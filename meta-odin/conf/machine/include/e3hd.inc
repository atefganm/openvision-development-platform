## meta-odin/conf/machine/include/e3hd.inc
```bitbake
require conf/machine/include/odin-oem.inc

KERNELVERSION = "3.18.24"

MTD_KERNEL = "mtd1"
MTD_ROOTFS = "mtd2"

IMAGEDIR = "e3hd"

MACHINE_ESSENTIAL_EXTRA_RDEPENDS += "\
	odin-dvb-modules-e3hd \
	"

PREFERRED_PROVIDER_virtual/blindscan-dvbc = "odin-blindscan-utils-e3hd"
PREFERRED_PROVIDER_virtual/blindscan-dvbs = "odin-blindscan-utils-e3hd"

SOC_FAMILY = "bcm7358"

PREFERRED_VERSION_linux-odin = "${KERNELVERSION}"

MACHINE_FEATURES += "videoenhancement blindscan-tbs dvb-c RCA"

RCTYPE = "504"
RCNAME = "e3hd"
```

## meta-odin/conf/machine/include/odinm7.inc
```bitbake
require conf/machine/include/odin-oem.inc

KERNELVERSION = "3.18.24"

IMAGEDIR = "en2"

MTD_KERNEL = "mtd3"
MTD_ROOTFS = "mtd4"

MACHINE_ESSENTIAL_EXTRA_RDEPENDS += "\
	odin-dvb-modules-odinm7 \
	"

PREFERRED_PROVIDER_virtual/blindscan-dvbc = "odin-blindscan-utils-odinm7"
PREFERRED_PROVIDER_virtual/blindscan-dvbs = "odin-blindscan-utils-odinm7"

SOC_FAMILY = "bcm7358"

PREFERRED_VERSION_linux-odin = "${KERNELVERSION}"

MACHINE_FEATURES += "videoenhancement blindscan-tbs 7segment textlcd dvb-c SCART RCA"

RCTYPE = "505"
RCNAME = "odinm7"
```

## meta-odin/conf/machine/include/odinm9.inc
```bitbake
require conf/machine/include/odin-oem.inc

KERNELVERSION = "3.6.0"

MTD_KERNEL = "mtd2"
MTD_ROOTFS = "mtd3"

IMAGEDIR = "odinm9"

MACHINE_ESSENTIAL_EXTRA_RDEPENDS += "\
	odin-dvb-modules-odinm9 \
	"

PREFERRED_PROVIDER_virtual/blindscan-dvbc = "odin-blindscan-utils-odinm9"
PREFERRED_PROVIDER_virtual/blindscan-dvbs = "odin-blindscan-utils-odinm9"

SOC_FAMILY = "bcm7413"

PREFERRED_VERSION_linux-odin = "${KERNELVERSION}"

MACHINE_FEATURES += "ci fanctrl textlcd RCA SCART YUV vfdsymbol"

RCNAME = "odinm9"
```

## meta-protek/conf/machine/9900lx.conf
```bitbake
#
# This is config file for Protek 9900 LX
#

require conf/machine/include/protek.inc

SOC_FAMILY = "bcm7362"

RCNAME = "protek1"
```

## meta-protek/conf/machine/include/protek.inc
```bitbake
# We know about rtc
MACHINE_FEATURES_BACKFILL_CONSIDERED += "rtc"

KERNELVERSION = "4.1.21"

BOX_BRAND = "protek"

MTD_KERNEL = "mtd1"
MTD_ROOTFS = "mtd2"
KERNEL_FILE = "kernel.bin"
ROOTFS_FILE = "rootfs.bin"

DVBPROVIDER = "kernel"
DVBSKYPROVIDER = "kernel"

MACHINE_ESSENTIAL_EXTRA_RDEPENDS += "\
	protek-dvb-modules-${MACHINE} \
	kernel-module-extrawlan-mt7601u \
	firmware-mt7601u \
	gstreamer1.0-plugin-dvbmediasink \
	"

DVBMEDIASINK_CONFIG = "--with-wma --with-wmv --with-pcm --with-dtsdownmix --with-vb6 --with-vb8 --with-spark"

TARGET_ARCH = "mipsel"
DEFAULTTUNE = "mips32el"

PREFERRED_PROVIDER_virtual/kernel = "linux-protek"
PREFERRED_VERSION_linux-protek = "${KERNELVERSION}"
PREFERRED_PROVIDER_virtual/blindscan-dvbc = "protek-blindscan-utils-dvbc"
PREFERRED_PROVIDER_virtual/blindscan-dvbs = "protek-blindscan-utils-dvbs"

KERNEL_IMAGETYPE = "vmlinux"
KERNEL_OUTPUT = "${KERNEL_IMAGETYPE}"
KERNEL_CONSOLE = "ttyS0,115200n8"

IMAGE_FSTYPES ?= "ubi"

MKUBIFS_ARGS = "-m 2048 -e 126976 -c 4096"
UBINIZE_ARGS = "-m 2048 -p 128KiB"

IMAGE_CMD_ubifs_prepend = "\
	rm -rf ${IMAGE_ROOTFS}/boot/*; \
	rm -rf ${IMAGE_ROOTFS}/tmp/*; \
	"

IMAGE_CMD_ubi_append = " \
	mkdir -p ${DEPLOY_DIR_IMAGE}/${IMAGEDIR}; \
	mv -f ${IMGDEPLOYDIR}/${IMAGE_NAME}${IMAGE_NAME_SUFFIX}.ubi ${DEPLOY_DIR_IMAGE}/${IMAGEDIR}/${ROOTFS_FILE}; \
	gzip -9c ${DEPLOY_DIR_IMAGE}/vmlinux-${MACHINE}.bin > ${DEPLOY_DIR_IMAGE}/${IMAGEDIR}/${KERNEL_FILE}; \
	echo ${IMAGE_NAME} > ${DEPLOY_DIR_IMAGE}/${IMAGEDIR}/imageversion; \
	echo "https://forum.openvision.tech/app.php/donate" > ${DEPLOY_DIR_IMAGE}/${IMAGEDIR}/donate.txt; \
	echo "rename this file to 'force' to force an update without confirmation" > ${DEPLOY_DIR_IMAGE}/${IMAGEDIR}/noforce; \
	rm -f ${DEPLOY_DIR_IMAGE}/*.zip; \
	cd ${DEPLOY_DIR_IMAGE}; \
	zip ${IMAGE_NAME}_usb.zip ${IMAGEDIR}/*; \
	rm -f ${DEPLOY_DIR_IMAGE}/*.ubi; \
	rm -f ${DEPLOY_DIR_IMAGE}/*.ubifs; \
	rm -Rf ${IMAGEDIR}; \
	"

MACHINE_FEATURES += "alsa hdmicec switchoff videoenhancement ci blindscan-tbs 7segment textlcd HDMI RCA"

# Broken bootloader can only flash around 100 MB
FLASHSIZE = "96"

BOOTLOGO_FILENAME = "splash.bin"

require conf/machine/include/tune-mips32.inc
require conf/machine/include/soc-family.inc
```

## meta-sh4/conf/layer.conf
```bitbake
# We have a conf and classes directory, append to BBPATH
BBPATH .= ":${LAYERDIR}"

# We have a recipes directory, add to BBFILES
BBFILES += "${LAYERDIR}/recipes-*/*.bb ${LAYERDIR}/recipes-*/*.bbappend \
            ${LAYERDIR}/recipes-*/*/*.bb ${LAYERDIR}/recipes-*/*/*.bbappend \
            ${LAYERDIR}/recipes-*/*/*/*.bb ${LAYERDIR}/recipes-*/*/*/*.bbappend"

META-sh4-BASE := '${@os.path.normpath("${LAYERDIR}/../")}'
# Prevent current directory creeping into sstate objects. Otherwise, building
# in another TOPDIR will cause recipes using this variable to be rebuilt.
META-sh4-BASE[vardepvalue] = 'meta-sh4'

# Additional license directories.
LICENSE_PATH += "${LAYERDIR}/conf/license"

WAF_CROSS_ANSWERS_PATH_sh4 = "${LAYERDIR}/files/waf-cross-answers"

DEBUG_PREFIX_MAP_sh4 = "-fdebug-prefix-map=${WORKDIR}=/usr/src/debug/${PN}/${EXTENDPE}${PV}-${PR} \
                     -fdebug-prefix-map=${STAGING_DIR_HOST}= \
                     -fdebug-prefix-map=${STAGING_DIR_NATIVE}= \
"

DEBUG_FLAGS_sh4 = "-g -feliminate-unused-debug-types ${DEBUG_PREFIX_MAP}"
```

## meta-sh4/conf/machine/adb_2850.conf
```bitbake
require conf/machine/include/nbox.inc

PREFERRED_PROVIDER_virtual/kernel = "linux-sh4-hs"

MACHINE_FEATURES += "RCA"

AUDIOELF = "audio_7111.elf"
VIDEOELF = "video_7111.elf"

SOC_FAMILY = "sti7111"

MACHINE_ESSENTIAL_EXTRA_RDEPENDS += "\
	stlinux24-sh4-stmfb-firmware-stx7111 \
	stlinux24-sh4-stx7111-fdma-firmware \
	"
```

## meta-sh4/conf/machine/adb_box.conf
```bitbake
require conf/machine/include/nbox.inc

PREFERRED_PROVIDER_virtual/kernel = "linux-sh4-ufs910"

MACHINE_FEATURES += "SCART"

AUDIOELF = "audio_7100.elf"
VIDEOELF = "video_7100.elf"

SOC_FAMILY = "sti7100"

MACHINE_ESSENTIAL_EXTRA_RDEPENDS += "\
	fp-control \
	stlinux24-sh4-stx7100-fdma-firmware \
	"
```

## meta-sh4/conf/machine/arivalink200.conf
```bitbake
require conf/machine/include/oem-sh4.inc
require conf/machine/include/normal-sh4-image.inc
require conf/machine/include/sh4-jffs2.inc

BOX_BRAND = "ferguson"

PREFERRED_PROVIDER_virtual/kernel = "linux-sh4-cuberevo"

ROOTFS_FILE = "root.img"
KERNEL_FILE = "uImage"

IMAGE_FSTYPES = "tar.gz"

MACHINE_FEATURES += "hdmicec ci smallflash RCA YUV SCART nofhdskin"

AUDIOELF = "audio_7100.elf"
VIDEOELF = "video_7109.elf"

SOC_FAMILY = "sti7109"

DVB1FIRMWARE = "dvb-fe-avl6222.fw"
DVB2FIRMWARE = "dvb-fe-cx24116.fw"

MACHINE_ESSENTIAL_EXTRA_RDEPENDS += "\
	firmware-sh4 \
	kernel-module-zram \
	stlinux24-sh4-stx7109-fdma-firmware \
	stlirc \
	"

CAN_USE_ENIGMA2_IN_FLASH = "1"
```

## meta-sh4/conf/machine/atevio7500.conf
```bitbake
require conf/machine/include/oem-sh4.inc
require conf/machine/include/ird-jffs2-image.inc
require conf/machine/include/sh4-jffs2.inc

BOX_BRAND = "atevio"

MTD_KERNEL = "mtd4"
MTD_ROOTFS = "mtd5"

PREFERRED_PROVIDER_virtual/kernel = "linux-sh4-spark7162"

ROOTFS_FILE = "root.img"
KERNEL_FILE = "uImage"

IMAGE_FSTYPES = "tar.gz"

MACHINE_FEATURES += "ci hdmicec smallflash RCA YUV SCART resellerid"

AUDIOELF = "audio_7105.elf"
VIDEOELF = "video_7105.elf"

SOC_FAMILY = "sti7105"

DVB1FIRMWARE = "dvb-fe-avl2108.fw"
DVB2FIRMWARE = "dvb-fe-stv6306.fw"

MACHINE_ESSENTIAL_EXTRA_RDEPENDS += "\
	enigma2-plugin-extensions-hs8200vfd \
	firmware-sh4 \
	fp-control \
	kernel-module-zram \
	stlinux24-sh4-stmfb-firmware-stx7105 \
	stlinux24-sh4-stx7105-fdma-firmware \
	"

CAN_USE_ENIGMA2_IN_FLASH = "1"

RESELLERID = "23190000"
#RESELLERID = "231900A0"

RCTYPE = "7"
RCNAME = "fs9000"
```

## meta-sh4/conf/machine/forever_2424hd.conf
```bitbake
require conf/machine/include/forever.inc

MTD_KERNEL = "mtd1"
MTD_ROOTFS = "mtd2"

MACHINE_FEATURES += "ci 7segment RCA"

RESELLERID = "29091000"
```

## meta-sh4/conf/machine/forever_3434hd.conf
```bitbake
require conf/machine/include/forever.inc

MACHINE_FEATURES += "RCA"

RESELLERID = "29090300"
```

## meta-sh4/conf/machine/forever_9898hd.conf
```bitbake
require conf/machine/include/forever.inc

MACHINE_FEATURES += "ci SCART YUV"

RESELLERID = "29090200"
```

## meta-sh4/conf/machine/fortis_hdbox.conf
```bitbake
require conf/machine/include/oem-sh4.inc
require conf/machine/include/normal-sh4-image.inc
require conf/machine/include/sh4-jffs2.inc

BOX_BRAND = "fortis"

PREFERRED_PROVIDER_virtual/kernel = "linux-sh4-edisionargus"

ROOTFS_FILE = "root.img"
KERNEL_FILE = "uImage"

IMAGE_FSTYPES = "tar.gz"

MACHINE_FEATURES += "ci smallflash SCART RCA YUV resellerid"

AUDIOELF = "audio_7100.elf"
VIDEOELF = "video_7109.elf"

SOC_FAMILY = "sti7109"

MACHINE_ESSENTIAL_EXTRA_RDEPENDS += "\
	enigma2-plugin-extensions-fs9000vfd \
	fp-control \
	kernel-module-zram \
	stlinux24-sh4-stx7109-fdma-firmware \
	"

CAN_USE_ENIGMA2_IN_FLASH = "0"

RESELLERID = "20020000"

RCTYPE = "7"
RCNAME = "fs9000"
```

## meta-sh4/conf/machine/hl101.conf
```bitbake
require conf/machine/include/oem-sh4.inc
require conf/machine/include/normal-sh4-image.inc

BOX_BRAND = "spiderbox"

PREFERRED_PROVIDER_virtual/kernel = "linux-sh4-edisionargus"

IMAGE_FSTYPES = "tar.gz"

AUDIOELF = "audio_7100.elf"
VIDEOELF = "video_7109.elf"

SOC_FAMILY = "sti7109"

DVB1FIRMWARE = "dvb-fe-avl2108.fw"
DVB2FIRMWARE = "dvb-fe-stv6306.fw"

MACHINE_ESSENTIAL_EXTRA_RDEPENDS += "\
	firmware-sh4 \
	fp-control \
	stlinux24-sh4-stx7109-fdma-firmware \
	stlirc \
	"

MACHINE_FEATURES += "ci middleflash SCART RCA YUV"

CAN_USE_ENIGMA2_IN_FLASH = "1"

RCTYPE = "18"
RCNAME = "hl101"
```

## meta-sh4/conf/machine/hs7110.conf
```bitbake
require conf/machine/include/hs.inc
require conf/machine/include/normal-sh4-image.inc
require conf/machine/include/sh4-ubi.inc

MTD_KERNEL = "mtd2"
MTD_ROOTFS = "mtd3"

MACHINE_FEATURES += "smallflash"

MACHINE_ESSENTIAL_EXTRA_RDEPENDS += "\
	enigma2-plugin-extensions-hs7110vfd \
	"

CAN_USE_ENIGMA2_IN_FLASH = "0"

RESELLERID = "250202A0"

RCTYPE = "9"
RCNAME = "hs7110"
```

## meta-sh4/conf/machine/hs7119.conf
```bitbake
require conf/machine/include/hs.inc
require conf/machine/include/ird-ubi-image.inc

MTD_KERNEL = "mtd1"
MTD_ROOTFS = "mtd2"

MACHINE_ESSENTIAL_EXTRA_RDEPENDS += "\
	enigma2-plugin-extensions-hs7810avfd \
	"

CAN_USE_ENIGMA2_IN_FLASH = "1"

RESELLERID = "271500A0"

RCTYPE = "9"
RCNAME = "hs7110"
```

## meta-sh4/conf/machine/hs7420.conf
```bitbake
require conf/machine/include/hs.inc
require conf/machine/include/normal-sh4-image.inc
require conf/machine/include/sh4-ubi.inc

MTD_KERNEL = "mtd2"
MTD_ROOTFS = "mtd3"

MACHINE_FEATURES += "smallflash SCART RCA YUV"

MACHINE_ESSENTIAL_EXTRA_RDEPENDS += "\
	enigma2-plugin-extensions-hs742xvfd \
	"

CAN_USE_ENIGMA2_IN_FLASH = "0"

RESELLERID = "25070300"
#RESELLERID = "250703A0"

RCTYPE = "8"
```

## meta-sh4/conf/machine/hs7429.conf
```bitbake
require conf/machine/include/hs.inc
require conf/machine/include/ird-ubi-image.inc

MTD_KERNEL = "mtd1"
MTD_ROOTFS = "mtd2"

MACHINE_FEATURES += "SCART RCA YUV"

MACHINE_ESSENTIAL_EXTRA_RDEPENDS += "\
	enigma2-plugin-extensions-hs742xvfd \
	"

CAN_USE_ENIGMA2_IN_FLASH = "1"

RESELLERID = "271530A0"
#RESELLERID = "271531A0"

RCTYPE = "8"
```

## meta-sh4/conf/machine/hs7810a.conf
```bitbake
require conf/machine/include/hs.inc
require conf/machine/include/normal-sh4-image.inc
require conf/machine/include/sh4-jffs2.inc

MTD_KERNEL = "mtd2"
MTD_ROOTFS = "mtd3"

MACHINE_FEATURES += "smallflash SCART RCA"

MACHINE_ESSENTIAL_EXTRA_RDEPENDS += "\
	enigma2-plugin-extensions-hs7810avfd \
	"

CAN_USE_ENIGMA2_IN_FLASH = "0"

RESELLERID = "25070000"
#RESELLERID = "250700A0"

RCTYPE = "8"
```
