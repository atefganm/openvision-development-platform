## meta-dags/conf/machine/force2nano.conf
```bitbake
#
# This is config file for Iqon Force 2 Nano
#

MTD_KERNEL = "mtd2"
MTD_ROOTFS = "mtd0"
SPLASH1_BMP = "splash1_power.bmp"

IMAGEDIR = "update/force2nano/cfe"

MACHINE_ESSENTIAL_EXTRA_RDEPENDS += "\
    dags-dvb-modules-dags7362 \
    "

require conf/machine/include/dags7362.inc

RCNAME = "iqon1"
```

## meta-dags/conf/machine/force2plushv.conf
```bitbake
#
# This is config file for Iqon Force 2 Plus HV
#

IMAGEDIR = "update/force2plushv/cfe"

require conf/machine/include/dags73625.inc

RCNAME = "iqon1"
```

## meta-dags/conf/machine/force3uhd.conf
```bitbake
#
# This is config file for Iqon Force 3 UHD
#

MTD_KERNEL = "mmcblk0p1"
MTD_ROOTFS = "mmcblk0p4"
SPLASH1_BMP = "splash1_power.bmp"

IMAGEDIR = "update/force3uhd"

MACHINE_ESSENTIAL_EXTRA_RDEPENDS += "\
    dags-dvb-modules-dags7252-200 \
    "

require conf/machine/include/dags7252.inc

MACHINE_FEATURES += "transcoding vfdsymbol"

RCNAME = "iqon3"
```

## meta-dags/conf/machine/force3uhdplus.conf
```bitbake
#
# This is config file for Iqon Force 3 UHD Plus
#

MTD_KERNEL = "mmcblk0p1"
MTD_ROOTFS = "mmcblk0p4"
SPLASH1_BMP = "splash1_power.bmp"

IMAGEDIR = "update/force3uhdplus"

MACHINE_ESSENTIAL_EXTRA_RDEPENDS += "\
    dags-dvb-modules-dags7252-300 \
    "

require conf/machine/include/dags7252.inc

MACHINE_FEATURES += "transcoding"

RCNAME = "iqon3"
```

## meta-dags/conf/machine/force4.conf
```bitbake
#
# This is config file for Iqon Force 4
#

IMAGEDIR = "update/force4"

require conf/machine/include/dags72604.inc

RCNAME = "iqon1"
```

## meta-dags/conf/machine/fusionhd.conf
```bitbake
#
# This is config file for Xsarius Fusion HD
#

MTD_KERNEL = "mtd2"
MTD_ROOTFS = "mtd0"
SPLASH1_BMP = "splash1_power.bmp"

IMAGEDIR = "update/fusionhd/cfe"

MACHINE_ESSENTIAL_EXTRA_RDEPENDS += "\
    dags-dvb-modules-dags7362 \
    "

require conf/machine/include/dags7362.inc

RCNAME = "fusionhd"
```
