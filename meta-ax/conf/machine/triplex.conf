## meta-ax/conf/machine/triplex.conf
```bitbake
#@TYPE: Machine
#@NAME: AX Triplex
#@DESCRIPTION: Machine configuration for the AX Triplex

KERNELVERSION = "4.10.6"

PREFERRED_VERSION_linux-ax = "${KERNELVERSION}"

SOC_FAMILY = "bcm7356"

MKUBIFS_ARGS = "-m 2048 -e 126976 -c 8192"
UBINIZE_ARGS = "-m 2048 -p 128KiB"

require conf/machine/include/ax.inc

MACHINE_FEATURES += "dvb-c ci textlcd fan blindscan-tbs RCA SCART YUV"

# Broken bootloader can only flash around 100 MB
FLASHSIZE = "96"

DVBMEDIASINK_CONFIG = "--with-wma --with-wmv --with-pcm --with-dts --with-eac3"

RCTYPE = "18"
```

## meta-ax/conf/machine/ultrabox.conf
```bitbake
#@TYPE: Machine
#@NAME: AX Ultrabox
#@DESCRIPTION: Machine configuration for the AX Ultrabox

KERNELVERSION = "4.7.6"

PREFERRED_VERSION_linux-ax = "${KERNELVERSION}"

SOC_FAMILY = "bcm73625"

MKUBIFS_ARGS = "-m 2048 -e 126976 -c 8192"
UBINIZE_ARGS = "-m 2048 -p 128KiB"

require conf/machine/include/ax.inc

DVBMEDIASINK_CONFIG = "--with-wma --with-wmv --with-pcm --with-dts --with-eac3 --with-h265 --with-vb6 --with-vb8 --with-spark"
```

## meta-azbox/conf/layer.conf
```bitbake
# We have a conf and classes directory, append to BBPATH
BBPATH .= ":${LAYERDIR}"

# We have a recipes directory, add to BBFILES
BBFILES += "${LAYERDIR}/recipes-*/*.bb ${LAYERDIR}/recipes-*/*.bbappend \
            ${LAYERDIR}/recipes-*/*/*.bb ${LAYERDIR}/recipes-*/*/*.bbappend \
            ${LAYERDIR}/recipes-*/*/*/*.bb ${LAYERDIR}/recipes-*/*/*/*.bbappend"

METAAZBOX_BASE := '${@os.path.normpath("${LAYERDIR}/../")}'
# Prevent current directory creeping into sstate objects. Otherwise, building
# in another TOPDIR will cause recipes using this variable to be rebuilt.
METAAZBOX_BASE[vardepvalue] = 'meta-azbox'

# Additional license directories.
LICENSE_PATH += "${LAYERDIR}/conf/license"
```

## meta-azbox/conf/machine/azboxme.conf
```bitbake
#@TYPE: Machine
#@NAME: AZBox Me
#@DESCRIPTION: Machine configuration for the AZBox Me

require conf/machine/include/azbox.inc

MACHINE_FEATURES += "YUV RCA"

SOC_FAMILY = "smp8655"

IMAGE_CMD_jffs2_append = " \
	rm -f ${DEPLOY_DIR_IMAGE}/*.bin; \
	rm -f ${DEPLOY_DIR_IMAGE}/*.tgz; \
	rm -f ${DEPLOY_DIR_IMAGE}/*.zip; \
	rm -f ${DEPLOY_DIR_IMAGE}/WEBIF/*.zip; \
	rm -f ${DEPLOY_DIR_IMAGE}/WEBIF/*.txt; \
	rm -f ${DEPLOY_DIR_IMAGE}/WEBIF/imageversion; \
	cp -f ${DEPLOY_DIR_IMAGE}/zbimage-linux-xload ${DEPLOY_DIR_IMAGE}/WEBIF/; \
	cp -f ${DEPLOY_DIR_IMAGE}/image0.jffs2 ${DEPLOY_DIR_IMAGE}/WEBIF/flash.jffs2; \
	tar -C ${DEPLOY_DIR_IMAGE}/WEBIF/ -cf ${DEPLOY_DIR_IMAGE}/WEBIF/webif-update.tar . ; \
	echo ${IMAGE_NAME} > ${DEPLOY_DIR_IMAGE}/WEBIF/imageversion; \
	echo "https://forum.openvision.tech/app.php/donate" > ${DEPLOY_DIR_IMAGE}/WEBIF/donate.txt; \
	cd ${DEPLOY_DIR_IMAGE}/WEBIF && zip ${IMAGE_NAME}_webif.zip webif-update.tar imageversion donate.txt; \
	rm -f ${DEPLOY_DIR_IMAGE}/WEBIF/*.tar; \
	rm -f ${DEPLOY_DIR_IMAGE}/WEBIF/*.jffs2; \
	rm -f ${DEPLOY_DIR_IMAGE}/WEBIF/zbimage-linux-xload; \
	wget -nc -P ${DEPLOY_DIR_IMAGE}/USB/ http://source.mynonpublic.com/azbox/me/update.ext; \
	cp -f ${DEPLOY_DIR_IMAGE}/zbimage-linux-xload ${DEPLOY_DIR_IMAGE}/USB/; \
	cp -f ${DEPLOY_DIR_IMAGE}/image0.jffs2 ${DEPLOY_DIR_IMAGE}/USB/; \
	echo ${IMAGE_NAME} > ${DEPLOY_DIR_IMAGE}/USB/imageversion; \
	echo "https://forum.openvision.tech/app.php/donate" > ${DEPLOY_DIR_IMAGE}/USB/donate.txt; \
	rm -f ${DEPLOY_DIR_IMAGE}/*.jffs2; \
	rm -f ${DEPLOY_DIR_IMAGE}/USB/*.zip; \
	cd ${DEPLOY_DIR_IMAGE}; \
	zip -j ${IMAGE_NAME}_usb.zip USB/*; \
	rm -f ${DEPLOY_DIR_IMAGE}/USB/*.jffs2; \
	rm -f ${DEPLOY_DIR_IMAGE}/USB/zbimage-linux-xload; \
	mv -f ${DEPLOY_DIR_IMAGE}/${IMAGE_NAME}_usb.zip ${DEPLOY_DIR_IMAGE}/USB/; \
	"
```

## meta-azbox/conf/machine/azboxminime.conf
```bitbake
#@TYPE: Machine
#@NAME: AZBox MiniMe
#@DESCRIPTION: Machine configuration for the AZBox MiniMe

require conf/machine/include/azbox.inc

MACHINE_FEATURES += "AV_JACK"

SOC_FAMILY = "smp8653"

do_image_jffs2[depends] += "${MACHINE}-packer-native:do_populate_sysroot"

IMAGE_CMD_jffs2_append = " \
	rm -f ${DEPLOY_DIR_IMAGE}/*.bin; \
	rm -f ${DEPLOY_DIR_IMAGE}/*.tgz; \
	rm -f ${DEPLOY_DIR_IMAGE}/*.zip; \
	rm -f ${DEPLOY_DIR_IMAGE}/WEBIF/*.zip; \
	rm -f ${DEPLOY_DIR_IMAGE}/WEBIF/*.txt; \
	rm -f ${DEPLOY_DIR_IMAGE}/WEBIF/imageversion; \
	cp -f ${DEPLOY_DIR_IMAGE}/zbimage-linux-xload ${DEPLOY_DIR_IMAGE}/WEBIF/; \
	cp -f ${DEPLOY_DIR_IMAGE}/image0.jffs2 ${DEPLOY_DIR_IMAGE}/WEBIF/flash.jffs2; \
	pack_minime_image ${DEPLOY_DIR_IMAGE}/WEBIF/zbimage-linux-xload ${DEPLOY_DIR_IMAGE}/WEBIF/flash.jffs2 ${DEPLOY_DIR_IMAGE}/WEBIF/webif-update.img; \
	echo ${IMAGE_NAME} > ${DEPLOY_DIR_IMAGE}/WEBIF/imageversion; \
	echo "https://forum.openvision.tech/app.php/donate" > ${DEPLOY_DIR_IMAGE}/WEBIF/donate.txt; \
	cd ${DEPLOY_DIR_IMAGE}/WEBIF && zip ${IMAGE_NAME}_webif.zip webif-update.img imageversion donate.txt; \
	rm -f ${DEPLOY_DIR_IMAGE}/WEBIF/*.img; \
	rm -f ${DEPLOY_DIR_IMAGE}/WEBIF/*.jffs2; \
	rm -f ${DEPLOY_DIR_IMAGE}/WEBIF/zbimage-linux-xload; \
	wget -nc -P ${DEPLOY_DIR_IMAGE}/USB/ http://source.mynonpublic.com/azbox/minime/update.ext; \
	cp -f ${DEPLOY_DIR_IMAGE}/zbimage-linux-xload ${DEPLOY_DIR_IMAGE}/USB/; \
	cp -f ${DEPLOY_DIR_IMAGE}/image0.jffs2 ${DEPLOY_DIR_IMAGE}/USB/; \
	echo ${IMAGE_NAME} > ${DEPLOY_DIR_IMAGE}/USB/imageversion; \
	echo "https://forum.openvision.tech/app.php/donate" > ${DEPLOY_DIR_IMAGE}/USB/donate.txt; \
	rm -f ${DEPLOY_DIR_IMAGE}/*.jffs2; \
	rm -f ${DEPLOY_DIR_IMAGE}/USB/*.zip; \
	cd ${DEPLOY_DIR_IMAGE}; \
	zip -j ${IMAGE_NAME}_usb.zip USB/*; \
	rm -f ${DEPLOY_DIR_IMAGE}/USB/*.jffs2; \
	rm -f ${DEPLOY_DIR_IMAGE}/USB/zbimage-linux-xload; \
	mv -f ${DEPLOY_DIR_IMAGE}/${IMAGE_NAME}_usb.zip ${DEPLOY_DIR_IMAGE}/USB/; \
	"
```

## meta-azbox/conf/machine/include/azbox.inc
```bitbake
# We know about rtc
MACHINE_FEATURES_BACKFILL_CONSIDERED += "rtc"

KERNELVERSION = "3.9.2"

BOX_BRAND = "azbox"

MACHINE_ESSENTIAL_EXTRA_RDEPENDS += "\
	azbox-compat \
	azbox-dvb-modules-${MACHINE} \
	azbox-mrua-${MACHINE} \
	enigma2-plugin-systemplugins-rtisys \	
	enigma2-plugin-systemplugins-videosettingssetup \
	"

EXTRA_IMAGEDEPENDS += "\
	kmod-native \
	"

DVBPROVIDER = "kernel"

DVBMEDIASINK_CONFIG = "--with-wma --with-wmv --with-pcm --with-dtsdownmix"

MACHINE_FEATURES += "azbox alsa usbhost nl80211 switchoff lpcm textlcd 32bpp dvbapi5 dvb-c blindscan-dvbs HDMI"

PREFERRED_PROVIDER_virtual/kernel = "linux-azbox"
PREFERRED_VERSION_linux-azbox = "${KERNELVERSION}"
PREFERRED_PROVIDER_virtual/blindscan-dvbs = "azbox-blindscan-dvbs-utils"

GLIBC_EXTRA_OECONF = "--with-tls --with-__thread"

require conf/machine/include/tune-mips32.inc
require conf/machine/include/soc-family.inc

SYSVINIT_ENABLED_GETTYS = ""

KERNEL_EXTRA_CMD = "--disable-compressor=lzo "

IMAGE_FSTYPES ?= "jffs2"

EXTRA_IMAGECMD_jffs2 = " -p 0x800 -e 0x20000 -n -l"

IMAGE_CMD_jffs2_prepend = " \
    mkdir -p ${DEPLOY_DIR_IMAGE}/USB; \
    mkdir -p ${DEPLOY_DIR_IMAGE}/WEBIF; \
    rm -fR ${IMAGE_ROOTFS}/boot/*; \
    mkfs.jffs2 \
        --root=${IMAGE_ROOTFS} \
        --faketime \
        ${KERNEL_EXTRA_CMD} \
        --compression-mode=size \
        --output=${DEPLOY_DIR_IMAGE}/image0.jffs2 \
        ${EXTRA_IMAGECMD}; \
    "

IMAGE_CMD_jffs2_prepend = "\
    rm -Rf ${IMAGE_ROOTFS}/tmp/*; \
    "

BLINDSCAN_BINARY = "avl_azbox_blindscan"

TARGET_ARCH = "mipsel"
DEFAULTTUNE = "mips32el"

RCNAME = "azboxme"
```

## meta-beyonwiz/conf/machine/beyonwizv2.conf
```bitbake
#@TYPE: Machine
#@NAME: beyonwizv2
#@DESCRIPTION: Machine configuration for the beyonwizv2

IMAGEDIR = "beyonwiz/v2"

require conf/machine/include/beyonwiz-hisi.inc

MACHINE_ESSENTIAL_EXTRA_RDEPENDS += "\
    enigma2-plugin-drivers-dvb-usb-it913x \
    enigma2-plugin-drivers-dvb-usb-rtl2832 \
    "
```

## meta-beyonwiz/conf/machine/include/beyonwiz-hisi.inc
```bitbake
# We know about rtc
MACHINE_FEATURES_BACKFILL_CONSIDERED += "rtc"

KERNELVERSION = "4.4.35"

BOX_BRAND = "beyonwiz"

DISTRO_FEATURES_remove += "x11 wayland"

EXTRA_OECONF_append_pn-enigma2 = "--with-lcddev=/dev/null --with-alphablendingacceleration=always --with-blitaccelerationthreshold=250  --with-fillaccelerationthreshold=190000"

SOC_FAMILY = "hisi3798mv200"
HICHIPSET = "3798mv200"
CHIPSET = "Hi3798Mv200"

MTD_KERNEL = "mmcblk0p12"
MTD_ROOTFS = "mmcblk0p16"

KERNEL_FILE = "kernel.bin"
ROOTFS_FILE = "rootfs.tar.bz2"
MTD_BLACK  = "mmcblk0"

MACHINE_ESSENTIAL_EXTRA_RDEPENDS += "\
	beyonwiz-dvb-modules-${MACHINE} \
	beyonwiz-loadmodules-${MACHINE} \ 
	beyonwiz-libs-${MACHINE} \
	beyonwiz-hihalt-${MACHINE} \
	beyonwiz-reader-${MACHINE} \
	beyonwiz-libreader-${MACHINE} \
	beyonwiz-partitions-${MACHINE} \
	beyonwiz-buildimage \
	e2fsprogs-resize2fs \
	gptfdisk \
	gstreamer1.0-plugin-dvbmediasink \
	"

MACHINE_FEATURES += "switchoff 7segment hdmicec textlcd emmc mmc dvb-c alsa hisil multitranscoding HDMI AV_JACK vfdsymbol"

IMAGE_CLASSES  += "beyonwiz-emmc_image"
IMAGE_FSTYPES += "beyonwizemmc"
IMAGE_ROOTFS_SIZE ?= "524288"

TARGET_ARCH = "arm"
DEFAULTTUNE = "cortexa15hf-neon-vfpv4"

PREFERRED_VERSION_linux-beyonwiz = "${KERNELVERSION}"

#Provider
PREFERRED_PROVIDER_virtual/kernel = "linux-beyonwiz"
PREFERRED_PROVIDER_virtual/blindscan-dvbs = "beyonwiz-blindscan-${MACHINE}"
PREFERRED_RPROVIDER_showiframe = "beyonwiz-showiframe-${MACHINE}"
PREFERRED_RPROVIDER_aio-grab = "beyonwiz-grab-${MACHINE}"
PREFERRED_PROVIDER_virtual/enigma2-mediaservice = "enigma2-plugin-systemplugins-servicehisilicon"

require conf/machine/include/tune-cortexa15.inc

DVBPROVIDER = "kernel"
DVBSKYPROVIDER = "kernel"

require conf/machine/include/soc-family.inc

DVBMEDIASINK_CONFIG = "--with-h265 --with-vb8 --with-vb9 --with-spark --with-wma --with-wmv --with-pcm --with-dts --with-eac3"

IMAGE_CMD_beyonwizemmc_append = " \
	mkdir -p ${DEPLOY_DIR_IMAGE}/${IMAGEDIR}; \
	mv -f ${IMGDEPLOYDIR}/${IMAGE_NAME}${IMAGE_NAME_SUFFIX}.ext4 ${DEPLOY_DIR_IMAGE}/${MACHINE}-partitions/rootfs.ext4; \
	cd ${IMAGE_ROOTFS}; \
	tar -cvf ${DEPLOY_DIR_IMAGE}/rootfs.tar -C ${IMAGE_ROOTFS} .; \
	mv -f ${DEPLOY_DIR_IMAGE}/rootfs.tar ${DEPLOY_DIR_IMAGE}/${IMAGEDIR}/rootfs.tar; \
	bzip2 ${DEPLOY_DIR_IMAGE}/${IMAGEDIR}/rootfs.tar; \
	cp -f ${DEPLOY_DIR_IMAGE}/uImage ${DEPLOY_DIR_IMAGE}/${IMAGEDIR}/${KERNEL_FILE}; \
	cp -f ${DEPLOY_DIR_IMAGE}/uImage ${DEPLOY_DIR_IMAGE}/${MACHINE}-partitions/${KERNEL_FILE}; \
	echo ${IMAGE_NAME} > ${DEPLOY_DIR_IMAGE}/${IMAGEDIR}/imageversion; \
	echo "https://forum.openvision.tech/app.php/donate" > ${DEPLOY_DIR_IMAGE}/${IMAGEDIR}/donate.txt; \
	cd ${DEPLOY_DIR_IMAGE}/${MACHINE}-partitions; \
	mkupdate -s 00000003-00000001-01010101 -f ${DEPLOY_DIR_IMAGE}/${MACHINE}-partitions/emmc_partitions.xml -d ${DEPLOY_DIR_IMAGE}/usb_update.bin; \
	rm -f ${DEPLOY_DIR_IMAGE}/*.zip; \
	cd ${DEPLOY_DIR_IMAGE}; \
	cp -f ${IMGDEPLOYDIR}/${IMAGE_NAME}${IMAGE_NAME_SUFFIX}.manifest ${IMAGE_NAME}_usb.zip.manifest; \
	zip -j ${IMAGE_NAME}_recovery_emmc.zip ${DEPLOY_DIR_IMAGE}/usb_update.bin ${DEPLOY_DIR_IMAGE}/${IMAGEDIR}/imageversion ${DEPLOY_DIR_IMAGE}/${IMAGEDIR}/donate.txt ${DEPLOY_DIR_IMAGE}/${MACHINE}-partitions/bootargs.bin ${DEPLOY_DIR_IMAGE}/${MACHINE}-partitions/fastboot.bin ${DEPLOY_DIR_IMAGE}/${MACHINE}-partitions/apploader.bin; \
	zip ${IMAGE_NAME}_usb.zip ${IMAGEDIR}/*; \
	rm -f ${DEPLOY_DIR_IMAGE}/*.ext4; \
	rm -f ${DEPLOY_DIR_IMAGE}/usb_update.bin; \
	rm -Rf ${IMAGEDIR}; \
	"

IMAGE_CMD_prepend = "\
	rm -Rf ${IMAGE_ROOTFS}/tmp/*; \
	"

EXTRA_ALSA = "mv200"

RCNAME = "beyonwiz2"
```

## meta-broadmedia/conf/layer.conf
```bitbake
# We have a conf and classes directory, append to BBPATH
BBPATH .= ":${LAYERDIR}"

# We have a recipes directory, add to BBFILES
BBFILES += "${LAYERDIR}/recipes-*/*.bb ${LAYERDIR}/recipes-*/*.bbappend \
            ${LAYERDIR}/recipes-*/*/*.bb ${LAYERDIR}/recipes-*/*/*.bbappend \
            ${LAYERDIR}/recipes-*/*/*/*.bb ${LAYERDIR}/recipes-*/*/*/*.bbappend"

METABROADMEDIA_BASE := '${@os.path.normpath("${LAYERDIR}/../")}'
# Prevent current directory creeping into sstate objects. Otherwise, building
# in another TOPDIR will cause recipes using this variable to be rebuilt.
METABROADMEDIA_BASE[vardepvalue] = 'meta-broadmedia'

# Additional license directories.
LICENSE_PATH += "${LAYERDIR}/conf/license"
```

## meta-broadmedia/conf/machine/alphatriplehd.conf
```bitbake
#@TYPE: Machine
#@NAME: alphatriple
#@DESCRIPTION: Machine configuration for SAB Alpha Triple HD

require conf/machine/include/g300.inc

IMAGEDIR = "sab_alpha_triple"

MACHINE_ESSENTIAL_EXTRA_RDEPENDS += "\
    broadmedia-dvb-modules-alphatriplehd \
    "

MACHINE_FEATURES += "vfdsymbol"

RCNAME = "sab1"
```

## meta-broadmedia/conf/machine/bre2zet2c.conf
```bitbake
#@TYPE: Machine
#@NAME: bre2zet2c
#@DESCRIPTION: Machine configuration for WWIO BRE2ZE T2/C

SOC_FAMILY = "bcm73625"

IMAGEDIR = "bre2ze_t2c"

require conf/machine/include/broadmedia-oem.inc

MACHINE_FEATURES += "ci 7segment blindscan-dvbc dvb-c satip"

MACHINE_ESSENTIAL_EXTRA_RDEPENDS += "\
    broadmedia-dvb-modules-bre2zet2c \
    "

DVBMEDIASINK_CONFIG = "--with-wma --with-wmv --with-pcm --with-dts --with-eac3 --with-h265 --with-vb6 --with-vb8 --with-spark"

RCTYPE = "500"
RCNAME = "wwio1"
```

## meta-broadmedia/conf/machine/include/g100.inc
```bitbake
require conf/machine/include/broadmedia-oem.inc

SOC_FAMILY = "bcm73625"

MACHINE_FEATURES += "ci 7segment"

MACHINE_ESSENTIAL_EXTRA_RDEPENDS += "\
	broadmedia-dvb-modules-g100 \
	"

DVBMEDIASINK_CONFIG = "--with-wma --with-wmv --with-pcm --with-dts --with-eac3 --with-h265 --with-vb6 --with-vb8 --with-spark"

STB_PLATFORM = "g100"

RCTYPE = "501"
RCNAME = "sf3038"
```

## meta-broadmedia/conf/machine/include/g300.inc
```bitbake
require conf/machine/include/broadmedia-oem.inc

SOC_FAMILY = "bcm7241"

MACHINE_FEATURES += "dvb-c ci blindscan-dvbc"

DVBMEDIASINK_CONFIG = "--with-wma --with-wmv --with-pcm --with-dts --with-eac3"

STB_PLATFORM = "g300"

RCTYPE = "503"
```

## meta-broadmedia/conf/machine/mbtwinplus.conf
```bitbake
#@TYPE: Machine
#@NAME: mbtwinplus
#@DESCRIPTION: Machine configuration for Miraclebox Premium Twin Plus

require conf/machine/include/g300.inc

IMAGEDIR = "miraclebox/twinplus"

MACHINE_ESSENTIAL_EXTRA_RDEPENDS += "\
    broadmedia-dvb-modules-twinplus \
    "

RCNAME = "miraclebox"
```

## meta-broadmedia/conf/machine/sf128.conf
```bitbake
#@TYPE: Machine
#@NAME: sf128
#@DESCRIPTION: Machine configuration for Octagon SF128

require conf/machine/include/g100.inc
```

## meta-broadmedia/conf/machine/sf138.conf
```bitbake
#@TYPE: Machine
#@NAME: sf138
#@DESCRIPTION: Machine configuration for Octagon SF138

require conf/machine/include/g100.inc

MACHINE_FEATURES += "blindscan-dvbc dvb-c"
```

## meta-broadmedia/conf/machine/sf3038.conf
```bitbake
#@TYPE: Machine
#@NAME: sf3038
#@DESCRIPTION: Machine configuration for Octagon SF3038

require conf/machine/include/g300.inc

MACHINE_ESSENTIAL_EXTRA_RDEPENDS += "\
    broadmedia-dvb-modules-sf3038 \
    "

MACHINE_FEATURES += "vfdsymbol"

RCNAME = "sf3038"
```

## meta-dags/conf/machine/force1.conf
```bitbake
#
# This is config file for Iqon Force 1
#

MTD_KERNEL = "mtd2"
MTD_ROOTFS = "mtd0"
SPLASH1_BMP = "splash1_os2.bmp"

IMAGEDIR = "update/force1/cfe"

MACHINE_ESSENTIAL_EXTRA_RDEPENDS += "\
    dags-dvb-modules-dags7356 \
    kernel-module-dvb-usb \
    edision-tuner-edicombo \
    "

require conf/machine/include/dags7356.inc

MACHINE_FEATURES += "YUV"

RCNAME = "iqon2"
```

## meta-dags/conf/machine/force1plus.conf
```bitbake
#
# This is config file for Iqon Force 1 Plus and MEGASAT Force 1 Plus
#

MTD_KERNEL = "mtd2"
MTD_ROOTFS = "mtd0"
SPLASH1_BMP = "splash1_os2.bmp"

IMAGEDIR = "update/force1plus/cfe"

MACHINE_ESSENTIAL_EXTRA_RDEPENDS += "\
    dags-dvb-modules-dags7356 \
    kernel-module-dvb-usb \
    edision-tuner-edicombo \
    "

require conf/machine/include/dags7356.inc

RCNAME = "iqon2"
```
