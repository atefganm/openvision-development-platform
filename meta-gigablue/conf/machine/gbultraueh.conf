## meta-gigablue/conf/machine/gbultraueh.conf
```bitbake
#@TYPE: Machine
#@NAME: Gigablue Ultra UE H
#@DESCRIPTION: Machine configuration for Gigablue Ultra UE H

IMAGEDIR = "gigablue/ultraueh"

require conf/machine/include/gigablue-gb73625.inc

MACHINE_FEATURES += "ci colorlcd220 gigabluelcd gigabluelcd220 YUV RCA"

RCNAME = "gb2"
```

## meta-gigablue/conf/machine/gbx1.conf
```bitbake
#@TYPE: Machine
#@NAME: Gigablue X1
#@DESCRIPTION: Machine configuration for Gigablue X1

IMAGEDIR = "gigablue/x1"

require conf/machine/include/gigablue-gb7362.inc
```

## meta-gigablue/conf/machine/gbx2.conf
```bitbake
#@TYPE: Machine
#@NAME: Gigablue X2
#@DESCRIPTION: Machine configuration for Gigablue X2

IMAGEDIR = "gigablue/x2"

require conf/machine/include/gigablue-gb73625.inc

RCNAME = "gb2"
```

## meta-gigablue/conf/machine/gbx3.conf
```bitbake
#@TYPE: Machine
#@NAME: Gigablue X3
#@DESCRIPTION: Machine configuration for Gigablue X3

IMAGEDIR = "gigablue/x3"

require conf/machine/include/gigablue-gb7362.inc

MACHINE_FEATURES += "blindscan-dvbc ci"
```

## meta-gigablue/conf/machine/gbx34k.conf
```bitbake
#@TYPE: Machine
#@NAME: GigaBlue X3 4K
#@DESCRIPTION: Machine configuration for the GigaBlue X3 4K

IMAGEDIR = "gigablue/x34k"

require conf/machine/include/gigablue-gb72604.inc

RCNAME = "gb3"
```

## meta-gigablue/conf/machine/gbx3h.conf
```bitbake
#@TYPE: Machine
#@NAME: Gigablue X3 H
#@DESCRIPTION: Machine configuration for Gigablue X3 H

IMAGEDIR = "gigablue/x3h"

require conf/machine/include/gigablue-gb73625.inc

MACHINE_FEATURES += "ci"

RCNAME = "gb2"
```

## meta-gigablue/conf/machine/include/gigablue-gb7252.inc
```bitbake
require conf/machine/include/gigablue-arm.inc

KERNELVERSION = "4.1.20"

MACHINE_FEATURES += "bolt colorlcd gigabluelcd ci blindscan-dvbs blindscan-dvbc transcoding dvb-c mountboot bluetooth quadpip"

SOC_FAMILY = "bcm7252s"

SRCDATE_BOLT = "20181120"

PREFERRED_VERSION_linux-gigablue = "${KERNELVERSION}"
PREFERRED_PROVIDER_virtual/kernel = "linux-gigablue"

IMAGE_CMD_tar_prepend = "\
	rm -Rf ${IMAGE_ROOTFS}/tmp/*; \
	mkdir -p ${DEPLOY_DIR_IMAGE}/${IMAGEDIR}; \
	cp -f ${DEPLOY_DIR_IMAGE}/${MACHINE}_boot.bin ${DEPLOY_DIR_IMAGE}/${IMAGEDIR}/boot.bin; \
	cp -f ${DEPLOY_DIR_IMAGE}/${MACHINE}_gpt.bin ${DEPLOY_DIR_IMAGE}/${IMAGEDIR}/gpt.bin; \
	cp -f ${DEPLOY_DIR_IMAGE}/${MACHINE}_rescue.bin ${DEPLOY_DIR_IMAGE}/${IMAGEDIR}/rescue.bin; \
	${@bb.utils.contains("MACHINE_FEATURES", "bolt", "cp -f ${DEPLOY_DIR_IMAGE}/${MACHINE}_bolt_${SRCDATE_BOLT}.bin ${DEPLOY_DIR_IMAGE}/${IMAGEDIR}/bolt_${SRCDATE_BOLT}.bin;" , "", d)} \
	cp -f ${DEPLOY_DIR_IMAGE}/zImage ${DEPLOY_DIR_IMAGE}/${IMAGEDIR}/${KERNEL_FILE}; \
	echo ${IMAGE_NAME} > ${DEPLOY_DIR_IMAGE}/${IMAGEDIR}/imageversion; \
	echo "https://forum.openvision.tech/app.php/donate" > ${DEPLOY_DIR_IMAGE}/${IMAGEDIR}/donate.txt; \
	cd ${IMAGE_ROOTFS}; \
	tar -cvf ${DEPLOY_DIR_IMAGE}/rootfs.tar -C ${IMAGE_ROOTFS} .; \
	mv -f ${DEPLOY_DIR_IMAGE}/rootfs.tar ${DEPLOY_DIR_IMAGE}/${IMAGEDIR}/rootfs.tar; \
	bzip2 ${DEPLOY_DIR_IMAGE}/${IMAGEDIR}/rootfs.tar; \
	cd ${DEPLOY_DIR_IMAGE}; \
	zip ${IMAGE_NAME}_usb.zip ${IMAGEDIR}/*; \
	rm -f ${DEPLOY_DIR_IMAGE}/*.tar.bz2; \
	rm -Rf gigablue; \
	"

MACHINE_ESSENTIAL_EXTRA_RDEPENDS += "\
	gigablue-platform-util-gb7252 \
	gigablue-ddbootup \
	gigablue-swapcreate \
	gstreamer1.0-plugin-dvbmediasink \
	"

EXTRA_IMAGEDEPENDS += "\
	gigablue-initrd-cfe-${MACHINE} \
	"

IMAGE_INSTALL_append = " \
	bluetoothsetup-gb7252 \
	"

STB_PLATFORM = "gb7252"

EXTRA_OECONF_append_pn-transtreamproxy = " --enable-ext-pid"
```

## meta-gigablue/conf/machine/include/gigablue-gb72604.inc
```bitbake
require conf/machine/include/gigablue-arm.inc

KERNELVERSION = "4.1.20"

DVBSKYPROVIDER = "kernel"

MACHINE_FEATURES += "colorlcd gigabluelcd gigabluelcd220 ci blindscan-dvbs blindscan-dvbc transcoding dvb-c mountboot bluetooth"

SOC_FAMILY = "bcm72604"

SRCDATE_BOLT = "20190926"

PREFERRED_VERSION_linux-gigablue = "${KERNELVERSION}"
PREFERRED_PROVIDER_virtual/kernel = "linux-gigablue"

IMAGE_CMD_tar_prepend = "\
	rm -Rf ${IMAGE_ROOTFS}/tmp/*; \
	mkdir -p ${IMGDEPLOYDIR}/${IMAGEDIR}; \
	cp -f ${DEPLOY_DIR_IMAGE}/${MACHINE}_boot.bin ${IMGDEPLOYDIR}/${IMAGEDIR}/boot.bin; \
	cp -f ${DEPLOY_DIR_IMAGE}/${MACHINE}_gpt.bin ${IMGDEPLOYDIR}/${IMAGEDIR}/gpt.bin; \
	cp -f ${DEPLOY_DIR_IMAGE}/${MACHINE}_rescue.bin ${IMGDEPLOYDIR}/${IMAGEDIR}/rescue.bin; \
	${@bb.utils.contains("MACHINE_FEATURES", "bolt", "cp -f ${DEPLOY_DIR_IMAGE}/${MACHINE}_bolt_${SRCDATE_BOLT}.bin ${DEPLOY_DIR_IMAGE}/${IMAGEDIR}/bolt_${SRCDATE_BOLT}.bin;" , "", d)} \
	cp -f ${DEPLOY_DIR_IMAGE}/zImage ${IMGDEPLOYDIR}/${IMAGEDIR}/${KERNEL_FILE}; \
	echo ${IMAGE_NAME} > ${IMGDEPLOYDIR}/${IMAGEDIR}/imageversion; \
	echo "https://forum.openvision.tech/app.php/donate" > ${IMGDEPLOYDIR}/${IMAGEDIR}/donate.txt; \
	cd ${IMAGE_ROOTFS}; \
	tar -cvf ${IMGDEPLOYDIR}/rootfs.tar -C ${IMAGE_ROOTFS} .; \
	mv -f ${IMGDEPLOYDIR}/rootfs.tar ${IMGDEPLOYDIR}/${IMAGEDIR}/rootfs.tar; \
	bzip2 ${IMGDEPLOYDIR}/${IMAGEDIR}/rootfs.tar; \
	cd ${IMGDEPLOYDIR}; \
	zip ${IMAGE_NAME}_usb.zip ${IMAGEDIR}/*; \
	rm -f ${DEPLOY_DIR_IMAGE}/*.tar.bz2; \
	rm -Rf gigablue; \
	"

MACHINE_ESSENTIAL_EXTRA_RDEPENDS += "\
	gigablue-platform-util-gb72604 \
	gigablue-ddbootup \
	gigablue-swapcreate \
	gstreamer1.0-plugin-dvbmediasink \
	"

EXTRA_IMAGEDEPENDS += "\
	gigablue-initrd-cfe-${MACHINE} \
	"

IMAGE_INSTALL_append = " \
	bluetoothsetup-gb72604 \
	"

STB_PLATFORM = "gb72604"
```

## meta-gigablue/conf/machine/include/gigablue-gb7325.inc
```bitbake
KERNELVERSION = "3.9.6"

SOC_FAMILY = "bcm7325"

require gigablue-mips.inc

MACHINE_FEATURES += "blindscan-dvbc ci SCART YUV RCA"

PREFERRED_VERSION_linux-gigablue = "${KERNELVERSION}"

MACHINE_ESSENTIAL_EXTRA_RDEPENDS += "\
	gigablue-dvb-modules-gb7325 \
	"

DVBMEDIASINK_CONFIG = "--with-wmv"

GLIBC_EXTRA_OECONF = "--with-tls"

STB_PLATFORM = "gb7325"

PREFERRED_VERSION_kernel-module-extrawlan-rt8812au = "4.3.14"
```

## meta-gigablue/conf/machine/include/gigablue-gb7356.inc
```bitbake
KERNELVERSION = "4.8.3"

SOC_FAMILY = "bcm7356"

require gigablue-mips.inc

MACHINE_FEATURES += "gigabluelcd blindscan-dvbc transcoding ci gigabluemipsbootvideo osdanimation blindscan-dvbs wol YUV RCA"

DVBSKYPROVIDER = "kernel"

PREFERRED_VERSION_linux-gigablue = "${KERNELVERSION}"

IMAGE_FSTYPES ?= "ubi"
MKUBIFS_ARGS = "-m 2048 -e 126976 -c 4096 -F"
UBINIZE_ARGS = "-m 2048 -p 128KiB"

MACHINE_ESSENTIAL_EXTRA_RDEPENDS += "\
	gigablue-dvb-modules-gb7356 \
	"

DVBMEDIASINK_CONFIG = "--with-wmv --with-wma --with-pcm --with-dts --with-eac3 --with-amr"

GLIBC_EXTRA_OECONF = "--with-tls --with-__thread"

STB_PLATFORM = "gb7356"
```

## meta-gigablue/conf/machine/include/gigablue-gb7358.inc
```bitbake
KERNELVERSION = "4.8.3"

SOC_FAMILY = "bcm7358"

require gigablue-mips.inc

MACHINE_FEATURES += "videoenhancement wol osdanimation"

# Broken bootloader can only flash around 100 MB
FLASHSIZE = "96"

DVBSKYPROVIDER = "kernel"

PREFERRED_VERSION_linux-gigablue = "${KERNELVERSION}"

IMAGE_FSTYPES ?= "ubi"
MKUBIFS_ARGS = "-m 2048 -e 126976 -c 4096"
UBINIZE_ARGS = "-m 2048 -p 128KiB"

MACHINE_ESSENTIAL_EXTRA_RDEPENDS += "\
	gigablue-dvb-modules-gb7358 \
	"

DVBMEDIASINK_CONFIG = "--with-wmv --with-wma --with-pcm --with-dts --with-eac3 --with-amr"

GLIBC_EXTRA_OECONF = "--with-tls --with-__thread"

STB_PLATFORM = "gb7358"
```

## meta-gigablue/conf/machine/include/gigablue-gb73625.inc
```bitbake
KERNELVERSION = "4.8.3"

SOC_FAMILY = "bcm73625"

require gigablue-mips.inc

MACHINE_FEATURES += "wol osdanimation blindscan-dvbs blindscan-dvbc"

# Broken bootloader can only flash around 100 MB
FLASHSIZE = "96"

DVBSKYPROVIDER = "kernel"

PREFERRED_VERSION_linux-gigablue = "${KERNELVERSION}"

IMAGE_FSTYPES ?= "ubi"
MKUBIFS_ARGS = "-m 2048 -e 126976 -c 4096"
UBINIZE_ARGS = "-m 2048 -p 128KiB"

MACHINE_ESSENTIAL_EXTRA_RDEPENDS += "\
	gigablue-dvb-modules-gb73625 \
	"

DVBMEDIASINK_CONFIG = "--with-wmv --with-wma --with-pcm --with-dts --with-eac3 --with-amr --with-h265 --with-vb6 --with-vb8 --with-spark"

GLIBC_EXTRA_OECONF = "--with-tls --with-__thread"

STB_PLATFORM = "gb73625"
```

## meta-gigablue/conf/machine/include/gigablue-mips.inc
```bitbake
require conf/machine/include/gigablue-oem.inc

MTD_KERNEL = "mtd2"
MTD_ROOTFS = "mtd0"
ROOTFS_FILE = "rootfs.bin"

TARGET_ARCH = "mipsel"
DEFAULTTUNE = "mips32el"
KERNEL_IMAGETYPE = "vmlinux"

PREFERRED_PROVIDER_virtual/blindscan-dvbc = "gigablue-blindscan-utils-mips"
PREFERRED_PROVIDER_virtual/blindscan-dvbs = "gigablue-blindscan-utils-mips"

IMAGE_CMD_ubifs_prepend = "\
	rm -rf ${IMAGE_ROOTFS}/boot/*; \
	rm -rf ${IMAGE_ROOTFS}/tmp/*; \
	"

IMAGE_CMD_ubi_append = " \
	mkdir -p ${DEPLOY_DIR_IMAGE}/${IMAGEDIR}; \
	${@bb.utils.contains("MACHINE_FEATURES", "gigabluelcd220", "cp -f ${DEPLOY_DIR_IMAGE}/lcdwarning220.bin ${DEPLOY_DIR_IMAGE}/${IMAGEDIR}/lcdwarning.bin;" , "", d)} \
	${@bb.utils.contains("MACHINE_FEATURES", "gigabluelcd220", "cp -f ${DEPLOY_DIR_IMAGE}/lcdwaitkey220.bin ${DEPLOY_DIR_IMAGE}/${IMAGEDIR}/lcdwaitkey.bin;" , "", d)} \
	${@bb.utils.contains("MACHINE_FEATURES", "gigabluelcd400", "cp -f ${DEPLOY_DIR_IMAGE}/lcdwarning400.bin ${DEPLOY_DIR_IMAGE}/${IMAGEDIR}/lcdwarning.bin;" , "", d)} \
	${@bb.utils.contains("MACHINE_FEATURES", "gigabluelcd400", "cp -f ${DEPLOY_DIR_IMAGE}/lcdwaitkey400.bin ${DEPLOY_DIR_IMAGE}/${IMAGEDIR}/lcdwaitkey.bin;" , "", d)} \
	cp -f ${DEPLOY_DIR_IMAGE}/warning.bin ${DEPLOY_DIR_IMAGE}/${IMAGEDIR}/warning.bin; \
	mv -f ${IMGDEPLOYDIR}/${IMAGE_NAME}${IMAGE_NAME_SUFFIX}.ubi ${DEPLOY_DIR_IMAGE}/${IMAGEDIR}/${ROOTFS_FILE}; \
	gzip -f -c ${DEPLOY_DIR_IMAGE}/vmlinux-${MACHINE}.bin > ${DEPLOY_DIR_IMAGE}/${IMAGEDIR}/${KERNEL_FILE}; \
	echo ${IMAGE_NAME} > ${DEPLOY_DIR_IMAGE}/${IMAGEDIR}/imageversion; \
	echo "https://forum.openvision.tech/app.php/donate" > ${DEPLOY_DIR_IMAGE}/${IMAGEDIR}/donate.txt; \
	echo "rename this file to 'force' to force an update without confirmation" > ${DEPLOY_DIR_IMAGE}/${IMAGEDIR}/noforce; \
	rm -f ${DEPLOY_DIR_IMAGE}/*.zip; \
	cd ${DEPLOY_DIR_IMAGE}; \
	zip -r ${IMAGE_NAME}_usb.zip gigablue/*; \
	rm -f ${DEPLOY_DIR_IMAGE}/*.ubi; \
	rm -f ${DEPLOY_DIR_IMAGE}/*.ubifs; \
	rm -rf ${DEPLOY_DIR_IMAGE}/gigablue; \
	"

IMAGE_CMD_jffs2_prepend = "\
	rm -rf ${IMAGE_ROOTFS}/boot/*; \
	rm -rf ${IMAGE_ROOTFS}/tmp/*; \
	"

IMAGE_CMD_jffs2_append = " ; \
	mkdir -p ${DEPLOY_DIR_IMAGE}/${IMAGEDIR}; \
	mv -f ${IMGDEPLOYDIR}/${IMAGE_NAME}${IMAGE_NAME_SUFFIX}.jffs2 ${DEPLOY_DIR_IMAGE}/${IMAGEDIR}/${ROOTFS_FILE}; \
	gzip -f -c ${DEPLOY_DIR_IMAGE}/vmlinux-${MACHINE}.bin > ${DEPLOY_DIR_IMAGE}/${IMAGEDIR}/${KERNEL_FILE}; \
	echo "rename this file to 'force' to force an update without confirmation" > ${DEPLOY_DIR_IMAGE}/${IMAGEDIR}/noforce; \
	echo ${IMAGE_NAME} > ${DEPLOY_DIR_IMAGE}/${IMAGEDIR}/imageversion; \
	echo "https://forum.openvision.tech/app.php/donate" > ${DEPLOY_DIR_IMAGE}/${IMAGEDIR}/donate.txt; \
	rm -f ${DEPLOY_DIR_IMAGE}/*.zip; \
	cd ${DEPLOY_DIR_IMAGE}; \
	zip -r ${IMAGE_NAME}_usb.zip gigablue/*; \
	zip ${IMAGE_NAME}_usb.zip burn.bat; \
	rm -f ${DEPLOY_DIR_IMAGE}/*.jffs2; \
	rm -rf ${DEPLOY_DIR_IMAGE}/gigablue; \
	"

require conf/machine/include/tune-mips32.inc
```

## meta-gigablue/conf/machine/include/gigablue-mv200.inc
```bitbake
require conf/machine/include/gigablue-oem.inc

KERNELVERSION = "4.4.35"

MTD_KERNEL = "mmcblk0p12"
MTD_ROOTFS = "mmcblk0p16"
MTD_BLACK  = "mmcblk0"

ROOTFS_FILE = "rootfs.tar.bz2"

DISTRO_FEATURES_remove += "x11 wayland"

SOC_FAMILY = "hisi3798mv200"
HICHIPSET = "3798mv200"
CHIPSET = "Hi3798Mv200"

MACHINE_ESSENTIAL_EXTRA_RDEPENDS += "\
	gigablue-dvb-modules-${MACHINE} \
	gigablue-loadmodules-gbmv200 \ 
	gigablue-libs-gbmv200 \
	gigablue-hihalt-gbmv200 \
	gigablue-reader-${MACHINE} \
	gigablue-partitions-${MACHINE} \
	gigablue-libreader-gbmv200 \
	gigablue-buildimage \
	e2fsprogs-resize2fs \
	gptfdisk \
	${@bb.utils.contains('MACHINE_FEATURES', 'emmc', 'partitions-by-name' , '', d)} \
	"

MACHINE_FEATURES += "switchoff 7segment hdmicec textlcd emmc mmc blindscan-dvbs alsa hisi multitranscoding AV_JACK vfdsymbol"

IMAGE_CLASSES  += "gigablue-emmc_image"
IMAGE_FSTYPES += "gigablueemmc"
IMAGE_ROOTFS_SIZE ?= "524288"

TARGET_ARCH = "arm"
DEFAULTTUNE = "cortexa15hf-neon-vfpv4"

PREFERRED_VERSION_linux-gigablue = "${KERNELVERSION}"
PREFERRED_PROVIDER_virtual/blindscan-dvbs = "gigablue-blindscan-gbmv200"
PREFERRED_RPROVIDER_showiframe = "gigablue-showiframe-gbmv200"
PREFERRED_RPROVIDER_aio-grab = "gigablue-grab-gbmv200"
PREFERRED_PROVIDER_virtual/enigma2-mediaservice = "enigma2-plugin-systemplugins-servicehisilicon"

require conf/machine/include/tune-cortexa15.inc

DVBSKYPROVIDER = "kernel"

DVBMEDIASINK_CONFIG = "--with-h265 --with-vb8 --with-vb9 --with-spark --with-wma --with-wmv --with-pcm --with-dts --with-eac3"

EXTRA_OECONF_append_pn-enigma2 = "--with-lcddev=/dev/null --with-alphablendingacceleration=always --with-blitaccelerationthreshold=250  --with-fillaccelerationthreshold=190000"

IMAGE_CMD_gigablueemmc_append = " \
	mkdir -p ${DEPLOY_DIR_IMAGE}/${IMAGEDIR}; \
	mv -f ${IMGDEPLOYDIR}/${IMAGE_NAME}${IMAGE_NAME_SUFFIX}.ext4 ${DEPLOY_DIR_IMAGE}/${MACHINE}-partitions/rootfs.ext4; \
	cd ${IMAGE_ROOTFS}; \
	tar -cvf ${DEPLOY_DIR_IMAGE}/rootfs.tar -C ${IMAGE_ROOTFS} .; \
	mv -f ${DEPLOY_DIR_IMAGE}/rootfs.tar ${DEPLOY_DIR_IMAGE}/${IMAGEDIR}/rootfs.tar; \
	bzip2 ${DEPLOY_DIR_IMAGE}/${IMAGEDIR}/rootfs.tar; \
	cp -f ${DEPLOY_DIR_IMAGE}/uImage ${DEPLOY_DIR_IMAGE}/${IMAGEDIR}/${KERNEL_FILE}; \
	cp -f ${DEPLOY_DIR_IMAGE}/uImage ${DEPLOY_DIR_IMAGE}/${MACHINE}-partitions/${KERNEL_FILE}; \
	echo ${IMAGE_NAME} > ${DEPLOY_DIR_IMAGE}/${IMAGEDIR}/imageversion; \
	echo "https://forum.openvision.tech/app.php/donate" > ${DEPLOY_DIR_IMAGE}/${IMAGEDIR}/donate.txt; \
	cd ${DEPLOY_DIR_IMAGE}/${MACHINE}-partitions; \
	mkupdate -s 00000003-00000001-01010101 -f ${DEPLOY_DIR_IMAGE}/${MACHINE}-partitions/emmc_partitions.xml -d ${DEPLOY_DIR_IMAGE}/usb_update.bin; \
	rm -f ${DEPLOY_DIR_IMAGE}/*.zip; \
	cd ${DEPLOY_DIR_IMAGE}; \
	cp -f ${IMGDEPLOYDIR}/${IMAGE_NAME}${IMAGE_NAME_SUFFIX}.manifest ${IMAGE_NAME}_usb.zip.manifest; \
	zip -j ${IMAGE_NAME}_recovery_emmc.zip ${DEPLOY_DIR_IMAGE}/usb_update.bin ${DEPLOY_DIR_IMAGE}/${IMAGEDIR}/imageversion ${DEPLOY_DIR_IMAGE}/${IMAGEDIR}/donate.txt ${DEPLOY_DIR_IMAGE}/${MACHINE}-partitions/bootargs.bin ${DEPLOY_DIR_IMAGE}/${MACHINE}-partitions/fastboot.bin ${DEPLOY_DIR_IMAGE}/${MACHINE}-partitions/apploader.bin; \
	zip ${IMAGE_NAME}_usb.zip ${IMAGEDIR}/*; \
	rm -f ${DEPLOY_DIR_IMAGE}/*.ext4; \
	rm -f ${DEPLOY_DIR_IMAGE}/usb_update.bin; \
	rm -Rf ${IMAGEDIR}; \
	rm -Rf gigablue; \
	rm -Rf userdata; \
	rm -Rf ${MACHINE}-partitions; \
	"

IMAGE_CMD_prepend = "\
	rm -Rf ${IMAGE_ROOTFS}/tmp/*; \
	rm -Rf ${DEPLOY_DIR_IMAGE}/userdata; \
	"

STB_PLATFORM = "gbmv200"

EXTRA_ALSA = "mv200"

RCNAME = "gb3"
```

## meta-gigablue/conf/machine/include/gigablue-oem.inc
```bitbake
# We know about rtc
MACHINE_FEATURES_BACKFILL_CONSIDERED += "rtc"

BOX_BRAND = "gigablue"

KERNEL_FILE = "kernel.bin"

MACHINE_ESSENTIAL_EXTRA_RDEPENDS += "\
	gigablue-ddbootup \
	kernel-module-rtl8192cu \
	firmware-rtl8192cu \
	firmware-rtl8192cufw \
	kernel-module-extrawlan-rtl8192eu \
	firmware-rtl8192eu \
	kernel-module-extrawlan-rt8812au \
	kernel-module-extrawlan-rt8822bu \
	gstreamer1.0-plugin-dvbmediasink \
	${@bb.utils.contains("MACHINE_FEATURES", "hisi", "" , "gigablue-cfe", d)} \
	"

DVBPROVIDER = "kernel"

PREFERRED_PROVIDER_virtual/kernel = "linux-gigablue"

KERNEL_OUTPUT = "${KERNEL_IMAGETYPE}"
KERNEL_CONSOLE = "ttyS0,115200n8"

MACHINE_FEATURES += "alsa hdmicec switchoff blindscan-tbs gigablue HDMI"

BOOTLOGO_FILENAME = "splash.bin"

require conf/machine/include/soc-family.inc

BLINDSCAN_BINARY = "gigablue_blindscan"

RCNAME ?= "gb0"
```

## meta-gigablue/conf/machine/include/gigablue.inc
```bitbake
# We know about rtc
MACHINE_FEATURES_BACKFILL_CONSIDERED += "rtc"

MACHINE_FEATURES += "alsa hdmicec switchoff gigablue blindscan-tbs HDMI"

BOX_BRAND = "gigablue"

BLINDSCAN_BINARY = "gigablue_blindscan"

RCNAME ?= "gb0"
```
