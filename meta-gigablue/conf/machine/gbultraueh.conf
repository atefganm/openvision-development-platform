## meta-ini/conf/machine/atemio5x00.conf
```bitbake
#
# This is config file for Atemio 5x00-HD
#

require conf/machine/include/inihde.inc

MACHINE_FEATURES += "textlcd vfdsymbol"

IMAGEDIR = "atemio/5x00"

MACHINE_ESSENTIAL_EXTRA_RDEPENDS += "\
	ini-dvb-modules-inihde \
	"
```

## meta-ini/conf/machine/atemio6000.conf
```bitbake
#
# This is config file for Atemio 6000-HD
#

require conf/machine/include/inihde2.inc

IMAGEDIR = "atemio/6000"

MACHINE_FEATURES += "blindscan-dvbs"

MACHINE_ESSENTIAL_EXTRA_RDEPENDS += "\
	ini-dvb-modules-inihde2am \
	"
```

## meta-ini/conf/machine/atemio6100.conf
```bitbake
#
# This is config file for Atemio 6100-HD
#

require conf/machine/include/inihde2.inc

IMAGEDIR = "atemio/6100"

MACHINE_FEATURES += "dvb-c"

MACHINE_ESSENTIAL_EXTRA_RDEPENDS += "\
	ini-dvb-modules-inihde2am \
	"
```

## meta-ini/conf/machine/atemio6200.conf
```bitbake
#
# This is config file for Atemio 6200-HD
#

require conf/machine/include/inihde2.inc

IMAGEDIR = "atemio/6200"

MACHINE_FEATURES += "dvb-c blindscan-dvbc blindscan-dvbs ci"

MACHINE_ESSENTIAL_EXTRA_RDEPENDS += "\
	ini-dvb-modules-inihde2am \
	"
```

## meta-ini/conf/machine/atemionemesis.conf
```bitbake
#
# This is config file for Atemio Nemesis
#

require conf/machine/include/inihdp.inc

IMAGEDIR = "atemio/8x00"

MACHINE_ESSENTIAL_EXTRA_RDEPENDS += "\
	ini-dvb-modules-ini-800 \
	kernel-module-extrawlan-rt8723bt \
	kernel-module-rtk-btusb \
	kernel-module-extrawlan-rt8723a \
	kernel-module-8723au \
	enigma2-plugin-systemplugins-simplefancontrol \
	"

MACHINE_FEATURES += "bluetooth"
```

## meta-ini/conf/machine/beyonwizt2.conf
```bitbake
#
# This is config file for Beyonwiz T2
#

require conf/machine/include/inihde2.inc

IMAGEDIR = "beyonwiz/hde2"

MACHINE_FEATURES += "dvb-c"

MACHINE_ESSENTIAL_EXTRA_RDEPENDS += "\
	ini-dvb-modules-inihde2au \
	"

RCNAME = "ini7"
```

## meta-ini/conf/machine/beyonwizt3.conf
```bitbake
#
# This is config file for Beyonwiz T3
#

require conf/machine/include/inihdx.inc

IMAGEDIR = "beyonwiz/hdx"

MACHINE_FEATURES += "vfdsymbol"

RCNAME = "ini5"
```

## meta-ini/conf/machine/beyonwizt4.conf
```bitbake
#
# This is config file for Beyonwiz T4
#

require conf/machine/include/inihdp.inc

IMAGEDIR = "beyonwiz/hdp"

MACHINE_ESSENTIAL_EXTRA_RDEPENDS += "\
	ini-dvb-modules-ini-840t4 \
	"

RCNAME = "ini7"
```

## meta-ini/conf/machine/bwidowx.conf
```bitbake
#
# This is config file for SPACE Black Widow-X
#

require conf/machine/include/inihde.inc

MACHINE_FEATURES += "7segment"

MACHINE_ESSENTIAL_EXTRA_RDEPENDS += "\
	ini-dvb-modules-yhgd2580-7358 \
	"

RCNAME = "ini6"
RCIDNUM = "1"
```
