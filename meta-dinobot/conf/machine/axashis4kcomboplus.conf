## meta-dinobot/conf/machine/axashis4kcomboplus.conf
```bitbake
#
# This is config file for AXAS HIS 4K Combo Plus
#

require conf/machine/include/u52.inc

IMAGEDIR = "axas/axascomboplus"

RCNAME = "axas1"
RCIDNUM = "1"
```

## meta-dinobot/conf/machine/axashisc4k.conf
```bitbake
#
# This is config file for AXAS HIS C 4K
#

require conf/machine/include/u56.inc

RCNAME = "axas2"
RCIDNUM = "1"
```

## meta-dinobot/conf/machine/axashistwin.conf
```bitbake
#
# This is config file for AXAS HIS Twin
#

require conf/machine/include/u41.inc

IMAGEDIR = "axas/axashistwin"

MTD_KERNEL = "mtd8"
MTD_ROOTFS = "mtd9"

RCNAME = "axas3"
RCIDNUM = "1"
```

## meta-dinobot/conf/machine/dinobot4k.conf
```bitbake
#
# This is config file for Vivant Dinobot 4K and Jepssen Mediabox 4K M7L
#

require conf/machine/include/u5.inc

MTD_KERNEL = "mmcblk0p10"
MTD_ROOTFS = "mmcblk1p1"

SDCARDIMG = "yes"

MACHINE_FEATURES += "dvb-c"
```

## meta-dinobot/conf/machine/dinobot4kl.conf
```bitbake
#
# This is config file for Vivant Dinobot 4K L
#

require conf/machine/include/u51.inc

SDCARDIMG = "yes"

MACHINE_FEATURES += "dvb-c"

IMAGEDIR = "dinobot/${MACHINETYPE}"
```

## meta-dinobot/conf/machine/dinobot4kmini.conf
```bitbake
#
# This is config file for Vivant Dinobot 4K Mini
#

require conf/machine/include/u53.inc
```

## meta-dinobot/conf/machine/dinobot4kplus.conf
```bitbake
#
# This is config file for Vivant Dinobot 4K Plus
#

require conf/machine/include/u52.inc

IMAGEDIR = "dinobot/${MACHINETYPE}"
```

## meta-dinobot/conf/machine/dinobot4kpro.conf
```bitbake
#
# This is config file for Vivant Dinobot 4K Pro
#

require conf/machine/include/u54.inc
```

## meta-dinobot/conf/machine/dinobot4kse.conf
```bitbake
#
# This is config file for Vivant Dinobot 4K SE and Ferguson U5 PVR
#

require conf/machine/include/u5pvr.inc
```

## meta-dinobot/conf/machine/dinoboth265.conf
```bitbake
#
# This is config file for Vivant Dinobot H265
#

require conf/machine/include/u41.inc

IMAGEDIR = "dinobot/${MACHINETYPE}"

MTD_KERNEL = "mtd8"
MTD_ROOTFS = "mtd9"
```

## meta-dinobot/conf/machine/dinobotu43.conf
```bitbake
#
# This is config file for Dinobot U43
#

require conf/machine/include/u43.inc

IMAGEDIR = "dinobot/${MACHINETYPE}"
```

## meta-dinobot/conf/machine/dinobotu55.conf
```bitbake
#
# This is config file for Vivant Dinobot U55
#

require conf/machine/include/u55.inc

IMAGEDIR = "dinobot/${MACHINETYPE}"
```

## meta-dinobot/conf/machine/include/dinobot-emmc.inc
```bitbake
KERNEL_FILE = "kernel.bin"
ROOTFS_FILE = "rootfs.tar.bz2"
MTD_BLACK  = "mmcblk0"

IMAGE_CLASSES  += "dinobot-emmc_image"
IMAGE_FSTYPES += "dinobotemmc"
IMAGE_ROOTFS_SIZE ?= "589824"

MACHINE_FEATURES += "emmc mmc"

IMAGE_CMD_dinobotemmc_append = " \
	mkdir -p ${DEPLOY_DIR_IMAGE}/${IMAGEDIR}; \
	if [ "${SDCARDIMG}" = "yes" ]; then \
		mv -f ${DEPLOY_DIR_IMAGE}/${IMAGE_NAME}.emmc.img ${DEPLOY_DIR_IMAGE}/${IMAGEDIR}/${IMAGE_NAME}.sdcard.img; \
	else \
		rm -f ${DEPLOY_DIR_IMAGE}/${IMAGE_NAME}.emmc.img; \
	fi; \
	cd ${IMAGE_ROOTFS}; \
	tar -cvf ${DEPLOY_DIR_IMAGE}/rootfs.tar -C ${IMAGE_ROOTFS} .; \
	mv -f ${DEPLOY_DIR_IMAGE}/rootfs.tar ${DEPLOY_DIR_IMAGE}/${IMAGEDIR}/rootfs.tar; \
	bzip2 ${DEPLOY_DIR_IMAGE}/${IMAGEDIR}/rootfs.tar; \
	cp -f ${DEPLOY_DIR_IMAGE}/uImage ${DEPLOY_DIR_IMAGE}/${IMAGEDIR}/${KERNEL_FILE}; \
	echo ${IMAGE_NAME} > ${DEPLOY_DIR_IMAGE}/${IMAGEDIR}/imageversion; \
	echo "https://forum.openvision.tech/app.php/donate" > ${DEPLOY_DIR_IMAGE}/${IMAGEDIR}/donate.txt; \
	rm -f ${DEPLOY_DIR_IMAGE}/*.zip; \
	cd ${DEPLOY_DIR_IMAGE}; \
	zip ${IMAGE_NAME}_usb.zip ${IMAGEDIR}/*; \
	rm -f ${DEPLOY_DIR_IMAGE}/*.ext4; \
	rm -Rf ${IMAGEDIR}; \
	"

IMAGE_CMD_prepend = "\
	rm -Rf ${IMAGE_ROOTFS}/tmp/*; \
	"

require conf/machine/include/dinobot-oem.inc
```

## meta-dinobot/conf/machine/include/dinobot-oem.inc
```bitbake
# We know about rtc
MACHINE_FEATURES_BACKFILL_CONSIDERED += "rtc"

KERNELVERSION = "4.4.35"

BOX_BRAND = "dinobot"

KERNEL_MODULE_AUTOLOAD += "\
	xhci-plat-hcd \
	ehci-platform \
	ohci-platform \
	cfg80211 \
	"

MACHINE_ESSENTIAL_EXTRA_RDEPENDS += "\
	kernel-module-xhci-plat-hcd \
	kernel-module-ehci-platform \
	kernel-module-ohci-platform \
	dinobot-pvr \
	dinobot-libs-${MACHINETYPE} \
	kernel-module-extrawlan-rtl8192eu \
	firmware-rtl8192eu \
	kernel-module-extrawlan-rt8822bu \
	kernel-module-extrawlan-rt8188fu \
	firmware-rt8188fu \
	${@bb.utils.contains('MACHINE_FEATURES', 'emmc', 'dinobot-resizerootfs' , '', d)} \
	dinobot-partitions-${SOC_FAMILY} \
	gstreamer1.0-plugin-dvbmediasink \
	dinobot-dvb-modules-${MACHINETYPE} \
	dinobot-libs-${MACHINETYPE} \
	dinobot-hihalt-${MACHINETYPE} \
	"

MACHINE_FEATURES += "videoenhancement switchoff hdmicec blindscan-tbs alsa multitranscoding hisil HDMI"

PREFERRED_PROVIDER_virtual/kernel = "linux-dinobot"
PREFERRED_PROVIDER_virtual/blindscan-dvbs = "dinobot-blindscan-${MACHINETYPE}"
PREFERRED_RPROVIDER_showiframe = "dinobot-showiframe-${MACHINETYPE}"
PREFERRED_RPROVIDER_aio-grab = "dinobot-grab-${MACHINETYPE}"
PREFERRED_VERSION_linux-dinobot = "${KERNELVERSION}"
PREFERRED_VERSION_directfb = "1.7.7"

DVBPROVIDER = "kernel"
DVBSKYPROVIDER = "kernel"

require conf/machine/include/soc-family.inc

DVBMEDIASINK_CONFIG = "--with-h265 --with-vb8 --with-vb9 --with-spark --with-wma --with-wmv --with-pcm --with-dts --with-eac3"

PREFERRED_PROVIDER_virtual/enigma2-mediaservice = "enigma2-plugin-systemplugins-servicehisilicon"

DEPENDS_append_pn-enigma2 = " dinobot-libs-${MACHINETYPE} "

BLINDSCAN_BINARY = "dinobot-blindscan"

RCNAME ?= "dinobot"
```

## meta-dinobot/conf/machine/include/dinobot-ubi.inc
```bitbake
KERNEL_FILE = "uImage"
ROOTFS_FILE = "rootfs.ubi"

IMAGE_FSTYPES += "ubi"
MKUBIFS_ARGS = "-F -m 2048 -e 126976 -c 3840"
UBINIZE_ARGS = "-m 2048 -p 128KiB"

IMAGE_CMD_ubi_append = " \
	mkdir -p ${DEPLOY_DIR_IMAGE}/${MACHINE}/${IMAGEDIR}; \
	mv -f ${IMGDEPLOYDIR}/${IMAGE_NAME}${IMAGE_NAME_SUFFIX}.ubi ${DEPLOY_DIR_IMAGE}/${MACHINE}/${IMAGEDIR}/${ROOTFS_FILE}; \
	cp -f ${DEPLOY_DIR_IMAGE}/uImage ${DEPLOY_DIR_IMAGE}/${MACHINE}/${IMAGEDIR}/${KERNEL_FILE}; \
	echo "${IMAGE_NAME}" > ${DEPLOY_DIR_IMAGE}/${MACHINE}/${IMAGEDIR}/imageversion; \
	echo "rename this file to 'force' to force an update without confirmation" > ${DEPLOY_DIR_IMAGE}/${MACHINE}/${IMAGEDIR}/noforce; \
	echo "https://forum.openvision.tech/app.php/donate" > ${DEPLOY_DIR_IMAGE}/${MACHINE}/${IMAGEDIR}/donate.txt; \
	rm -f ${DEPLOY_DIR_IMAGE}/*.zip; \
	cd ${DEPLOY_DIR_IMAGE}/${MACHINE}; \
	zip -r ../${IMAGE_NAME}_usb.zip *; \
	rm -f ${DEPLOY_DIR_IMAGE}/*.ubi; \
	rm -f ${DEPLOY_DIR_IMAGE}/*.ubifs; \
	cd ..; \
	rm -Rf ${DEPLOY_DIR_IMAGE}/${MACHINE}; \
	"

IMAGE_CMD_ubifs_prepend = " \
	rm -Rf ${IMAGE_ROOTFS}/tmp/*; \
	"

require conf/machine/include/dinobot-oem.inc
```

## meta-dinobot/conf/machine/include/u43.inc
```bitbake
EXTRA_OECONF_append_pn-enigma2 = "--with-lcddev=/dev/null --with-alphablendingacceleration=always"

SOC_FAMILY = "hisi3716mv410"
HICHIPSET = "3716mv410"
CHIPSET = "Hi3716Mv410"

KERNEL_MODULE_AUTOLOAD += "8192eu"

require conf/machine/include/dinobot-cortexa9.inc
require conf/machine/include/dinobot-ubi.inc

MACHINE_ESSENTIAL_EXTRA_RDEPENDS += "\
	dinobot-cpu-scaling \
	"

MACHINETYPE = "u43"

MTD_KERNEL = "mtd8"
MTD_ROOTFS = "mtd9"

SDCARD = "no"

MACHINE_FEATURES += "dvb-c 7segment hiaccel RCA"

STB_PLATFORM = "${MACHINETYPE}"

RCNAME = "turing"
```

## meta-dinobot/conf/machine/include/u51.inc
```bitbake
EXTRA_OECONF_append_pn-enigma2 = "--with-lcddev=/dev/null --with-alphablendingacceleration=always"

SOC_FAMILY = "hisi3798mv200"
HICHIPSET = "3798mv200"
CHIPSET = "Hi3798Mv200"

KERNEL_MODULE_AUTOLOAD += "8192eu"

require conf/machine/include/dinobot-cortexa15.inc
require conf/machine/include/dinobot-emmc.inc

MACHINETYPE = "u51"

MTD_KERNEL = "mmcblk0p9"
MTD_ROOTFS = "mmcblk0p10"

MACHINE_FEATURES += "7segment blindscan-dvbs textlcd hiaccel RCA"

STB_PLATFORM = "${MACHINETYPE}"

EXTRA_ALSA = "mv200"
```

## meta-dinobot/conf/machine/include/u53.inc
```bitbake
EXTRA_OECONF_append_pn-enigma2 = "--with-lcddev=/dev/null --with-alphablendingacceleration=always"

SOC_FAMILY = "hisi3798cv200"
HICHIPSET = "3798cv200"
CHIPSET = "Hi3798Cv200"

KERNEL_MODULE_AUTOLOAD += "88x2bu"

require conf/machine/include/dinobot-cortexa15.inc
require conf/machine/include/dinobot-emmc.inc

MACHINETYPE = "u53"

MTD_KERNEL = "mmcblk0p10"
MTD_ROOTFS = "mmcblk0p13"

SDCARDIMG = "no"

MACHINE_FEATURES += "7segment dvb-c blindscan-dvbs textlcd hiaccel"

IMAGEDIR = "dinobot/${MACHINETYPE}"

STB_PLATFORM = "${MACHINETYPE}"
```

## meta-dinobot/conf/machine/include/u532.inc
```bitbake
EXTRA_OECONF_append_pn-enigma2 = "--with-lcddev=/dev/null --with-alphablendingacceleration=always"

SOC_FAMILY = "hisi3798cv200"
HICHIPSET = "3798cv200"
CHIPSET = "Hi3798Cv200"

require conf/machine/include/dinobot-cortexa15.inc
require conf/machine/include/dinobot-emmc.inc

MACHINETYPE = "u532"

MTD_KERNEL = "mmcblk0p10"
MTD_ROOTFS = "mmcblk0p13"

SDCARDIMG = "no"

MACHINE_FEATURES += "7segment hiaccel"

IMAGEDIR = "e2/update"

STB_PLATFORM = "${MACHINETYPE}"
```

## meta-dinobot/conf/machine/include/u54.inc
```bitbake
EXTRA_OECONF_append_pn-enigma2 = "--with-lcddev=/dev/null --with-alphablendingacceleration=always"

SOC_FAMILY = "hisi3798mv200"
HICHIPSET = "3798mv200"
CHIPSET = "Hi3798Mv200"

KERNEL_MODULE_AUTOLOAD += "8192eu"

require conf/machine/include/dinobot-cortexa15.inc
require conf/machine/include/dinobot-emmc.inc

MACHINETYPE = "u54"

MTD_KERNEL = "mmcblk0p10"
MTD_ROOTFS = "mmcblk0p13"

SDCARDIMG = "no"

MACHINE_FEATURES += "7segment blindscan-dvbs textlcd hiaccel RCA"

IMAGEDIR = "dinobot/${MACHINETYPE}"

STB_PLATFORM = "${MACHINETYPE}"

EXTRA_ALSA = "mv200"
```

## meta-dinobot/conf/machine/include/u55.inc
```bitbake
EXTRA_OECONF_append_pn-enigma2 = "--with-lcddev=/dev/null --with-alphablendingacceleration=always"

SOC_FAMILY = "hisi3798mv200"
HICHIPSET = "3798mv200"
CHIPSET = "Hi3798Mv200"

KERNEL_MODULE_AUTOLOAD += "rt8188fu"

require conf/machine/include/dinobot-cortexa15.inc
require conf/machine/include/dinobot-ubi.inc

MACHINETYPE = "u55"

MTD_KERNEL = "mtd10"
MTD_ROOTFS = "mtd11"

SDCARDIMG = "no"

MACHINE_FEATURES += "7segment blindscan-dvbs textlcd hiaccel RCA"

STB_PLATFORM = "${MACHINETYPE}"

EXTRA_ALSA = "mv200"
```

## meta-dinobot/conf/machine/include/u56.inc
```bitbake
EXTRA_OECONF_append_pn-enigma2 = "--with-lcddev=/dev/null --with-alphablendingacceleration=always"

SOC_FAMILY = "hisi3798mv200"
HICHIPSET = "3798mv200"
CHIPSET = "Hi3798Mv200"

KERNEL_MODULE_AUTOLOAD += "8192eu"

require conf/machine/include/dinobot-cortexa15.inc
require conf/machine/include/dinobot-emmc.inc

MACHINETYPE = "u56"

MTD_KERNEL = "mmcblk0p9"
MTD_ROOTFS = "mmcblk0p10"

SDCARDIMG = "no"

MACHINE_FEATURES += "blindscan-dvbs 7segment textlcd hiaccel RCA"

IMAGEDIR = "axas/axasc4k"

STB_PLATFORM = "${MACHINETYPE}"

EXTRA_ALSA = "mv200"
```

## meta-dinobot/conf/machine/include/u57.inc
```bitbake
EXTRA_OECONF_append_pn-enigma2 = "--with-lcddev=/dev/null --with-alphablendingacceleration=always"

SOC_FAMILY = "hisi3798mv200"
HICHIPSET = "3798mv200"
CHIPSET = "Hi3798Mv200"

KERNEL_MODULE_AUTOLOAD += "rt8188fu"

require conf/machine/include/dinobot-cortexa15.inc
require conf/machine/include/dinobot-emmc.inc

MACHINETYPE = "u57"

SDCARDIMG = "no"

MACHINE_FEATURES += "blindscan-dvbs 7segment hiaccel RCA"

STB_PLATFORM = "${MACHINETYPE}"

EXTRA_ALSA = "mv200"
```

## meta-dinobot/conf/machine/include/u5pvr.inc
```bitbake
EXTRA_OECONF_append_pn-enigma2 = "--with-lcddev=/dev/null --with-alphablendingacceleration=always"

SOC_FAMILY = "hisi3798cv200"
HICHIPSET = "3798cv200"
CHIPSET = "Hi3798Cv200"

KERNEL_MODULE_AUTOLOAD += "\
	brcmutil \
	brcmfmac \
	"

require conf/machine/include/dinobot-cortexa15.inc
require conf/machine/include/dinobot-emmc.inc

MACHINE_ESSENTIAL_EXTRA_RDEPENDS += "\
	kernel-module-brcmutil \
	kernel-module-brcmfmac \
	"

MACHINETYPE = "u5pvr"

MTD_KERNEL = "mmcblk0p10"
MTD_ROOTFS = "mmcblk0p13"

SDCARDIMG = "no"

MACHINE_FEATURES += "7segment dvb-c textlcd RCA"

IMAGEDIR = "dinobot/${MACHINETYPE}"

STB_PLATFORM = "${MACHINETYPE}"
```

## meta-dinobot/conf/machine/iziboxelite4k.conf
```bitbake
#
# This is config file for IZIBox Elite 4K
#

require conf/machine/include/u57.inc

MTD_KERNEL = "mmcblk0p9"
MTD_ROOTFS = "mmcblk0p10"

IMAGEDIR = "izibox/${MACHINETYPE}"

RCNAME = "izibox2"
```
