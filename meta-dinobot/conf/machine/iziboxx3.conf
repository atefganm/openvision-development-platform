## meta-dinobot/conf/machine/iziboxx3.conf
```bitbake
#
# This is config file for IZIBox X3
#

require conf/machine/include/u55.inc

IMAGEDIR = "izibox/x3"

RCNAME = "izibox1"
RCIDNUM = "1"

MACHINE_FEATURES += "gbipboxclient"
```

## meta-dinobot/conf/machine/protek4kx1.conf
```bitbake
#
# This is config file for Protek 4K X1
#

require conf/machine/include/u41.inc

IMAGEDIR = "e2/update"

MTD_KERNEL = "mmcblk0p9"
MTD_ROOTFS = "mmcblk0p10"

RCNAME = "protek3"
RCIDNUM = "1"
```

## meta-dinobot/conf/machine/turing.conf
```bitbake
#
# This is config file for Atto.TV Turing
#

require conf/machine/include/u43.inc

IMAGEDIR = "atto/turing"
```

## meta-dinobot/conf/machine/viper4kv20.conf
```bitbake
#
# This is config file for Amiko Viper 4K V20
#

require conf/machine/include/u57.inc

MTD_KERNEL = "mmcblk0p9"
MTD_ROOTFS = "mmcblk0p10"

IMAGEDIR = "amiko/${MACHINETYPE}"

RCNAME = "amiko6"
```

## meta-dinobot/conf/machine/vipersingle.conf
```bitbake
#
# This is config file for Amiko Viper Single
#

require conf/machine/include/u57.inc

MTD_KERNEL = "mtd8"
MTD_ROOTFS = "mtd9"

IMAGEDIR = "amiko/${MACHINETYPE}"

RCNAME = "amiko6"
```

## meta-dreambox/conf/machine/dm8000.conf
```bitbake
#@TYPE: Machine
#@NAME: Dreambox DM8000
#@DESCRIPTION: Machine configuration for the Dreambox DM8000

KERNELVERSION = "3.2"

MACHINE_FEATURES += "pci dvb-c blindscan-dvbc frontprocessor ci dvd colorlcd128 grautec DVI SCART YUV RCA SVIDEO"

# Broken bootloader can only flash around 100 MB
FLASHSIZE = "96"

require conf/machine/include/dreambox-nand-256mb.inc
require conf/machine/include/dreambox-part-256mb.inc
require conf/machine/include/dreambox-ubi.inc
require conf/machine/include/dreambox-mips32el.inc

PREFERRED_VERSION_linux-dreambox = "${KERNELVERSION}"

SOC_FAMILY = "bcm7400"

MACHINE_ESSENTIAL_EXTRA_RDEPENDS += "\
	dm-bootsplash \
	dreambox-enigma2-config \
	enigma2-plugin-drivers-network-ath5k \
	"

RCNAME = "dmm0"
```

## meta-dreambox/conf/machine/include/dreambox-ubi.inc
```bitbake
inherit image_types_nfi

IMAGE_FSTYPES ?= "ubifs"
UBINIZE_VOLSIZE ?= "0"
UBINIZE_DATAVOL ?= "0"
```

## meta-dreambox/conf/machine/include/dreambox.inc
```bitbake
# dreambox.inc
# We know about rtc
MACHINE_FEATURES_BACKFILL_CONSIDERED += "rtc"

EXTRA_IMAGEDEPENDS += "dreambox-secondstage-${MACHINE}"

MACHINE_ESSENTIAL_EXTRA_RDEPENDS += "\
	dreambox-boot-progress \
	dreambox-dvb-modules-${MACHINE} \
	gstreamer1.0-plugin-dvbmediasink \
	${@bb.utils.contains_any("MACHINE", "dm8000 dm7020hd dm800sev2 dm500hdv2", "kernel-module-ecb", "", d)} \
	kernel-module-hmac \
	kernel-module-md4 \
	kernel-module-stv0299 \
	"

MACHINE_FEATURES += "alsa usbhost switchoff dreambox"

PREFERRED_PROVIDER_virtual/bootloader = "dreambox-secondstage-${MACHINE}"
PREFERRED_PROVIDER_virtual/kernel = "linux-dreambox"

PREFERRED_PROVIDER_virtual/blindscan-dvbs = "dreambox-blindscan-utils"
PREFERRED_PROVIDER_virtual/blindscan-dvbc = "dreambox-blindscan-utils"

KERNEL_IMAGETYPE = "vmlinux"
KERNEL_OUTPUT = "${KERNEL_IMAGETYPE}"
KERNEL_OUTPUT_DIR = "."
KERNEL_CONSOLE = "${@bb.utils.contains('MACHINE_FEATURES', 'usbconsole', 'ttyS0,115200', 'null', d)}"

DREAMBOX_BUILDIMAGE = "buildimage --arch ${MACHINE} ${EXTRA_BUILDCMD} \
	--erase-block-size ${DREAMBOX_ERASE_BLOCK_SIZE} \
	--flash-size ${DREAMBOX_FLASH_SIZE} \
	--sector-size ${DREAMBOX_SECTOR_SIZE}"
```

## meta-ebox/conf/layer.conf
```bitbake
# We have a conf and classes directory, append to BBPATH
BBPATH .= ":${LAYERDIR}"

# We have a recipes directory, add to BBFILES
BBFILES += "${LAYERDIR}/recipes-*/*.bb ${LAYERDIR}/recipes-*/*.bbappend \
            ${LAYERDIR}/recipes-*/*/*.bb ${LAYERDIR}/recipes-*/*/*.bbappend \
            ${LAYERDIR}/recipes-*/*/*/*.bb ${LAYERDIR}/recipes-*/*/*/*.bbappend"

METAEBOX_BASE := '${@os.path.normpath("${LAYERDIR}/../")}'
# Prevent current directory creeping into sstate objects. Otherwise, building
# in another TOPDIR will cause recipes using this variable to be rebuilt.
METAEBOX_BASE[vardepvalue] = 'meta-ebox'

# Additional license directories.
LICENSE_PATH += "${LAYERDIR}/conf/license"
```

## meta-ebox/conf/machine/ebox5000.conf
```bitbake
#
# This is config file for MixOS F5 and Galaxy Innovations 9196m
#

require conf/machine/include/ebox-oem.inc

IMAGEDIR = "ebox/7403"

MTD_KERNEL = "mtd1"
MTD_ROOTFS = "mtd2"

SOC_FAMILY = "bcm7403"

MACHINE_FEATURES += "textlcd SCART YUV vfdsymbol"
```

## meta-ebox/conf/machine/ebox5100.conf
```bitbake
#
# This is config file for MixOS F5 mini and Galaxy Innovations 9196 Lite
#

require conf/machine/include/ebox-oem.inc

IMAGEDIR = "ebox/7403"

MTD_KERNEL = "mtd1"
MTD_ROOTFS = "mtd2"

SOC_FAMILY = "bcm7403"

MACHINE_FEATURES += "textlcd"
```

## meta-ebox/conf/machine/ebox7358.conf
```bitbake
#
# This is config file for MixOS F7
#

require conf/machine/include/ebox-oem.inc

IMAGEDIR = "ebox/7358"

MTD_KERNEL = "mtd7"
MTD_ROOTFS = "mtd6"

SOC_FAMILY = "bcm7358"

MACHINE_FEATURES += "videoenhancement vfdsymbol"
```

## meta-ebox/conf/machine/eboxlumi.conf
```bitbake
#
# This is config file for MixOS Lumi
#

require conf/machine/include/ebox-oem.inc

IMAGEDIR = "ebox/7403"

MTD_KERNEL = "mtd1"
MTD_ROOTFS = "mtd2"

SOC_FAMILY = "bcm7403"

MACHINE_FEATURES += "vfdsymbol"
```

## meta-ebox/conf/machine/include/ebox-oem.inc
```bitbake
# We know about rtc
MACHINE_FEATURES_BACKFILL_CONSIDERED += "rtc"

KERNELVERSION = "3.12.4"

BOX_BRAND = "ebox"

KERNEL_FILE = "kernel_cfe_auto.bin"
ROOTFS_FILE = "root_cfe_auto.bin"

MACHINE_ESSENTIAL_EXTRA_RDEPENDS += "\
	ebox-dvb-modules-${MACHINE} \
	ebox-shutdown \
	gstreamer1.0-plugin-dvbmediasink \
	"

TARGET_ARCH = "mipsel"
DEFAULTTUNE = "mips32el"

GLIBC_EXTRA_OECONF = "--with-tls --with-__thread"
DVBMEDIASINK_CONFIG = "--with-wma --with-wmv --with-pcm --with-dts"

PREFERRED_PROVIDER_virtual/kernel = "linux-ebox"
PREFERRED_VERSION_linux-ebox = "${KERNELVERSION}"

KERNEL_IMAGETYPE = "vmlinux"
KERNEL_OUTPUT = "${KERNEL_IMAGETYPE}"
KERNEL_CONSOLE = "null"

IMAGE_FSTYPES ?= "ubi"

MKUBIFS_ARGS = "-m 2048 -e 126976 -c 1024 -F"
UBINIZE_ARGS = "-m 2048 -p 128KiB"

IMAGE_CMD_ubifs_prepend = "\
	rm -rf ${IMAGE_ROOTFS}/boot/*; \
	rm -rf ${IMAGE_ROOTFS}/tmp/*; \
	"

IMAGE_CMD_ubi_append = " \
	mkdir -p ${DEPLOY_DIR_IMAGE}/${IMAGEDIR}; \
	mv -f ${IMGDEPLOYDIR}/${IMAGE_NAME}${IMAGE_NAME_SUFFIX}.ubi ${DEPLOY_DIR_IMAGE}/${IMAGEDIR}/root_cfe_auto.bin; \
	gzip -9c ${DEPLOY_DIR_IMAGE}/vmlinux-${MACHINE}.bin > ${DEPLOY_DIR_IMAGE}/${IMAGEDIR}/kernel_cfe_auto.bin; \
	echo ${IMAGE_NAME} > ${DEPLOY_DIR_IMAGE}/${IMAGEDIR}/imageversion; \
	echo "https://forum.openvision.tech/app.php/donate" > ${DEPLOY_DIR_IMAGE}/${IMAGEDIR}/donate.txt; \
	rm -f ${DEPLOY_DIR_IMAGE}/*.zip; \
	cd ${DEPLOY_DIR_IMAGE}; \
	zip ${IMAGE_NAME}_usb.zip ${IMAGEDIR}/*; \
	rm -f ${DEPLOY_DIR_IMAGE}/*.ubi; \
	rm -f ${DEPLOY_DIR_IMAGE}/*.ubifs; \
	rm -Rf ${IMAGEDIR}; \
	"

MACHINE_FEATURES += "alsa dvbapi5 usbhost switchoff hdmicec blindscan-tbs HDMI RCA"

# Broken bootloader can only flash around 100 MB
FLASHSIZE = "96"

require conf/machine/include/tune-mips32.inc
require conf/machine/include/soc-family.inc

RCNAME = "ebox5000"
```

## meta-edision/conf/machine/include/edision-4k.inc
```bitbake
KERNELVERSION = "5.9"

SOC_FAMILY = "bcm72604"

BOX_BRAND = "edision"

# We know about rtc
MACHINE_FEATURES_BACKFILL_CONSIDERED += "rtc"

DEFAULTTUNE = "armv7vehf-neon-vfpv4"
KERNEL_IMAGETYPE = "zImage"

require conf/machine/include/arm/arch-armv8a.inc

MACHINE_ESSENTIAL_EXTRA_RDEPENDS += "\
	edision-dvb-modules-${MACHINE} \
	edision-resizerootfs \
	kernel-module-extrawlan-qca6174 \
	firmware-qca6174 \
	wireless-regdb-static \
	kernel-module-rt2800usb \
	${@bb.utils.contains('MACHINE_FEATURES', 'swap', 'edision-swapcreate', '',d)} \
	enigma2-plugin-drivers-dvb-usb-opticombo \
	gstreamer1.0-plugin-dvbmediasink \
	edision-splash \
	"

DVBMEDIASINK_CONFIG = "--with-wma --with-pcm --with-dtsdownmix --with-eac3 --with-h265 --with-vb9"

PREFERRED_PROVIDER_virtual/blindscan-dvbs = "edision-blindscan-utils-${MACHINE}"
PREFERRED_PROVIDER_virtual/blindscan-dvbc = "edision-blindscan-utils-${MACHINE}"

PREFERRED_PROVIDER_virtual/kernel = "linux-edision"
PREFERRED_VERSION_linux-edision = "${KERNELVERSION}"

MTD_BOOTFS = "mmcblk1p1"
MTD_BLACK  = "mmcblk1"
MTD_KERNEL = "mmcblk1p2"
MTD_ROOTFS = "mmcblk1p3"
KERNEL_FILE = "kernel.bin"
ROOTFS_FILE = "rootfs.tar.bz2"

KERNEL_CONSOLE = "ttyS0,115200n8"

MACHINE_FEATURES += "alsa switchoff hdmicec osdposition dvb-c blindscan-tbs blindscan-dvbs blindscan-dvbc satip mountboot videoenhancement mmc emmc swap HDMI"

require conf/machine/include/rootfs-emmc.inc

STB_PLATFORM = "edision4k"

RCNAME = "edision3"
```

## meta-edision/conf/machine/include/edision-mipsel.inc
```bitbake
TARGET_ARCH = "mipsel"
DEFAULTTUNE = "mips32el"

require conf/machine/include/tune-mips32.inc

# We know about rtc
MACHINE_FEATURES_BACKFILL_CONSIDERED += "rtc"

BOX_BRAND = "edision"

MACHINE_ESSENTIAL_EXTRA_RDEPENDS += "\
	os-dvb-modules-${MACHINE} \
	kernel-module-extrawlan-rt8723bs \
	firmware-rtl8723bs \
	kernel-module-hci-uart \
	kernel-module-rt2800usb \
	enigma2-plugin-drivers-dvb-usb-opticombo \
	gstreamer1.0-plugin-dvbmediasink \
	edision-splash \
	"

DVBMEDIASINK_CONFIG = "--with-wma --with-wmv --with-pcm --with-dts --with-eac3"

PREFERRED_PROVIDER_virtual/kernel = "linux-os"

KERNEL_IMAGETYPE = "vmlinux.gz"
KERNEL_CONSOLE = "ttyS0,115200n8"

KERNEL_MODULE_AUTOLOAD += "\
	r8723bs \
	hci_uart \
	"

MACHINE_FEATURES += "alsa switchoff osdposition hdmicec dvb-c videoenhancement HDMI"

require conf/machine/include/rootfs-ubi.inc

KERNEL_FILE = "kernel.bin"
ROOTFS_FILE = "rootfs.bin"

STB_PLATFORM = "edisionmips"
```

## meta-edision/conf/machine/include/rootfs-emmc.inc
```bitbake
IMAGE_CLASSES += "edision4k-emmcimg"
IMAGE_FSTYPES ?= "emmcimg tar.bz2"
IMAGE_OVERHEAD_FACTOR = "1.0"

IMAGE_CMD_emmcimg_append = " \
	mkdir -p ${IMGDEPLOYDIR}/${IMAGEDIR}; \
	cp -f ${IMGDEPLOYDIR}/${IMAGE_NAME}${IMAGE_NAME_SUFFIX}.emmc ${IMGDEPLOYDIR}/${IMAGEDIR}/emmc.img; \
	cp -f ${DEPLOY_DIR_IMAGE}/${KERNEL_IMAGETYPE}-${MACHINE}.bin ${IMGDEPLOYDIR}/${IMAGEDIR}/${KERNEL_FILE}; \
	cp -f ${IMGDEPLOYDIR}/${IMAGE_NAME}${IMAGE_NAME_SUFFIX}.tar.bz2 ${IMGDEPLOYDIR}/${IMAGEDIR}/${ROOTFS_FILE}; \
	cp -f ${DEPLOY_DIR_IMAGE}/splash.bin ${IMGDEPLOYDIR}/${IMAGEDIR}; \
	echo "${IMAGE_NAME}" > ${IMGDEPLOYDIR}/${IMAGEDIR}/imageversion; \
	echo "https://forum.openvision.tech/app.php/donate" > ${IMGDEPLOYDIR}/${IMAGEDIR}/donate.txt; \
	echo "rename this file to 'force' to force an update without confirmation" > ${IMGDEPLOYDIR}/${IMAGEDIR}/noforce; \
	echo "***** ATTENTION *****" >${IMGDEPLOYDIR}/${IMAGEDIR}/recovery_${MACHINE}_READ.ME; \
	echo "The RECOVERY is only required for new installation of the ${MACHINE}" >>${IMGDEPLOYDIR}/${IMAGEDIR}/recovery_${MACHINE}_READ.ME; \
	echo "The ${IMAGE_NAME}_recovery_emmc.zip deletes all images including the multiboot images" >>${IMGDEPLOYDIR}/${IMAGEDIR}/recovery_${MACHINE}_READ.ME; \
	rm -f ${IMGDEPLOYDIR}/*.zip; \
	cd ${IMGDEPLOYDIR}; \
	zip -j ${IMAGE_NAME}_recovery_emmc.zip ${IMAGEDIR}/emmc.img ${IMAGEDIR}/imageversion ${IMAGEDIR}/donate.txt ${IMAGEDIR}/recovery_${MACHINE}_READ.ME ${IMAGEDIR}/noforce ${IMAGEDIR}/splash.bin ; \
	zip -j ${IMAGE_NAME}_usb.zip ${IMAGEDIR}/imageversion ${IMAGEDIR}/donate.txt ${IMAGEDIR}/${KERNEL_FILE} ${IMAGEDIR}/${ROOTFS_FILE}; \
	rm -f ${DEPLOY_DIR_IMAGE}/*.ext4; \
	rm -rf ${IMAGEDIR}; \
	"

IMAGE_CMD_prepend = "\
	rm -Rf ${IMAGE_ROOTFS}/tmp/*; \
	"
```

## meta-edision/conf/machine/include/rootfs-ubi.inc
```bitbake
IMAGE_FSTYPES ?= "ubi"
MKUBIFS_ARGS = "-m 2048 -e 126976 -c 4096 -F"
UBINIZE_ARGS = "-m 2048 -p 128KiB"

IMAGE_CMD_ubifs_prepend = " \
	rm -rf ${IMAGE_ROOTFS}/boot/*; \
	rm -rf ${IMAGE_ROOTFS}/tmp/*; \
	"

IMAGE_CMD_ubi_append = " \
	mkdir -p ${IMGDEPLOYDIR}/${IMAGEDIR}; \
	cp -f ${IMGDEPLOYDIR}/${IMAGE_NAME}${IMAGE_NAME_SUFFIX}.ubi ${IMGDEPLOYDIR}/${IMAGEDIR}/${ROOTFS_FILE}; \
	cp -f ${DEPLOY_DIR_IMAGE}/${KERNEL_IMAGETYPE}-${MACHINE}.bin ${IMGDEPLOYDIR}/${IMAGEDIR}/${KERNEL_FILE}; \
	cp -f ${DEPLOY_DIR_IMAGE}/splash.bin ${IMGDEPLOYDIR}/${IMAGEDIR}; \
	echo "${IMAGE_NAME}" > ${IMGDEPLOYDIR}/${IMAGEDIR}/imageversion; \
	echo "https://forum.openvision.tech/app.php/donate" > ${IMGDEPLOYDIR}/${IMAGEDIR}/donate.txt; \
	echo "rename this file to 'force' to force an update without confirmation" > ${IMGDEPLOYDIR}/${IMAGEDIR}/noforce; \
	rm -f ${IMGDEPLOYDIR}/*.zip; \
	cd ${IMGDEPLOYDIR}; \
	zip ${IMAGE_NAME}_usb.zip ${IMAGEDIR}/*; \
	rm -f ${DEPLOY_DIR_IMAGE}/*.ubi; \
	rm -f ${DEPLOY_DIR_IMAGE}/*.ubifs; \
	rm -rf ${IMAGEDIR}; \
	"
```

## meta-edision/conf/machine/osmega.conf
```bitbake
#@TYPE: Machine
#@NAME: Edision OS mega
#@DESCRIPTION: Machine configuration for the Edision OS mega

KERNELVERSION = "4.11"

SOC_FAMILY = "bcm73565"

require conf/machine/include/edision-mipsel.inc

DVBMEDIASINK_CONFIG += "--with-h265"

PREFERRED_PROVIDER_virtual/blindscan-dvbs = "os-blindscan-utils"
PREFERRED_PROVIDER_virtual/blindscan-dvbc = "os-blindscan-utils"

PREFERRED_VERSION_linux-os = "${KERNELVERSION}"

MTD_KERNEL = "mtd0"
MTD_ROOTFS = "mtd2"

MACHINE_FEATURES += "textlcd blindscan-dvbs blindscan-dvbc ci vfdsymbol"

RCNAME = "xcore3"
```

## meta-edision/conf/machine/osmini.conf
```bitbake
#@TYPE: Machine
#@NAME: Edision OS mini
#@DESCRIPTION: Machine configuration for the Edision OS mini

KERNELVERSION = "4.11"

SOC_FAMILY = "bcm7362"

require conf/machine/include/edision-mipsel.inc

PREFERRED_PROVIDER_virtual/blindscan-dvbs = "os-blindscan-utils"
PREFERRED_PROVIDER_virtual/blindscan-dvbc = "os-blindscan-utils"

PREFERRED_VERSION_linux-os = "${KERNELVERSION}"

MTD_KERNEL = "mtd0"
MTD_ROOTFS = "mtd2"

MACHINE_FEATURES += "7segment blindscan-dvbs blindscan-dvbc"

RCNAME = "xcore3"
```

## meta-edision/conf/machine/osmini4k.conf
```bitbake
#@TYPE: Machine
#@NAME: Edision OS mini 4K
#@DESCRIPTION: Machine configuration for the Edision OS mini 4K

require conf/machine/include/edision-4k.inc

MACHINE_FEATURES += "textlcd 7segment"
```

## meta-edision/conf/machine/osminiplus.conf
```bitbake
#@TYPE: Machine
#@NAME: Edision OS mini+
#@DESCRIPTION: Machine configuration for the Edision OS mini+

KERNELVERSION = "4.11"

SOC_FAMILY = "bcm73625"

require conf/machine/include/edision-mipsel.inc

DVBMEDIASINK_CONFIG += "--with-h265"

PREFERRED_PROVIDER_virtual/blindscan-dvbs = "os-blindscan-utils"
PREFERRED_PROVIDER_virtual/blindscan-dvbc = "os-blindscan-utils"

PREFERRED_VERSION_linux-os = "${KERNELVERSION}"

MTD_KERNEL = "mtd0"
MTD_ROOTFS = "mtd2"

MACHINE_FEATURES += "blindscan-dvbs blindscan-dvbc textlcd vfdsymbol"

RCNAME = "xcore3"
```

## meta-edision/conf/machine/osmio4k.conf
```bitbake
#@TYPE: Machine
#@NAME: Edision OS mio 4K
#@DESCRIPTION: Machine configuration for the Edision OS mio 4K

require conf/machine/include/edision-4k.inc

MACHINE_FEATURES += "textlcd 7segment"

MACHINE_ESSENTIAL_EXTRA_RDEPENDS += "\
	kernel-module-hci-uart \
	kernel-module-btqca \
	"

KERNEL_MODULE_AUTOLOAD += "\
	wlan \
	hci_uart \
	"

PACKAGECONFIG_ffmpeg_append = " libv4l2"
```

## meta-edision/conf/machine/osmio4kplus.conf
```bitbake
#@TYPE: Machine
#@NAME: Edision OS mio 4K plus
#@DESCRIPTION: Machine configuration for the Edision OS mio 4K plus

require conf/machine/include/edision-4k.inc

MACHINE_FEATURES += "bwlcd128 bluetooth"

MACHINE_ESSENTIAL_EXTRA_RDEPENDS += "\
	kernel-module-hci-uart \
	kernel-module-btqca \
	"

KERNEL_MODULE_AUTOLOAD += "\
	wlan \
	hci_uart \
	"

PACKAGECONFIG_ffmpeg_append = " libv4l2"
```

## meta-edision/conf/machine/osnino.conf
```bitbake
#@TYPE: Machine
#@NAME: Edision OS nino
#@DESCRIPTION: Machine configuration for the Edision OS nino

KERNELVERSION = "4.8.17"

SOC_FAMILY = "bcm7362"

require conf/machine/include/edision-mipsel.inc

PREFERRED_VERSION_linux-os = "${KERNELVERSION}"

MTD_KERNEL = "mtd2"
MTD_ROOTFS = "mtd0"

MACHINE_FEATURES += "textlcd 7segment vfdsymbol"

RCNAME = "edision1"
```
