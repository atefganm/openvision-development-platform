## meta-edision/conf/machine/osninoplus.conf
```bitbake
#@TYPE: Machine
#@NAME: Edision OS nino+
#@DESCRIPTION: Machine configuration for the Edision OS nino+

KERNELVERSION = "4.8.17"

SOC_FAMILY = "bcm73625"

require conf/machine/include/edision-mipsel.inc

DVBMEDIASINK_CONFIG += "--with-h265"

#PREFERRED_PROVIDER_virtual/blindscan-dvbs = "os-blindscan-utils"
#PREFERRED_PROVIDER_virtual/blindscan-dvbc = "os-blindscan-utils"

PREFERRED_VERSION_linux-os = "${KERNELVERSION}"

MTD_KERNEL = "mtd2"
MTD_ROOTFS = "mtd0"

MACHINE_FEATURES += "textlcd 7segment vfdsymbol"

RCNAME = "edision2"
```

## meta-edision/conf/machine/osninopro.conf
```bitbake
#@TYPE: Machine
#@NAME: Edision OS nino pro
#@DESCRIPTION: Machine configuration for the Edision OS nino pro

KERNELVERSION = "4.8.17"

SOC_FAMILY = "bcm73625"

require conf/machine/include/edision-mipsel.inc

DVBMEDIASINK_CONFIG += "--with-h265"

PREFERRED_PROVIDER_virtual/blindscan-dvbs = "edision-blindscan-utils-${MACHINE}"
PREFERRED_PROVIDER_virtual/blindscan-dvbc = "edision-blindscan-utils-${MACHINE}"

PREFERRED_VERSION_linux-os = "${KERNELVERSION}"

MTD_KERNEL = "mtd2"
MTD_ROOTFS = "mtd0"

MACHINE_FEATURES += "textlcd 7segment blindscan-dvbs blindscan-dvbc vfdsymbol"

RCNAME = "edision2"
```

## meta-entwopia/conf/machine/bre2ze.conf
```bitbake
#
# This is config file for WWIO BRE2ZE
#

KERNELVERSION = "3.14.2"

MACHINE_ESSENTIAL_EXTRA_RDEPENDS += "\
	entwopia-dvb-modules-ew7362 \
	kernel-module-extrawlan-mt7601u \
	firmware-mt7601u \
	"

SOC_FAMILY = "bcm7362"

MACHINE_FEATURES += "ci 7segment textlcd satip"

PREFERRED_VERSION_linux-entwopia = "${KERNELVERSION}"

require conf/machine/include/entwopia-oem.inc

DVBMEDIASINK_CONFIG = "--with-wma --with-wmv --with-pcm --with-dts --with-eac3"

RCNAME = "wwio1"
```

## meta-entwopia/conf/machine/enfinity.conf
```bitbake
#
# This is config file for EVO ENfinity
#

require conf/machine/include/ew7358.inc

RCNAME = "evo1"
```

## meta-entwopia/conf/machine/evomini.conf
```bitbake
#
# This is config file for EVO ENfinity mini
#

KERNELVERSION = "3.14.2"

IMAGEDIR = "mini"

MACHINE_ESSENTIAL_EXTRA_RDEPENDS += "\
	entwopia-dvb-modules-ch62lc \
	"

SOC_FAMILY = "bcm7362"

PREFERRED_VERSION_linux-entwopia = "${KERNELVERSION}"

require conf/machine/include/entwopia-oem.inc

DVBMEDIASINK_CONFIG = "--with-wma --with-wmv --with-pcm --with-dts --with-eac3"

MACHINE_FEATURES += "AV_JACK"

RCNAME = "evo5"
```

## meta-entwopia/conf/machine/evominiplus.conf
```bitbake
#
# This is config file for EVO ENfinity mini+
#

KERNELVERSION = "4.10.6"

IMAGEDIR = "miniplus"

MACHINE_ESSENTIAL_EXTRA_RDEPENDS += "\
	entwopia-dvb-modules-ch625lc \
	"

SOC_FAMILY = "bcm73625"

MACHINE_FEATURES += "ci 7segment textlcd AV_JACK"

PREFERRED_VERSION_linux-entwopia = "${KERNELVERSION}"

require conf/machine/include/entwopia-oem.inc

DVBSKYPROVIDER = "kernel"

DVBMEDIASINK_CONFIG = "--with-wma --with-wmv --with-pcm --with-dts --with-eac3 --with-h265 --with-vb6 --with-vb8 --with-spark"

RCNAME = "evo5"
```

## meta-entwopia/conf/machine/include/entwopia-oem.inc
```bitbake
# We know about rtc
MACHINE_FEATURES_BACKFILL_CONSIDERED += "rtc"

BOX_BRAND = "entwopia"

MTD_KERNEL = "mtd2"
MTD_ROOTFS = "mtd0"

KERNEL_FILE = "kernel.bin"
ROOTFS_FILE = "rootfs.bin"

DVBPROVIDER = "kernel"

MACHINE_ESSENTIAL_EXTRA_RDEPENDS += "\
	gstreamer1.0-plugin-dvbmediasink \
	"

TARGET_ARCH = "mipsel"
DEFAULTTUNE = "mips32el"

GLIBC_EXTRA_OECONF = "--with-tls --with-__thread"

PREFERRED_PROVIDER_virtual/kernel = "linux-entwopia"

KERNEL_IMAGETYPE = "vmlinux"
KERNEL_OUTPUT = "${KERNEL_IMAGETYPE}"
KERNEL_CONSOLE = "ttyS0,115200n8"

IMAGE_FSTYPES ?= "ubi"

MKUBIFS_ARGS = "-m 2048 -e 126976 -c 4096"
UBINIZE_ARGS = "-m 2048 -p 128KiB"

IMAGE_CMD_ubifs_prepend = "\
	rm -rf ${IMAGE_ROOTFS}/boot/*; \
	rm -rf ${IMAGE_ROOTFS}/tmp/*; \
	"

IMAGE_CMD_ubi_append = " \
	mkdir -p ${DEPLOY_DIR_IMAGE}/${IMAGEDIR}; \
	mv -f ${IMGDEPLOYDIR}/${IMAGE_NAME}${IMAGE_NAME_SUFFIX}.ubi ${DEPLOY_DIR_IMAGE}/${IMAGEDIR}/${ROOTFS_FILE}; \
	gzip -9c ${DEPLOY_DIR_IMAGE}/vmlinux-${MACHINE}.bin > ${DEPLOY_DIR_IMAGE}/${IMAGEDIR}/${KERNEL_FILE}; \
	echo ${IMAGE_NAME} > ${DEPLOY_DIR_IMAGE}/${IMAGEDIR}/imageversion; \
	echo "https://forum.openvision.tech/app.php/donate" > ${DEPLOY_DIR_IMAGE}/${IMAGEDIR}/donate.txt; \
	if [ "${FORCE}" = "yes" ]; then \
		echo "rename this file to 'noforce' to force an update with confirmation" > ${DEPLOY_DIR_IMAGE}/${IMAGEDIR}/force; \
	else \
		echo "rename this file to 'force' to force an update without confirmation" > ${DEPLOY_DIR_IMAGE}/${IMAGEDIR}/noforce; \
	fi; \
	rm -f ${DEPLOY_DIR_IMAGE}/*.zip; \
	cd ${DEPLOY_DIR_IMAGE}; \
	zip ${IMAGE_NAME}_usb.zip ${IMAGEDIR}/*; \
	rm -f ${DEPLOY_DIR_IMAGE}/*.ubi; \
	rm -f ${DEPLOY_DIR_IMAGE}/*.ubifs; \
	rm -Rf ${IMAGEDIR}; \
	"


MACHINE_FEATURES += "alsa hdmicec switchoff blindscan-tbs videoenhancement HDMI"

# Broken bootloader can only flash around 100 MB
FLASHSIZE = "96"

BOOTLOGO_FILENAME = "splash.bin"

require conf/machine/include/tune-mips32.inc
require conf/machine/include/soc-family.inc
```

## meta-entwopia/conf/machine/include/ew7358.inc
```bitbake
require conf/machine/include/entwopia-oem.inc

KERNELVERSION = "3.14.2"

MACHINE_ESSENTIAL_EXTRA_RDEPENDS += "\
	entwopia-dvb-modules-ew7358 \
	"

SOC_FAMILY = "bcm7358"

MACHINE_FEATURES += "7segment textlcd RCA YUV"

PREFERRED_VERSION_linux-entwopia = "${KERNELVERSION}"

DVBMEDIASINK_CONFIG = "--with-wma --with-wmv --with-pcm --with-dts --with-eac3"

STB_PLATFORM = "ew7358"
```

## meta-entwopia/conf/machine/marvel1.conf
```bitbake
#
# This is config file for VisionNet Marvel 1
#

require conf/machine/include/ew7358.inc

RCNAME = "visionnet"
```

## meta-entwopia/conf/machine/x2plus.conf
```bitbake
#
# This is config file for EVO enfinityX 2plus
#

KERNELVERSION = "3.14.2"

MACHINE_ESSENTIAL_EXTRA_RDEPENDS += "\
	entwopia-dvb-modules-ew7356 \
	"

SOC_FAMILY = "bcm7356"

MACHINE_FEATURES += "textlcd multitranscoding RCA YUV"

PREFERRED_VERSION_linux-entwopia = "${KERNELVERSION}"

require conf/machine/include/entwopia-oem.inc

DVBMEDIASINK_CONFIG = "--with-wma --with-wmv --with-pcm --with-dts --with-eac3"

RCNAME = "evo2"
```

## meta-formuler/conf/machine/formuler1.conf
```bitbake
#@TYPE: Machine
#@NAME: formuler f1
#@DESCRIPTION: Machine configuration for the formuler f1

MACHINE_FEATURES += "dvb-c YUV RCA"

SOC_FAMILY = "bcm7356"

require conf/machine/include/formuler.inc
```

## meta-formuler/conf/machine/formuler3.conf
```bitbake
#@TYPE: Machine
#@NAME: formuler f3
#@DESCRIPTION: Machine configuration for the formuler f3

MACHINE_FEATURES += "7segment"

SOC_FAMILY = "bcm7362"

require conf/machine/include/formuler.inc
```

## meta-formuler/conf/machine/formuler4.conf
```bitbake
#@TYPE: Machine
#@NAME: formuler f4
#@DESCRIPTION: Machine configuration for the formuler f4

MACHINE_FEATURES += "7segment AV_JACK"

SOC_FAMILY = "bcm7362"

require conf/machine/include/formuler.inc
```

## meta-formuler/conf/machine/formuler4turbo.conf
```bitbake
#@TYPE: Machine
#@NAME: formuler f4turbo
#@DESCRIPTION: Machine configuration for the formuler f4turbo

MACHINE_FEATURES += "7segment dvb-c AV_JACK"

DVBMEDIASINK_CONFIG_append = " --with-h265 --with-vb6 --with-vb8 --with-spark"

SOC_FAMILY = "bcm73625"

require conf/machine/include/formuler.inc
```

## meta-formuler/conf/machine/include/formuler.inc
```bitbake
# We know about rtc
MACHINE_FEATURES_BACKFILL_CONSIDERED += "rtc" 

KERNELVERSION = "4.10.6"

MACHINE_ESSENTIAL_EXTRA_RDEPENDS += "\
	formuler-dvb-modules-${MACHINE} \
	gstreamer1.0-plugin-dvbmediasink \
	"

DVBMEDIASINK_CONFIG = "--with-wma --with-wmv --with-pcm --with-dts --with-eac3"

TARGET_ARCH = "mipsel"
DEFAULTTUNE = "mips32el"

PREFERRED_PROVIDER_virtual/kernel = "linux-formuler"
PREFERRED_VERSION_linux-formuler = "${KERNELVERSION}"

KERNEL_IMAGETYPE = "vmlinux"
KERNEL_OUTPUT = "${KERNEL_IMAGETYPE}"
KERNEL_CONSOLE = "null"

IMAGE_FSTYPES ?= "ubi"

MTD_KERNEL = "mtd1"
MTD_ROOTFS = "mtd2"
KERNEL_FILE = "kernel.bin"
ROOTFS_FILE = "rootfs.bin"

IMAGE_CMD_ubi_append = " \
	mkdir -p ${IMGDEPLOYDIR}/${IMAGEDIR}; \
	cp -f ${IMGDEPLOYDIR}/${IMAGE_NAME}${IMAGE_NAME_SUFFIX}.ubi ${IMGDEPLOYDIR}/${IMAGEDIR}/${ROOTFS_FILE}; \
	gzip -9c ${DEPLOY_DIR_IMAGE}/vmlinux-${MACHINE}.bin > ${IMGDEPLOYDIR}/${IMAGEDIR}/${KERNEL_FILE}; \
	echo "${IMAGE_NAME}" > ${IMGDEPLOYDIR}/${IMAGEDIR}/imageversion; \
	echo "https://forum.openvision.tech/app.php/donate" > ${IMGDEPLOYDIR}/${IMAGEDIR}/donate.txt; \
	echo "rename this file to 'force' to force an update without confirmation" > ${IMGDEPLOYDIR}/${IMAGEDIR}/noforce; \
	rm -f ${IMGDEPLOYDIR}/*.zip; \
	cd ${IMGDEPLOYDIR}; \
	zip ${IMAGE_NAME}_usb.zip ${IMAGEDIR}/*; \
	rm -f ${DEPLOY_DIR_IMAGE}/*.ubi; \
	rm -f ${DEPLOY_DIR_IMAGE}/*.ubifs; \
	rm -Rf ${IMAGEDIR}; \
	"

IMAGE_CMD_ubifs_prepend = " \
	rm -Rf ${IMAGE_ROOTFS}/boot/*; \
	rm -Rf ${IMAGE_ROOTFS}/tmp/*; \
	"

MACHINE_FEATURES += "alsa usbhost switchoff osdposition hdmicec ci textlcd blindscan-tbs videoenhancement HDMI"

require conf/machine/include/tune-mips32.inc

MKUBIFS_ARGS = "-m 2048 -e 126976 -c 8192"
UBINIZE_ARGS = "-m 2048 -p 128KiB"

RCTYPE = "18"
RCNAME = "formuler1"

BOX_BRAND = "formuler"
```

## meta-gigablue/conf/machine/gb800ueplus.conf
```bitbake
#@TYPE: Machine
#@NAME: GigaBlue 800 UE Plus
#@DESCRIPTION: Machine configuration for GigaBlue 800 UE Plus

IMAGEDIR = "gigablue/ueplus"

require conf/machine/include/gigablue-gb7358.inc

MACHINE_FEATURES += "colorlcd220 gigabluelcd blindscan-dvbc ci gigabluelcd220 blindscan-dvbs YUV RCA"
```

## meta-gigablue/conf/machine/gbip4k.conf
```bitbake
#@TYPE: Machine
#@NAME: GigaBlue IP 4K
#@DESCRIPTION: Machine configuration for GigaBlue IP 4K

IMAGEDIR = "gigablue/ip4k"

require conf/machine/include/gigablue-mv200.inc

MACHINE_FEATURES += "gbipboxclient"
```

## meta-gigablue/conf/machine/gbipbox.conf
```bitbake
#@TYPE: Machine
#@NAME: GigaBlue IPBox
#@DESCRIPTION: Machine configuration for GigaBlue IPBox

IMAGEDIR = "gigablue/ipbox"

require conf/machine/include/gigablue-gb7358.inc

MACHINE_FEATURES += "dvb-c gbipboxclient"
```

## meta-gigablue/conf/machine/gbquad.conf
```bitbake
#@TYPE: Machine
#@NAME: GigaBlue Quad
#@DESCRIPTION: Machine configuration for GigaBlue Quad

IMAGEDIR = "gigablue/quad"

require conf/machine/include/gigablue-gb7356.inc

MACHINE_FEATURES += "colorlcd220 gigabluelcd220"

MACHINE_ESSENTIAL_EXTRA_RDEPENDS += "\
	kernel-module-smsc75xx \
	"
```

## meta-gigablue/conf/machine/gbquad4k.conf
```bitbake
#@TYPE: Machine
#@NAME: Gigablue Quad 4K
#@DESCRIPTION: Machine configuration for the Gigablue Quad 4K

IMAGEDIR = "gigablue/quad4k"

require conf/machine/include/gigablue-gb7252.inc

MACHINE_FEATURES += "colorlcd400 gigabluelcd400 HDMI-IN-FHD"

RCNAME = "gb3"
```

## meta-gigablue/conf/machine/gbquadplus.conf
```bitbake
#@TYPE: Machine
#@NAME: GigaBlue Quad Plus
#@DESCRIPTION: Machine configuration for GigaBlue Quad Plus

IMAGEDIR = "gigablue/quadplus"

require conf/machine/include/gigablue-gb7356.inc

MACHINE_FEATURES += "colorlcd400 gigabluelcd400"

RCTYPE = "502"
RCNAME = "gb1"
```

## meta-gigablue/conf/machine/gbtrio4k.conf
```bitbake
#@TYPE: Machine
#@NAME: GigaBlue Trio 4K
#@DESCRIPTION: Machine configuration for GigaBlue Trio 4K

IMAGEDIR = "gigablue/trio4k"

MACHINE_FEATURES += "ci"

require conf/machine/include/gigablue-mv200.inc
```

## meta-gigablue/conf/machine/gbue4k.conf
```bitbake
#@TYPE: Machine
#@NAME: Gigablue UE 4K
#@DESCRIPTION: Machine configuration for the Gigablue UE 4K

IMAGEDIR = "gigablue/ue4k"

require conf/machine/include/gigablue-gb7252.inc

MACHINE_FEATURES += "colorlcd220 gigabluelcd220"

RCNAME = "gb4"
```

## meta-gigablue/conf/machine/gbultrase.conf
```bitbake
#@TYPE: Machine
#@NAME: Gigablue Ultra SE
#@DESCRIPTION: Machine configuration for Gigablue Ultra SE

IMAGEDIR = "gigablue/ultrase"

require conf/machine/include/gigablue-gb7362.inc

MACHINE_FEATURES += "blindscan-dvbc ci YUV RCA"
```

## meta-gigablue/conf/machine/gbultraue.conf
```bitbake
#@TYPE: Machine
#@NAME: Gigablue Ultra UE
#@DESCRIPTION: Machine configuration for Gigablue Ultra UE

IMAGEDIR = "gigablue/ultraue"

require conf/machine/include/gigablue-gb7362.inc

MACHINE_FEATURES += "ci blindscan-dvbc colorlcd220 gigabluelcd gigabluelcd220 YUV RCA"
```
