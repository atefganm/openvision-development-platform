## meta-dags/conf/machine/purehdse.conf
```bitbake
#
# This is config file for Xsarius Pure HD SE
#

IMAGEDIR = "update/purehdse/cfe"

require conf/machine/include/dags73625.inc

RCNAME = "fusionhd"
```

## meta-dags/conf/machine/revo4k.conf
```bitbake
#
# This is config file for Xsarius Revo 4K
#

MTD_KERNEL = "mmcblk0p1"
MTD_ROOTFS = "mmcblk0p4"
SPLASH1_BMP = "splash1_power.bmp"

IMAGEDIR = "update/revo4k"

MACHINE_ESSENTIAL_EXTRA_RDEPENDS += "\
    dags-dvb-modules-dags7252-200 \
    "

require conf/machine/include/dags7252.inc

MACHINE_FEATURES += "transcoding streamproxy vfdsymbol"

RCNAME = "revo"
```

## meta-dags/conf/machine/tm2t.conf
```bitbake
#
# This is config file for Technomate TM-2T-OE
#

MTD_KERNEL = "mtd6"
MTD_ROOTFS = "mtd4"

IMAGEDIR = "update/tm2toe/cfe"

MACHINE_ESSENTIAL_EXTRA_RDEPENDS += "\
    dags-dvb-modules-dags7335 \
    edision-tuner-edicombo \
    "

require conf/machine/include/dags7335.inc

MACHINE_FEATURES += "SCART RCA"

RCNAME = "tm1"
```

## meta-dags/conf/machine/tm4ksuper.conf
```bitbake
#
# This is config file for Technomate TM 4K super
#

MTD_KERNEL = "mmcblk0p1"
MTD_ROOTFS = "mmcblk0p4"
SPLASH1_BMP = "splash1_power.bmp"

IMAGEDIR = "update/tm4ksuper"

MACHINE_ESSENTIAL_EXTRA_RDEPENDS += "\
    dags-dvb-modules-dags7252-300 \
    "

require conf/machine/include/dags7252.inc

MACHINE_FEATURES += "transcoding dvb-c RCA"

RCNAME = "tm6"
```

## meta-dags/conf/machine/tmnano.conf
```bitbake
#
# This is config file for Technomate TM-NANO-OE
#

MTD_KERNEL = "mtd1"
MTD_ROOTFS = "mtd0"

IMAGEDIR = "update/tmnanooe/cfe"

MACHINE_ESSENTIAL_EXTRA_RDEPENDS += "\
    dags-dvb-modules-dags7335 \
    edision-tuner-edicombo \
    "

require conf/machine/include/dags7335.inc

MACHINE_FEATURES += "RCA"

RCNAME = "tm2"
```

## meta-dags/conf/machine/tmnano2super.conf
```bitbake
#
# This is config file for Technomate TM-NANO 2 Super
#

MTD_KERNEL = "mtd2"
MTD_ROOTFS = "mtd0"
SPLASH1_BMP = "splash1.bmp"

IMAGEDIR = "update/tmnano2super/cfe"

MACHINE_ESSENTIAL_EXTRA_RDEPENDS += "\
    dags-dvb-modules-dags7356tm \
    "

require conf/machine/include/dags7356.inc

RCNAME = "tm2"
```

## meta-dags/conf/machine/tmnano2t.conf
```bitbake
#
# This is config file for Technomate TM-NANO-2T
#

MTD_KERNEL = "mtd1"
MTD_ROOTFS = "mtd0"

IMAGEDIR = "update/tmnano2t/cfe"

MACHINE_ESSENTIAL_EXTRA_RDEPENDS += "\
    dags-dvb-modules-dags7335 \
    edision-tuner-edicombo \
    "

require conf/machine/include/dags7335.inc

MACHINE_FEATURES += "YUV RCA"

RCNAME = "tm2"
```

## meta-dags/conf/machine/tmnano3t.conf
```bitbake
#
# This is config file for Technomate TM-NANO-3T Combo
#

MTD_KERNEL = "mtd2"
MTD_ROOTFS = "mtd0"
SPLASH1_BMP = "splash1.bmp"

IMAGEDIR = "update/force1plus/cfe"

MACHINE_ESSENTIAL_EXTRA_RDEPENDS += "\
    dags-dvb-modules-dags7356tm \
    "

require conf/machine/include/dags7356.inc

RCNAME = "tm2"
```

## meta-dags/conf/machine/tmnanom3.conf
```bitbake
#
# This is config file for Technomate TM-NANO-M3
#

MTD_KERNEL = "mtd2"
MTD_ROOTFS = "mtd0"
SPLASH1_BMP = "splash1_power.bmp"

IMAGEDIR = "update/tmnanom3/cfe"

MACHINE_ESSENTIAL_EXTRA_RDEPENDS += "\
    dags-dvb-modules-dags7362 \
    "

require conf/machine/include/dags7362.inc

MACHINE_FEATURES += "dvb-c"

RCNAME = "tm5"
```

## meta-dags/conf/machine/tmnanose.conf
```bitbake
#
# This is config file for Technomate TM-NANO-SE
#

MTD_KERNEL = "mtd2"
MTD_ROOTFS = "mtd0"
SPLASH1_BMP = "splash1_power.bmp"

IMAGEDIR = "update/tmnanose/cfe"

MACHINE_ESSENTIAL_EXTRA_RDEPENDS += "\
    dags-dvb-modules-dags7362 \
    "

require conf/machine/include/dags7362.inc

MACHINE_FEATURES += "AV_JACK"

RCNAME = "tm3"
```

## meta-dags/conf/machine/tmnanosecombo.conf
```bitbake
#
# This is config file for Technomate TM-NANO-SE Combo
#

MTD_KERNEL = "mtd2"
MTD_ROOTFS = "mtd0"
SPLASH1_BMP = "splash1_power.bmp"

IMAGEDIR = "update/tmnanosecombo/cfe"

MACHINE_ESSENTIAL_EXTRA_RDEPENDS += "\
    dags-dvb-modules-dags7362 \
    "

require conf/machine/include/dags7362.inc

MACHINE_FEATURES += "dvb-c AV_JACK"

RCNAME = "tm3"
```

## meta-dags/conf/machine/tmnanosem2.conf
```bitbake
#
# This is config file for Technomate TM-NANO-SE M2
#

MTD_KERNEL = "mtd2"
MTD_ROOTFS = "mtd0"
SPLASH1_BMP = "splash1_power.bmp"

IMAGEDIR = "update/tmnanosem2/cfe"

MACHINE_ESSENTIAL_EXTRA_RDEPENDS += "\
    dags-dvb-modules-dags7362 \
    "

require conf/machine/include/dags7362.inc

MACHINE_FEATURES += "fan dvb-c AV_JACK"

RCNAME = "tm4"
```

## meta-dags/conf/machine/tmnanoseplus.conf
```bitbake
#
# This is config file for Technomate TM-NANO-SE/M2 Plus
#

MTD_KERNEL = "mtd2"
MTD_ROOTFS = "mtd0"
SPLASH1_BMP = "splash1_power.bmp"

IMAGEDIR = "update/tmnanoseplus/cfe"

MACHINE_ESSENTIAL_EXTRA_RDEPENDS += "\
    dags-dvb-modules-dags7362 \
    "

require conf/machine/include/dags7362.inc

MACHINE_FEATURES += "fan dvb-c"

RCNAME = "tm4"
```

## meta-dags/conf/machine/tmsingle.conf
```bitbake
#
# This is config file for Technomate TM-Single
#

MTD_KERNEL = "mtd6"
MTD_ROOTFS = "mtd4"

IMAGEDIR = "update/tmsingle/cfe"

MACHINE_ESSENTIAL_EXTRA_RDEPENDS += "\
    dags-dvb-modules-dags7335 \
    edision-tuner-edicombo \
    "

require conf/machine/include/dags7335.inc

MACHINE_FEATURES += "SCART"

RCNAME = "tm2"
```

## meta-dags/conf/machine/tmtwin.conf
```bitbake
#
# This is config file for Technomate TM-Twin-OE
#

MTD_KERNEL = "mtd6"
MTD_ROOTFS = "mtd4"

IMAGEDIR = "update/tmtwinoe/cfe"

MACHINE_ESSENTIAL_EXTRA_RDEPENDS += "\
    dags-dvb-modules-dags7335 \
    edision-tuner-edicombo \
    "

require conf/machine/include/dags7335.inc

MACHINE_FEATURES += "SCART RCA YUV"

RCNAME = "tm1"
```

## meta-dags/conf/machine/tmtwin4k.conf
```bitbake
#
# This is config file for Technomate TM-Twin-4K
#

MTD_KERNEL = "mmcblk0p1"
MTD_ROOTFS = "mmcblk0p4"
SPLASH1_BMP = "splash1_power.bmp"

IMAGEDIR = "update/tmtwin4k"

MACHINE_ESSENTIAL_EXTRA_RDEPENDS += "\
    dags-dvb-modules-dags7252-200 \
    "

require conf/machine/include/dags7252.inc

MACHINE_FEATURES += "transcoding fan dvb-c vfdsymbol"

RCNAME = "tm6"
```

## meta-dags/conf/machine/valalinux.conf
```bitbake
#
# This is config file for VALA Linux
#

MTD_KERNEL = "mtd2"
MTD_ROOTFS = "mtd0"
SPLASH1_BMP = "splash1_os1.bmp"

IMAGEDIR = "update/valalinux/cfe"

MACHINE_ESSENTIAL_EXTRA_RDEPENDS += "\
    dags-dvb-modules-dags7362 \
    "

require conf/machine/include/dags7362.inc

MACHINE_FEATURES += "dvb-c"

RCNAME = "vala"
```

## meta-dags/conf/machine/worldvisionf1.conf
```bitbake
#
# This is config file for WorldVision Force 1
#

MTD_KERNEL = "mtd2"
MTD_ROOTFS = "mtd0"
SPLASH1_BMP = "splash1_os1.bmp"

IMAGEDIR = "update/force1/cfe"

MACHINE_ESSENTIAL_EXTRA_RDEPENDS += "\
    dags-dvb-modules-dags7356f1 \
    "

require conf/machine/include/dags7356.inc

MACHINE_FEATURES += "YUV"

RCNAME = "iqon2"
```

## meta-dags/conf/machine/worldvisionf1plus.conf
```bitbake
#
# This is config file for WorldVision Force 1 Plus
#

MTD_KERNEL = "mtd2"
MTD_ROOTFS = "mtd0"
SPLASH1_BMP = "splash1_os1.bmp"

IMAGEDIR = "update/force1plus/cfe"

MACHINE_ESSENTIAL_EXTRA_RDEPENDS += "\
    dags-dvb-modules-dags7356f1 \
    "

require conf/machine/include/dags7356.inc

RCNAME = "iqon2"
```

## meta-dinobot/conf/machine/anadol4k.conf
```bitbake
#
# This is config file for Anadol 4K Eco
#

require conf/machine/include/u5.inc

MTD_KERNEL = "mmcblk0p9"
MTD_ROOTFS = "mmcblk0p10"

SDCARDIMG = "no"

RCNAME = "anadol1"
RCIDNUM = "1"
```

## meta-dinobot/conf/machine/anadol4kv2.conf
```bitbake
#
# This is config file for Anadol 4K Eco V2 and Anadol 4K Combo
#

require conf/machine/include/u51.inc

SDCARDIMG = "no"

MACHINE_FEATURES += "dvb-c"

IMAGEDIR = "dinobot/${MACHINETYPE}"

RCNAME = "anadol1"
RCIDNUM = "1"
```

## meta-dinobot/conf/machine/anadolprohd5.conf
```bitbake
#
# This is config file for Anadol Pro HD5, IZIBox Eco Twin HD, SpyCat Mini V2, JamesDonkey HD Duo
#

require conf/machine/include/u42.inc

RCNAME = "anadol3"
RCIDNUM = "1"
```

## meta-dinobot/conf/machine/arivacombo.conf
```bitbake
#
# This is config file for Ferguson Ariva ATV Combo
#

require conf/machine/include/u532.inc

RCNAME = "ariva"
RCIDNUM = "1"
```

## meta-dinobot/conf/machine/arivatwin.conf
```bitbake
#
# This is config file for Ferguson Ariva ATV Twin
#

require conf/machine/include/u533.inc

RCNAME = "ariva"
RCIDNUM = "1"
```

## meta-dinobot/conf/machine/axashis4kcombo.conf
```bitbake
#
# This is config file for AXAS HIS 4K Combo
#

require conf/machine/include/u51.inc

SDCARDIMG = "no"

MACHINE_FEATURES += "dvb-c"

IMAGEDIR = "axas/axascombo"

RCNAME = "axas1"
RCIDNUM = "1"
```
