## meta-dags/conf/machine/fusionhdse.conf
```bitbake
#
# This is config file for Xsarius Fusion HD SE
#

MTD_KERNEL = "mtd2"
MTD_ROOTFS = "mtd0"
SPLASH1_BMP = "splash1_power.bmp"

IMAGEDIR = "update/fusionhdse/cfe"

MACHINE_ESSENTIAL_EXTRA_RDEPENDS += "\
    dags-dvb-modules-dags7362 \
    "

require conf/machine/include/dags7362.inc

RCNAME = "fusionhd"
```

## meta-dags/conf/machine/galaxy4k.conf
```bitbake
#
# This is config file for Xsarius Galaxy 4K
#

MTD_KERNEL = "mmcblk0p1"
MTD_ROOTFS = "mmcblk0p4"
SPLASH1_BMP = "splash1_power.bmp"

IMAGEDIR = "update/galaxy4k"

MACHINE_ESSENTIAL_EXTRA_RDEPENDS += "\
    dags-dvb-modules-dags7252-300 \
    "

require conf/machine/include/dags7252.inc

MACHINE_FEATURES += "transcoding streamproxy RCA"

RCNAME = "revo"
```

## meta-dags/conf/machine/include/dags-arm.inc
```bitbake
require conf/machine/include/dags-oem.inc

DISTRO_FEATURES_remove += "directfb gtk-directfb"

KERNEL_FILE = "oe_kernel.bin"
ROOTFS_FILE = "rootfs.tar.bz2"
MTD_BLACK  = "mmcblk0"

TARGET_ARCH = "arm"
DEFAULTTUNE = "cortexa15hf-neon-vfpv4"
IMAGE_FSTYPES += "tar.bz2"

require conf/machine/include/tune-cortexa15.inc

IMAGE_CMD_tar_prepend = "\
	mkdir -p ${DEPLOY_DIR_IMAGE}/${IMAGEDIR}; \
	cp -f ${DEPLOY_DIR_IMAGE}/${MACHINE}_initrd_run.bin ${DEPLOY_DIR_IMAGE}/${IMAGEDIR}/initrd_run.bin; \
	cp -f ${DEPLOY_DIR_IMAGE}/zImage ${DEPLOY_DIR_IMAGE}/${IMAGEDIR}/${KERNEL_FILE}; \
	echo ${IMAGE_NAME} > ${DEPLOY_DIR_IMAGE}/${IMAGEDIR}/imageversion; \
	echo "https://forum.openvision.tech/app.php/donate" > ${DEPLOY_DIR_IMAGE}/${IMAGEDIR}/donate.txt; \
	cd ${IMAGE_ROOTFS}; \
	tar -cvf ${DEPLOY_DIR_IMAGE}/rootfs.tar -C ${IMAGE_ROOTFS} .; \
	mv -f ${DEPLOY_DIR_IMAGE}/rootfs.tar ${DEPLOY_DIR_IMAGE}/${IMAGEDIR}/rootfs.tar; \
	bzip2 ${DEPLOY_DIR_IMAGE}/${IMAGEDIR}/rootfs.tar; \
	rm -f ${DEPLOY_DIR_IMAGE}/*.zip; \
	cd ${DEPLOY_DIR_IMAGE}; \
	zip ${IMAGE_NAME}_usb.zip ${IMAGEDIR}/*; \
	rm -f ${DEPLOY_DIR_IMAGE}/*.tar.bz2; \
	rm -Rf update; \
	"

IMAGE_CMD_tar_prepend = " \
	rm -Rf ${IMAGE_ROOTFS}/tmp/*; \
	"

EXTRA_IMAGEDEPENDS += "\
	dags-initrd-cfe-${MACHINE} \
	"
```

## meta-dags/conf/machine/include/dags-mips.inc
```bitbake
require conf/machine/include/dags-oem.inc

KERNEL_FILE = "oe_kernel.bin"
ROOTFS_FILE = "oe_rootfs.bin"

TARGET_ARCH = "mipsel"
DEFAULTTUNE = "mips32el"

KERNEL_IMAGETYPE = "vmlinux"
KERNEL_OUTPUT = "${KERNEL_IMAGETYPE}"
KERNEL_CONSOLE = "ttyS0,115200n8"

IMAGE_FSTYPES ?= "ubi"

MKUBIFS_ARGS = "-m 2048 -e 126976 -c 4096 -F"
UBINIZE_ARGS = "-m 2048 -p 128KiB"

IMAGE_CMD_ubifs_prepend = "\
	rm -rf ${IMAGE_ROOTFS}/boot/*; \
	rm -rf ${IMAGE_ROOTFS}/tmp/*; \
	"

IMAGE_CMD_ubi_append = " \
	mkdir -p ${DEPLOY_DIR_IMAGE}/${IMAGEDIR}; \
	mv -f ${IMGDEPLOYDIR}/${IMAGE_NAME}${IMAGE_NAME_SUFFIX}.ubi ${DEPLOY_DIR_IMAGE}/${IMAGEDIR}/${ROOTFS_FILE}; \
	gzip -f -9c ${DEPLOY_DIR_IMAGE}/vmlinux-${MACHINE}.bin > ${DEPLOY_DIR_IMAGE}/${IMAGEDIR}/${KERNEL_FILE}; \
	echo ${IMAGE_NAME} > ${DEPLOY_DIR_IMAGE}/${IMAGEDIR}/imageversion; \
	echo "https://forum.openvision.tech/app.php/donate" > ${DEPLOY_DIR_IMAGE}/${IMAGEDIR}/donate.txt; \
	rm -f ${DEPLOY_DIR_IMAGE}/*.zip; \
	cd ${DEPLOY_DIR_IMAGE}; \
	zip ${IMAGE_NAME}_usb.zip ${IMAGEDIR}/*; \
	rm -f ${DEPLOY_DIR_IMAGE}/*.ubi; \
	rm -f ${DEPLOY_DIR_IMAGE}/*.ubifs; \
	rm -Rf update; \
	"

require conf/machine/include/tune-mips32.inc
```

## meta-dags/conf/machine/include/dags-oem.inc
```bitbake
# We know about rtc
MACHINE_FEATURES_BACKFILL_CONSIDERED += "rtc"

BOX_BRAND = "dags"

MACHINE_FEATURES += "alsa hdmicec switchoff textlcd ci dags HDMI"

BOOTLOGO_FILENAME = "splash.bmp"

DVBPROVIDER = "kernel"
DVBSKYPROVIDER = "kernel"

MACHINE_ESSENTIAL_EXTRA_RDEPENDS += "\
	dags-shutdown \
	gstreamer1.0-plugin-dvbmediasink \
	gstreamer1.0-libav \
	${@bb.utils.contains('MACHINE_FEATURES', 'swap', 'dags-swapcreate', '',d)} \
	"

GLIBC_EXTRA_OECONF = "--with-tls"
DVBMEDIASINK_CONFIG = "--with-dags --with-pcm --with-eac3 --with-amr --with-wmv"

PREFERRED_PROVIDER_virtual/kernel = "linux-dags"

PREFERRED_PROVIDER_virtual/blindscan-dvbs = "dags-blindscan-utils"

require conf/machine/include/soc-family.inc

BLINDSCAN_BINARY = "dags_blindscan"

RCNAME ?= "optimuss1"

PREFERRED_VERSION_linux-dags = "${KERNELVERSION}"
```

## meta-dags/conf/machine/include/dags7252.inc
```bitbake
require conf/machine/include/dags-arm.inc

KERNELVERSION = "3.14.28"

SOC_FAMILY = "bcm7252s"

STB_PLATFORM = "dags7252"

MACHINE_FEATURES += "emmc mmc"

EXTRA_OECONF_append_pn-transtreamproxy = " --enable-ext-pid"
```

## meta-dags/conf/machine/include/dags72604.inc
```bitbake
require conf/machine/include/dags-arm.inc

KERNELVERSION = "4.1.20"

SOC_FAMILY = "bcm72604"

STB_PLATFORM = "dags72604"

MACHINE_FEATURES += "emmc mmc dvb-c blindscan-dvbs swap"

DVBMEDIASINK_CONFIG = "--with-dags --with-pcm --with-eac3 --with-amr --with-wmv --with-h265 --with-vb9"

MTD_KERNEL = "mmcblk0p1"
MTD_ROOTFS = "mmcblk0p4"
SPLASH1_BMP = "splash1_power.bmp"

MACHINE_ESSENTIAL_EXTRA_RDEPENDS += "\
	dags-dvb-modules-dags72604 \
	"
```

## meta-dags/conf/machine/include/dags7335.inc
```bitbake
require conf/machine/include/dags-mips.inc

KERNELVERSION = "3.9.7"

SOC_FAMILY = "bcm7335"

STB_PLATFORM = "dags7335"

MACHINE_FEATURES += "fan blindscan-tbs"
```

## meta-dags/conf/machine/include/dags7356.inc
```bitbake
require conf/machine/include/dags-mips.inc

KERNELVERSION = "3.9.7"

SOC_FAMILY = "bcm7356"

STB_PLATFORM = "dags7356"

MACHINE_FEATURES += "fan blindscan-tbs RCA"
```

## meta-dags/conf/machine/include/dags7362.inc
```bitbake
require conf/machine/include/dags-mips.inc

KERNELVERSION = "4.2.1"

SOC_FAMILY = "bcm7362"

STB_PLATFORM = "dags7362"

MACHINE_FEATURES += "blindscan-tbs vfdsymbol"
```

## meta-dags/conf/machine/include/dags73625.inc
```bitbake
require conf/machine/include/dags-mips.inc

KERNELVERSION = "4.2.1"

SOC_FAMILY = "bcm73625"

STB_PLATFORM = "dags73625"

MACHINE_FEATURES += "blindscan-tbs dvb-c vfdsymbol"

MTD_KERNEL = "mtd2"
MTD_ROOTFS = "mtd0"
SPLASH1_BMP = "splash1_power.bmp"

MACHINE_ESSENTIAL_EXTRA_RDEPENDS += "\
	dags-dvb-modules-dags73625 \
	"
```

## meta-dags/conf/machine/iqonios100hd.conf
```bitbake
#
# This is config file for Iqon IOS-100HD
#

MTD_KERNEL = "mtd6"
MTD_ROOTFS = "mtd4"

IMAGEDIR = "update/ios100/cfe"

MACHINE_ESSENTIAL_EXTRA_RDEPENDS += "\
    dags-dvb-modules-dags7335 \
    edision-tuner-edicombo \
    "

require conf/machine/include/dags7335.inc

MACHINE_FEATURES += "SCART RCA YUV"

RCNAME = "iqon1"
```

## meta-dags/conf/machine/iqonios200hd.conf
```bitbake
#
# This is config file for Iqon IOS-200HD, MediaArt 200HD and Roxxs 200HD
#

MTD_KERNEL = "mtd6"
MTD_ROOTFS = "mtd4"

IMAGEDIR = "update/ios200/cfe"

MACHINE_ESSENTIAL_EXTRA_RDEPENDS += "\
    dags-dvb-modules-dags7335ci \
    "

require conf/machine/include/dags7335.inc

MACHINE_FEATURES += "RCA YUV"

RCNAME = "iqon1"
```

## meta-dags/conf/machine/iqonios300hdv2.conf
```bitbake
#
# This is config file for Iqon IOS-300HDV2
#

MTD_KERNEL = "mtd1"
MTD_ROOTFS = "mtd4"

IMAGEDIR = "update/ios300new/cfe"

MACHINE_ESSENTIAL_EXTRA_RDEPENDS += "\
    dags-dvb-modules-dags7335 \
    edision-tuner-edicombo \
    "

require conf/machine/include/dags7335.inc

MACHINE_FEATURES += "RCA"

RCNAME = "iqon1"
```

## meta-dags/conf/machine/lunix.conf
```bitbake
#
# This is config file for Qviart Lunix
#

IMAGEDIR = "update/lunix/cfe"

require conf/machine/include/dags73625.inc

RCNAME = "qviart1"
```

## meta-dags/conf/machine/lunix34k.conf
```bitbake
#
# This is config file for Qviart Lunix3 4K
#

MTD_KERNEL = "mmcblk0p1"
MTD_ROOTFS = "mmcblk0p4"
SPLASH1_BMP = "splash1_power.bmp"

IMAGEDIR = "update/lunix3-4k"

MACHINE_ESSENTIAL_EXTRA_RDEPENDS += "\
    dags-dvb-modules-dags7252-300 \
    "

require conf/machine/include/dags7252.inc

MACHINE_FEATURES += "transcoding dvb-c RCA"

RCNAME = "qviart1"
```

## meta-dags/conf/machine/lunix4k.conf
```bitbake
#
# This is config file for Qviart Lunix 4K
#

IMAGEDIR = "update/lunix4k"

require conf/machine/include/dags72604.inc

RCNAME = "qviart3"
```

## meta-dags/conf/machine/lunixco.conf
```bitbake
#
# This is config file for Qviart Lunix Co
#

IMAGEDIR = "update/lunixco/cfe"

require conf/machine/include/dags73625.inc

RCNAME = "qviart4"
```

## meta-dags/conf/machine/mediabox.conf
```bitbake
#
# This is config file for Jepssen MediaBox HD LX
#

MTD_KERNEL = "mtd6"
MTD_ROOTFS = "mtd4"

IMAGEDIR = "update/mediabox/cfe"

MACHINE_ESSENTIAL_EXTRA_RDEPENDS += "\
    dags-dvb-modules-dags7335 \
    edision-tuner-edicombo \
    "

require conf/machine/include/dags7335.inc

MACHINE_FEATURES += "YUV RCA"

RCNAME = "mediabox"
```

## meta-dags/conf/machine/optimussos.conf
```bitbake
#
# This is config file for Edision Optimuss OS
#

MTD_KERNEL = "mtd2"
MTD_ROOTFS = "mtd0"
SPLASH1_BMP = "splash1_power.bmp"

IMAGEDIR = "update/optimussos/cfe"

MACHINE_ESSENTIAL_EXTRA_RDEPENDS += "\
    dags-dvb-modules-dags7362 \
    "

require conf/machine/include/dags7362.inc

MACHINE_FEATURES += "AV_JACK"
```

## meta-dags/conf/machine/optimussos1.conf
```bitbake
#
# This is config file for Edision Optimuss OS1
#

MTD_KERNEL = "mtd1"
MTD_ROOTFS = "mtd4"

IMAGEDIR = "update/optimussos1/cfe"

MACHINE_ESSENTIAL_EXTRA_RDEPENDS += "\
    dags-dvb-modules-dags7335 \
    edision-tuner-edicombo \
    "

require conf/machine/include/dags7335.inc

MACHINE_FEATURES += "RCA"
```

## meta-dags/conf/machine/optimussos1plus.conf
```bitbake
#
# This is config file for Edision Optimuss OS1 Plus
#

MTD_KERNEL = "mtd2"
MTD_ROOTFS = "mtd0"
SPLASH1_BMP = "splash1_os1.bmp"

IMAGEDIR = "update/optimussos1plus/cfe"

MACHINE_ESSENTIAL_EXTRA_RDEPENDS += "\
    dags-dvb-modules-dags7356 \
    kernel-module-dvb-usb \
    edision-tuner-edicombo \
    "

require conf/machine/include/dags7356.inc
```

## meta-dags/conf/machine/optimussos2.conf
```bitbake
#
# This is config file for Edision Optimuss OS2
#

MTD_KERNEL = "mtd6"
MTD_ROOTFS = "mtd4"

IMAGEDIR = "update/optimussos2/cfe"

MACHINE_ESSENTIAL_EXTRA_RDEPENDS += "\
    dags-dvb-modules-dags7335ci \
    "

require conf/machine/include/dags7335.inc

MACHINE_FEATURES += "YUV RCA"
```

## meta-dags/conf/machine/optimussos2plus.conf
```bitbake
#
# This is config file for Edision Optimuss OS2 Plus
#

MTD_KERNEL = "mtd2"
MTD_ROOTFS = "mtd0"
SPLASH1_BMP = "splash1_os2.bmp"

IMAGEDIR = "update/optimussos2plus/cfe"

MACHINE_ESSENTIAL_EXTRA_RDEPENDS += "\
    dags-dvb-modules-dags7356 \
    kernel-module-dvb-usb \
    edision-tuner-edicombo \
    "

require conf/machine/include/dags7356.inc

MACHINE_FEATURES += "YUV"
```

## meta-dags/conf/machine/optimussos3plus.conf
```bitbake
#
# This is config file for Edision Optimuss OS3 Plus
#

MTD_KERNEL = "mtd2"
MTD_ROOTFS = "mtd0"
SPLASH1_BMP = "splash1_os2.bmp"

IMAGEDIR = "update/optimussos3plus/cfe"

MACHINE_ESSENTIAL_EXTRA_RDEPENDS += "\
    dags-dvb-modules-dags7356 \
    kernel-module-dvb-usb \
    edision-tuner-edicombo \
    "

require conf/machine/include/dags7356.inc

RCNAME = "optimuss2"
```
