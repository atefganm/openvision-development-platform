## meta-sh4/conf/machine/sagemcom88.conf
```bitbake
require conf/machine/include/oem-sh4.inc
require conf/machine/include/normal-sh4-image.inc
require conf/machine/include/sh4-jffs2.inc

BOX_BRAND = "sagemcom"

PREFERRED_PROVIDER_virtual/kernel = "linux-sh4-spark7162"

ROOTFS_FILE = "root.img"
KERNEL_FILE = "uImage"

IMAGE_FSTYPES += "tar.gz"

MACHINE_FEATURES += "hdmicec ci smallflash SCART nofhdskin"

AUDIOELF = "audio_7105.elf"
VIDEOELF = "video_7105.elf"

SOC_FAMILY = "sti7105"

MACHINE_ESSENTIAL_EXTRA_RDEPENDS += "\
	firmware-sh4 \
	kernel-module-zram \
	stlinux24-sh4-stmfb-firmware-stx7105 \
	stlinux24-sh4-stx7105-fdma-firmware \
	stlirc \
	"

CAN_USE_ENIGMA2_IN_FLASH = "1"
```

## meta-sh4/conf/machine/spark7162.conf
```bitbake
require conf/machine/include/spark.inc

AUDIOELF = "audio_7105.elf"
VIDEOELF = "video_7105.elf"

SOC_FAMILY = "sti7105"

MACHINE_ESSENTIAL_EXTRA_RDEPENDS += "\
	enigma2-plugin-systemplugins-sparkuniontunertype \
	stlinux24-sh4-stmfb-firmware-stx7105 \
	stlinux24-sh4-stx7105-fdma-firmware \
	vfdctl \
	"
```

## meta-sh4/conf/machine/tf7700.conf
```bitbake
require conf/machine/include/oem-sh4.inc
require conf/machine/include/normal-sh4-image.inc
require conf/machine/include/sh4-jffs2.inc

BOX_BRAND = "topfield"

PREFERRED_PROVIDER_virtual/kernel = "linux-sh4-edisionargus"

ROOTFS_FILE = "root.img"
KERNEL_FILE = "uImage"

IMAGE_FSTYPES += "tar.gz"

MACHINE_FEATURES += "RCA YUV SCART"

AUDIOELF = "audio_7100.elf"
VIDEOELF = "video_7109.elf"

SOC_FAMILY = "sti7109"

MACHINE_ESSENTIAL_EXTRA_RDEPENDS += "\
	enigma2-plugin-extensions-topfieldvfd \
	firmware-sh4 \
	fp-control \
	kernel-module-zram \
	stlinux24-sh4-stx7109-fdma-firmware \
	tfd2mtd \
	tffpctl \
	"

CAN_USE_ENIGMA2_IN_FLASH = "1"

RCTYPE = "11"
RCNAME = "tf7700"
```

## meta-sh4/conf/machine/ufc960.conf
```bitbake
require conf/machine/include/kathrein.inc

MTD_KERNEL = "mtd1"
MTD_ROOTFS = "mtd2"

PREFERRED_PROVIDER_virtual/kernel = "linux-sh4-ufs922"

MACHINE_FEATURES += "ci smallflash nofhdskin"

AUDIOELF = "audio_7100.elf"
VIDEOELF = "video_7109.elf"

SOC_FAMILY = "sti7109"

DVB1FIRMWARE = "dvb-fe-cx21143.fw"
DVB2FIRMWARE = "dvb-fe-stv6306.fw"

MACHINE_ESSENTIAL_EXTRA_RDEPENDS += "\
	firmware-sh4 \
	stlinux24-sh4-stx7109-fdma-firmware \
	"

CAN_USE_ENIGMA2_IN_FLASH = "1"
```

## meta-sh4/conf/machine/ufs910.conf
```bitbake
require conf/machine/include/kathrein.inc

PREFERRED_PROVIDER_virtual/kernel = "linux-sh4-${MACHINE}"

MACHINE_FEATURES += "smallflash nofhdskin"

AUDIOELF = "audio_7100.elf"
VIDEOELF = "video_7100.elf"

SOC_FAMILY = "sti7100"

MACHINE_ESSENTIAL_EXTRA_RDEPENDS += "\
	firmware-sh4 \
	stlinux24-sh4-stx7100-fdma-firmware \
	stlirc \
	vfdctl \
	"

CAN_USE_ENIGMA2_IN_FLASH = "0"
# It's possible to flash 16MB images which is not even our smallflash = 64MB

RCTYPE = "19"
RCNAME = "ufs910"
```

## meta-sh4/conf/machine/ufs912.conf
```bitbake
require conf/machine/include/kathrein.inc

PREFERRED_PROVIDER_virtual/kernel = "linux-sh4-${MACHINE}"

MACHINE_FEATURES += "hdmicec"

AUDIOELF = "audio_7111.elf"
VIDEOELF = "video_7111.elf"

SOC_FAMILY = "sti7111"

MACHINE_ESSENTIAL_EXTRA_RDEPENDS += "\
	stlinux24-sh4-stmfb-firmware-stx7111 \
	stlinux24-sh4-stx7111-fdma-firmware \
	vfdctl \
	"

CAN_USE_ENIGMA2_IN_FLASH = "1"

RCTYPE = "12"
RCNAME = "ufs912"
```

## meta-sh4/conf/machine/ufs913.conf
```bitbake
require conf/machine/include/kathrein.inc

MTD_KERNEL = "mtd8"
MTD_ROOTFS = "mtd9"

PREFERRED_PROVIDER_virtual/kernel = "linux-sh4-${MACHINE}"

MACHINE_FEATURES += "hdmicec smallflash"

AUDIOELF = "audio_7105.elf"
VIDEOELF = "video_7105.elf"

SOC_FAMILY = "sti7105"

MACHINE_ESSENTIAL_EXTRA_RDEPENDS += "\
	firmware-sh4 \
	stlinux24-sh4-stmfb-firmware-stx7105 \
	stlinux24-sh4-stx7105-fdma-firmware \
	vfdctl \
	"

CAN_USE_ENIGMA2_IN_FLASH = "1"

RCTYPE = "20"
RCNAME = "ufs913"
```

## meta-sh4/conf/machine/ufs922.conf
```bitbake
require conf/machine/include/kathrein.inc

PREFERRED_PROVIDER_virtual/kernel = "linux-sh4-${MACHINE}"

MACHINE_FEATURES += "fan smallflash nofhdskin"

AUDIOELF = "audio_7100.elf"
VIDEOELF = "video_7109.elf"

SOC_FAMILY = "sti7109"

MACHINE_ESSENTIAL_EXTRA_RDEPENDS += "\
	firmware-sh4 \
	stlinux24-sh4-stx7109-fdma-firmware \
	"

CAN_USE_ENIGMA2_IN_FLASH = "0"

RCTYPE = "19"
RCNAME = "ufs912"
```

## meta-sh4/conf/machine/vip1_v1.conf
```bitbake
require conf/machine/include/edisionargus.inc

DVB1FIRMWARE = "dvb-fe-avl2108.fw"
DVB2FIRMWARE = "dvb-fe-stv6306.fw"

MACHINE_ESSENTIAL_EXTRA_RDEPENDS += "\
	firmware-sh4 \
	"
```

## meta-sh4/conf/machine/vitamin_hd5000.conf
```bitbake
require conf/machine/include/oem-sh4.inc
require conf/machine/include/normal-sh4-image.inc
require conf/machine/include/sh4-jffs2.inc

BOX_BRAND = "showbox"

PREFERRED_PROVIDER_virtual/kernel = "linux-sh4-hs"

ROOTFS_FILE = "root.img"
KERNEL_FILE = "uImage"

IMAGE_FSTYPES = "tar.gz"

MACHINE_FEATURES += "hdmicec ci smallflash RCA YUV SCART"

AUDIOELF = "audio_7111.elf"
VIDEOELF = "video_7111.elf"

SOC_FAMILY = "sti7111"

MACHINE_ESSENTIAL_EXTRA_RDEPENDS += "\
	fp-control \
	kernel-module-zram \
	stlinux24-sh4-stmfb-firmware-stx7111 \
	stlinux24-sh4-stx7111-fdma-firmware \
	"

CAN_USE_ENIGMA2_IN_FLASH = "1"

RCTYPE = "14"
RCNAME = "vitamin"
```

## meta-tiviar/conf/layer.conf
```bitbake
# We have a conf and classes directory, append to BBPATH
BBPATH .= ":${LAYERDIR}"

# We have a recipes directory, add to BBFILES
BBFILES += "${LAYERDIR}/recipes-*/*.bb ${LAYERDIR}/recipes-*/*.bbappend \
            ${LAYERDIR}/recipes-*/*/*.bb ${LAYERDIR}/recipes-*/*/*.bbappend \
            ${LAYERDIR}/recipes-*/*/*/*.bb ${LAYERDIR}/recipes-*/*/*/*.bbappend"

METATIVIAR_BASE := '${@os.path.normpath("${LAYERDIR}/../")}'
# Prevent current directory creeping into sstate objects. Otherwise, building
# in another TOPDIR will cause recipes using this variable to be rebuilt.
METATIVIAR_BASE[vardepvalue] = 'meta-tiviar'

# Additional license directories.
LICENSE_PATH += "${LAYERDIR}/conf/license"
```

## meta-tiviar/conf/machine/include/tiviar.inc
```bitbake
# We know about rtc
MACHINE_FEATURES_BACKFILL_CONSIDERED += "rtc"

KERNELVERSION = "4.10.6"

BOX_BRAND = "tiviar"

MTD_KERNEL = "mtd1"
MTD_ROOTFS = "mtd2"
KERNEL_FILE = "kernel.bin"
ROOTFS_FILE = "rootfs.bin"

MACHINE_ESSENTIAL_EXTRA_RDEPENDS += "\
	tiviar-dvb-modules-${MACHINE} \
	gstreamer1.0-plugin-dvbmediasink \
	"

DVBPROVIDER = "kernel"
DVBSKYPROVIDER = "kernel"

DVBMEDIASINK_CONFIG = "--with-wma --with-wmv --with-pcm --with-dts --with-eac3"

TARGET_ARCH = "mipsel"
DEFAULTTUNE = "mips32el"

PREFERRED_PROVIDER_virtual/kernel = "linux-tiviar"
PREFERRED_VERSION_linux-tiviar = "${KERNELVERSION}"

KERNEL_IMAGETYPE = "vmlinux"
KERNEL_OUTPUT = "${KERNEL_IMAGETYPE}"
KERNEL_CONSOLE = "ttyS0,115200n8"

IMAGE_FSTYPES ?= "ubi"

MKUBIFS_ARGS = "-m 2048 -e 126976 -c 8192"
UBINIZE_ARGS = "-m 2048 -p 128KiB"

IMAGE_CMD_ubifs_prepend = "\
	rm -rf ${IMAGE_ROOTFS}/boot/*; \
	rm -rf ${IMAGE_ROOTFS}/tmp/*; \
	"

IMAGE_CMD_ubi_append = " \
	mkdir -p ${DEPLOY_DIR_IMAGE}/${IMAGEDIR}; \
	mv -f ${IMGDEPLOYDIR}/${IMAGE_NAME}${IMAGE_NAME_SUFFIX}.ubi ${DEPLOY_DIR_IMAGE}/${IMAGEDIR}/${ROOTFS_FILE}; \
	gzip -9c ${DEPLOY_DIR_IMAGE}/vmlinux-${MACHINE}.bin > ${DEPLOY_DIR_IMAGE}/${IMAGEDIR}/${KERNEL_FILE}; \
	echo ${IMAGE_NAME} > ${DEPLOY_DIR_IMAGE}/${IMAGEDIR}/imageversion; \
	echo "https://forum.openvision.tech/app.php/donate" > ${DEPLOY_DIR_IMAGE}/${IMAGEDIR}/donate.txt; \
	echo "rename this file to 'force' to force an update without confirmation" > ${DEPLOY_DIR_IMAGE}/${IMAGEDIR}/noforce; \
	rm -f ${DEPLOY_DIR_IMAGE}/*.zip; \
	cd ${DEPLOY_DIR_IMAGE}; \
	zip ${IMAGE_NAME}_usb.zip ${IMAGEDIR}/*; \
	rm -f ${DEPLOY_DIR_IMAGE}/*.ubi; \
	rm -f ${DEPLOY_DIR_IMAGE}/*.ubifs; \
	rm -Rf ${IMAGEDIR}; \
	"

MACHINE_FEATURES += "ci alsa hdmicec switchoff blindscan-tbs videoenhancement textlcd HDMI"

# Broken bootloader can only flash around 100 MB
FLASHSIZE = "96"

BOOTLOGO_FILENAME = "splash.bin"

require conf/machine/include/tune-mips32.inc
require conf/machine/include/soc-family.inc

RCNAME = "tiviar1"
```

## meta-tiviar/conf/machine/tiviaraplus.conf
```bitbake
#@TYPE: Machine
#@NAME:  Tiviar Alpha+
#@DESCRIPTION: Machine configuration for the Tiviar Alpha+

SOC_FAMILY = "bcm7356"

MACHINE_FEATURES += "dvb-c multitranscoding SCART YUV"

require conf/machine/include/tiviar.inc
```

## meta-tiviar/conf/machine/tiviarmin.conf
```bitbake
#@TYPE: Machine
#@NAME: Tiviar mini
#@DESCRIPTION: Machine configuration for the Tiviar mini

SOC_FAMILY = "bcm7362"

MACHINE_FEATURES += "7segment AV_JACK"

require conf/machine/include/tiviar.inc
```

## meta-tripledot/conf/machine/enibox.conf
```bitbake
#
# This is config file for HDBox EniBox
#

require conf/machine/include/vg5000.inc

RCNAME = "hdbox"
```

## meta-tripledot/conf/machine/evoslimse.conf
```bitbake
#
# This is config file for Evo Slim SE
#

require conf/machine/include/yh7362.inc

IMAGEDIR = "slim"

RCNAME = "evo8"
RCIDNUM = "1"
```

## meta-tripledot/conf/machine/evoslimt2c.conf
```bitbake
#
# This is config file for Evo Slim T2C
#

require conf/machine/include/tripledot-oem.inc

MTD_ROOTFS = "mtd0"

IMAGEDIR = "slimt2c"

MACHINE_ESSENTIAL_EXTRA_RDEPENDS += "\
	tripledot-dvb-modules-yh62tc \
	tripledot-cfe \
	"

PREFERRED_PROVIDER_virtual/kernel = "linux-tripledot-yh62tc"
PREFERRED_VERSION_linux-tripledot-yh62tc = "${KERNELVERSION}"

SOC_FAMILY = "bcm7362"

MKUBIFS_ARGS = "-m 2048 -e 126976 -c 4096"
UBINIZE_ARGS = "-m 2048 -p 128KiB -s 2048"

MACHINE_FEATURES += "dvb-c"

RCNAME = "evo8"
RCIDNUM = "1"
```

## meta-tripledot/conf/machine/include/tripledot-oem.inc
```bitbake
# We know about rtc
MACHINE_FEATURES_BACKFILL_CONSIDERED += "rtc"

KERNELVERSION = "3.14.2"

BOX_BRAND = "tripledot"

MTD_KERNEL = "mtd2"

KERNEL_FILE = "kernel.bin"
ROOTFS_FILE = "rootfs.bin"

DVBPROVIDER = "kernel"

MACHINE_ESSENTIAL_EXTRA_RDEPENDS += "\
	gstreamer1.0-plugin-dvbmediasink \
	"

DVBMEDIASINK_CONFIG = "--with-wma --with-wmv --with-pcm --with-dts --with-eac3"

TARGET_ARCH = "mipsel"
DEFAULTTUNE = "mips32el"

KERNEL_IMAGETYPE = "vmlinux"
KERNEL_OUTPUT = "${KERNEL_IMAGETYPE}"
KERNEL_CONSOLE = "ttyS0,115200n8"

IMAGE_FSTYPES ?= "ubi"

IMAGE_CMD_ubifs_prepend = "\
	rm -rf ${IMAGE_ROOTFS}/boot/*; \
	rm -rf ${IMAGE_ROOTFS}/tmp/*; \
	"

IMAGE_CMD_ubi_append = " \
	mkdir -p ${DEPLOY_DIR_IMAGE}/${IMAGEDIR}; \
	${@bb.utils.contains("MACHINE_FEATURES", "extrasplash", "cp -f ${DEPLOY_DIR_IMAGE}/cfe.bmp ${DEPLOY_DIR_IMAGE}/${IMAGEDIR}/;" , "", d)} \
	${@bb.utils.contains("MACHINE_FEATURES", "extrasplash", "cp -f ${DEPLOY_DIR_IMAGE}/splash.bmp ${DEPLOY_DIR_IMAGE}/${IMAGEDIR}/;" , "", d)} \
	${@bb.utils.contains("MACHINE_FEATURES", "extrasplash", "cp -f ${DEPLOY_DIR_IMAGE}/imageversion.bmp ${DEPLOY_DIR_IMAGE}/${IMAGEDIR}/;" , "", d)} \
	${@bb.utils.contains("MACHINE_FEATURES", "extrasplash", "cp -f ${DEPLOY_DIR_IMAGE}/kernel.bmp ${DEPLOY_DIR_IMAGE}/${IMAGEDIR}/;" , "", d)} \
	${@bb.utils.contains("MACHINE_FEATURES", "extrasplash", "cp -f ${DEPLOY_DIR_IMAGE}/rootfs.bmp ${DEPLOY_DIR_IMAGE}/${IMAGEDIR}/;" , "", d)} \
	${@bb.utils.contains("MACHINE_FEATURES", "extrasplash", "cp -f ${DEPLOY_DIR_IMAGE}/finished.bmp ${DEPLOY_DIR_IMAGE}/${IMAGEDIR}/;" , "", d)} \
	mv -f ${IMGDEPLOYDIR}/${IMAGE_NAME}${IMAGE_NAME_SUFFIX}.ubi ${DEPLOY_DIR_IMAGE}/${IMAGEDIR}/${ROOTFS_FILE}; \
	gzip -9c ${DEPLOY_DIR_IMAGE}/vmlinux-${MACHINE}.bin > ${DEPLOY_DIR_IMAGE}/${IMAGEDIR}/${KERNEL_FILE}; \
	echo ${IMAGE_NAME} > ${DEPLOY_DIR_IMAGE}/${IMAGEDIR}/imageversion; \
	echo "https://forum.openvision.tech/app.php/donate" > ${DEPLOY_DIR_IMAGE}/${IMAGEDIR}/donate.txt; \
	${@bb.utils.contains('MACHINE', 'yh7362', \
	'echo "dont change this file" > ${DEPLOY_DIR_IMAGE}/${IMAGEDIR}/force;' , \
	'echo "rename this file to force to force an update without confirmation" > ${DEPLOY_DIR_IMAGE}/${IMAGEDIR}/noforce;', d)} \
	rm -f ${DEPLOY_DIR_IMAGE}/*.zip; \
	cd ${DEPLOY_DIR_IMAGE}; \
	zip ${IMAGE_NAME}_usb.zip ${IMAGEDIR}/*; \
	rm -f ${DEPLOY_DIR_IMAGE}/*.ubi; \
	rm -f ${DEPLOY_DIR_IMAGE}/*.ubifs; \
	rm -Rf ${IMAGEDIR}; \
	"

MACHINE_FEATURES += "alsa hdmicec switchoff blindscan-tbs videoenhancement HDMI"

# Broken bootloader can only flash around 100 MB
FLASHSIZE = "96"

BOOTLOGO_FILENAME = "splash.bin"

require conf/machine/include/tune-mips32.inc
require conf/machine/include/soc-family.inc
```

## meta-tripledot/conf/machine/include/vg5000.inc
```bitbake
require conf/machine/include/tripledot-oem.inc

MTD_ROOTFS = "mtd8"

MACHINE_ESSENTIAL_EXTRA_RDEPENDS += "\
	tripledot-dvb-modules-vg5000 \
	"

PREFERRED_PROVIDER_virtual/kernel = "linux-tripledot-vg5000"
PREFERRED_VERSION_linux-tripledot-vg5000 = "${KERNELVERSION}"

SOC_FAMILY = "bcm7362"

MKUBIFS_ARGS = "-m 2048 -e 126976 -c 4096"
UBINIZE_ARGS = "-m 2048 -p 128KiB -s 2048"

MACHINE_FEATURES += "ci 7segment textlcd AV_JACK"

STB_PLATFORM = "vg5000"
```

## meta-tripledot/conf/machine/include/yh7362.inc
```bitbake
require conf/machine/include/tripledot-oem.inc

MTD_ROOTFS = "mtd0"

MACHINE_ESSENTIAL_EXTRA_RDEPENDS += "\
	tripledot-dvb-modules-yh7362 \
	tripledot-cfe \
	"

PREFERRED_PROVIDER_virtual/kernel = "linux-tripledot-yh7362"
PREFERRED_VERSION_linux-tripledot-yh7362 = "${KERNELVERSION}"

SOC_FAMILY = "bcm7362"

MKUBIFS_ARGS = "-m 2048 -e 126976 -c 4096"
UBINIZE_ARGS = "-m 2048 -p 128KiB -s 2048"

STB_PLATFORM = "yh7362"
```

## meta-tripledot/conf/machine/mago.conf
```bitbake
#
# This is config file for Relook Mago
#

require conf/machine/include/vg5000.inc

RCNAME = "relook"
```

## meta-tripledot/conf/machine/sf108.conf
```bitbake
#
# This is config file for Octagon SF108 E2HD
#

require conf/machine/include/vg5000.inc

RCNAME = "sf108"
```

## meta-tripledot/conf/machine/sf98.conf
```bitbake
#
# This is config file for Octagon SF98
#

require conf/machine/include/yh7362.inc

RCNAME = "sf98"
RCIDNUM = "1"
```

## meta-tripledot/conf/machine/t2cable.conf
```bitbake
#
# This is config file for Evo Enfinity T2/Cable
#

MTD_ROOTFS = "mtd8"

MACHINE_ESSENTIAL_EXTRA_RDEPENDS += "\
	tripledot-dvb-modules-jj7362 \
	"

PREFERRED_PROVIDER_virtual/kernel = "linux-tripledot-jj7362"
PREFERRED_VERSION_linux-tripledot-jj7362 = "${KERNELVERSION}"

SOC_FAMILY = "bcm7362"

MKUBIFS_ARGS = "-m 2048 -e 126976 -c 4096"
UBINIZE_ARGS = "-m 2048 -p 128KiB -s 2048"

MACHINE_FEATURES += "dvb-c 7segment textlcd AV_JACK"

require conf/machine/include/tripledot-oem.inc

RCNAME = "evo4"
```
