## meta-sh4/conf/machine/hs7819.conf
```bitbake
require conf/machine/include/hs.inc
require conf/machine/include/ird-ubi-image.inc

MTD_KERNEL = "mtd1"
MTD_ROOTFS = "mtd2"

MACHINE_FEATURES += "SCART RCA"

MACHINE_ESSENTIAL_EXTRA_RDEPENDS += "\
	enigma2-plugin-extensions-hs7810avfd \
	"

CAN_USE_ENIGMA2_IN_FLASH = "1"

RESELLERID = "271520A0"

RCTYPE = "8"
```

## meta-sh4/conf/machine/include/atemio.inc
```bitbake
require conf/machine/include/oem-sh4.inc
require conf/machine/include/normal-sh4-image.inc
require conf/machine/include/sh4-jffs2.inc

BOX_BRAND = "atemio"

MTD_KERNEL = "mtd1"
MTD_ROOTFS = "mtd2"

PREFERRED_PROVIDER_virtual/kernel = "linux-sh4-hs"

ROOTFS_FILE = "root.img"
KERNEL_FILE = "uImage"

IMAGE_FSTYPES += "tar.gz"

AUDIOELF = "audio_7111.elf"
VIDEOELF = "video_7111.elf"

SOC_FAMILY = "sti7111"

MACHINE_ESSENTIAL_EXTRA_RDEPENDS += "\
	fp-control \
	kernel-module-zram \
	stlinux24-sh4-stmfb-firmware-stx7111 \
	stlinux24-sh4-stx7111-fdma-firmware \
	"

MACHINE_FEATURES += "hdmicec ci smallflash SCART RCA YUV nofhdskin"

CAN_USE_ENIGMA2_IN_FLASH = "1"
```

## meta-sh4/conf/machine/include/cuberevo.inc
```bitbake
require conf/machine/include/oem-sh4.inc
require conf/machine/include/normal-sh4-image.inc

BOX_BRAND = "cuberevo"

MTD_KERNEL = "mtd3"
MTD_ROOTFS = "mtd4"

PREFERRED_PROVIDER_virtual/kernel = "linux-sh4-${BOX_BRAND}"

IMAGE_FSTYPES = "tar.gz"

AUDIOELF = "audio_7100.elf"
VIDEOELF = "video_7109.elf"

SOC_FAMILY = "sti7109"

DVB1FIRMWARE = "dvb-fe-cx24116.fw"
DVB2FIRMWARE = "dvb-fe-stv6306.fw"

MACHINE_ESSENTIAL_EXTRA_RDEPENDS += "\
	enigma2-plugin-extensions-cuberevovfd \
	firmware-sh4 \
	fp-control \
	ipbox-eeprom \
	stlinux24-sh4-stx7109-fdma-firmware \
	"

MACHINE_FEATURES += "ci middleflash SCART"

EXTRA_OECONF_append_pn-enigma2 = " --with-cuberevostb"

CAN_USE_ENIGMA2_IN_FLASH = "0"

RCTYPE = "13"
RCNAME = "cuberevo_uni"
```

## meta-sh4/conf/machine/include/duolabs.inc
```bitbake
require conf/machine/include/oem-sh4.inc
require conf/machine/include/normal-sh4-image.inc
require conf/machine/include/sh4-jffs2.inc

BOX_BRAND = "duolabs"

PREFERRED_PROVIDER_virtual/kernel = "linux-sh4-${BOX_BRAND}"

ROOTFS_FILE = "root.img"
KERNEL_FILE = "uImage"

IMAGE_FSTYPES = "tar.gz"

MACHINE_FEATURES += "ci smallflash RCA SCART"

AUDIOELF = "audio_7100.elf"
VIDEOELF = "video_7100.elf"

SOC_FAMILY = "sti7100"

MACHINE_ESSENTIAL_EXTRA_RDEPENDS += "\
	firmware-sh4 \
	kernel-module-zram \
	stlinux24-sh4-stx7100-fdma-firmware \
	stlirc \
	"

CAN_USE_ENIGMA2_IN_FLASH = "0"
```

## meta-sh4/conf/machine/include/edisionargus.inc
```bitbake
require conf/machine/include/oem-sh4.inc
require conf/machine/include/normal-sh4-image.inc

BOX_BRAND = "edisionargus"

PREFERRED_PROVIDER_virtual/kernel = "linux-sh4-${BOX_BRAND}"

IMAGE_FSTYPES += "tar.gz"

AUDIOELF = "audio_7100.elf"
VIDEOELF = "video_7109.elf"

SOC_FAMILY = "sti7109"

MACHINE_ESSENTIAL_EXTRA_RDEPENDS += "\
	fp-control \
	stlinux24-sh4-stx7109-fdma-firmware \
	stlirc \
	"

MACHINE_FEATURES += "ci middleflash RCA YUV SCART"

CAN_USE_ENIGMA2_IN_FLASH = "1"

RCTYPE = "17"
RCNAME = "vip_1"
```

## meta-sh4/conf/machine/include/forever.inc
```bitbake
require conf/machine/include/oem-sh4.inc
require conf/machine/include/ird-ubi-image.inc

BOX_BRAND = "forever"

PREFERRED_PROVIDER_virtual/kernel = "linux-sh4-${BOX_BRAND}"

ROOTFS_FILE = "root.img"
KERNEL_FILE = "uImage"

IMAGE_FSTYPES += "tar.gz"

AUDIOELF = "companion_h205_audio.bin"
VIDEOELF = "companion_h205_video_Ax.bin"
VIDEOELF2 = "companion_h205_video_Bx.bin"

SOC_FAMILY = "stih205"

MACHINE_ESSENTIAL_EXTRA_RDEPENDS += "\
	kernel-module-scsi-wait-scan \
	stlinux24-sh4-stmfb-firmware-stxh205 \
	stlinux24-sh4-stxh205-fdma-firmware \
	stlinux24-sh4-stxh205-fdma-firmware-extra \
	stlirc \
	"

MACHINE_FEATURES += "hdmicec 4thgsh4 resellerid"

CAN_USE_ENIGMA2_IN_FLASH = "1"

RCTYPE = "22"
RCNAME = "hs9510"
```

## meta-sh4/conf/machine/include/hs.inc
```bitbake
require conf/machine/include/oem-sh4.inc

BOX_BRAND = "hs"

PREFERRED_PROVIDER_virtual/kernel = "linux-sh4-hs"

ROOTFS_FILE = "root.img"
KERNEL_FILE = "uImage"

AUDIOELF = "audio_7111.elf"
VIDEOELF = "video_7111.elf"

SOC_FAMILY = "sti7111"

MACHINE_ESSENTIAL_EXTRA_RDEPENDS += "\
	flash-tools \
	fortis-eeprom \
	fp-control \
	kernel-module-zram \
	stlinux24-sh4-stmfb-firmware-stx7111 \
	stlinux24-sh4-stx7111-fdma-firmware \
	"

MACHINE_FEATURES += "hdmicec ci resellerid"

RCNAME ?= "hs9510"
```

## meta-sh4/conf/machine/include/ipbox.inc
```bitbake
require conf/machine/include/oem-sh4.inc
require conf/machine/include/normal-sh4-image.inc
require conf/machine/include/sh4-jffs2.inc

BOX_BRAND = "ipbox"

PREFERRED_PROVIDER_virtual/kernel = "linux-sh4-cuberevo"

ROOTFS_FILE = "root.img"
KERNEL_FILE = "uImage"

IMAGE_FSTYPES = "tar.gz"

AUDIOELF = "audio_7100.elf"
VIDEOELF = "video_7109.elf"

SOC_FAMILY = "sti7109"

MACHINE_ESSENTIAL_EXTRA_RDEPENDS += "\
	ipbox-eeprom \
	kernel-module-zram \
	stlinux24-sh4-stx7109-fdma-firmware \
	stlirc \
	"

MACHINE_FEATURES += "ci smallflash SCART"

CAN_USE_ENIGMA2_IN_FLASH = "0"

RCNAME = "cuberevo_uni"
```

## meta-sh4/conf/machine/include/ird-jffs2-image.inc
```bitbake
MACHINE_FEATURES += "smallflash"

MACHINE_ESSENTIAL_EXTRA_RDEPENDS += "\
	forever-logo-cfe \
	"

do_image_jffs2[depends] += "fup-native:do_populate_sysroot"

IMAGE_CMD_jffs2_append = " \
	; \
	while [ ! -s ${IMGDEPLOYDIR}/${IMAGE_NAME}${IMAGE_NAME_SUFFIX}.jffs2 ]; do sleep 1; done ; \
	cp -f ${IMGDEPLOYDIR}/${IMAGE_NAME}${IMAGE_NAME_SUFFIX}.jffs2 ${DEPLOY_DIR_IMAGE}/${IMAGE_NAME}${IMAGE_NAME_SUFFIX}.jffs2; \
	mkdir -p ${DEPLOY_DIR_IMAGE}/${IMAGEDIR}; \
	while [ ! -s ${DEPLOY_DIR_IMAGE}/${IMAGE_NAME}${IMAGE_NAME_SUFFIX}.jffs2 ]; do sleep 1; done ; \
	mv -f ${DEPLOY_DIR_IMAGE}/${IMAGE_NAME}${IMAGE_NAME_SUFFIX}.jffs2 ${DEPLOY_DIR_IMAGE}/${IMAGEDIR}/${ROOTFS_FILE}; \
	cp -f ${DEPLOY_DIR_IMAGE}/uImage ${DEPLOY_DIR_IMAGE}/${IMAGEDIR}/${KERNEL_FILE}; \
	rm -f ${DEPLOY_DIR_IMAGE}/*.zip; \
	rm -f ${DEPLOY_DIR_IMAGE}/*.ird; \
	cd ${DEPLOY_DIR_IMAGE}; \
	if [ -e ${DEPLOY_DIR_IMAGE}/bootscreen.gz ]; then \
		fup -c ${IMAGEDIR}/e2-R${RESELLERID}.ird -1 ${IMAGEDIR}/${ROOTFS_FILE} -6 ${IMAGEDIR}/${KERNEL_FILE} -9 bootscreen.gz; \
	else \
		fup -c ${IMAGEDIR}/e2-R${RESELLERID}.ird -1 ${IMAGEDIR}/${ROOTFS_FILE} -6 ${IMAGEDIR}/${KERNEL_FILE}; \
	fi; \
	fup -r ${IMAGEDIR}/e2-R${RESELLERID}.ird ${RESELLERID}; \
	fup -n ${IMAGEDIR}/e2-R${RESELLERID}.ird 100200; \
	fup -i ${IMAGEDIR}/e2-R${RESELLERID}.ird > ${IMAGEDIR}/e2-R${RESELLERID}-info.txt; \
	echo ${IMAGE_NAME} > ${IMAGEDIR}/imageversion; \
	echo "https://forum.openvision.tech/app.php/donate" > ${IMAGEDIR}/donate.txt; \
	zip ${IMAGE_NAME}_ird.zip ${IMAGEDIR}/e2-R${RESELLERID}.ird ${IMAGEDIR}/e2-R${RESELLERID}-info.txt ${IMAGEDIR}/imageversion ${IMAGEDIR}/donate.txt; \
	rm -f ${IMAGEDIR}/*.ird; \
	rm -f ${IMAGEDIR}/*.txt; \
	echo "https://forum.openvision.tech/app.php/donate" > ${IMAGEDIR}/donate.txt; \
	zip ${IMAGE_NAME}_usb.zip ${IMAGEDIR}/*; \
	rm -f ${DEPLOY_DIR_IMAGE}/*.jffs2; \
	rm -rf ${IMAGEDIR}; \
	"

# There's this magic limit in ird names that we can't use our complete name so I used e2-R${RESELLERID} to make it work.
# As we're using zip files with our complete name so we could ignore the ird name.
```

## meta-sh4/conf/machine/include/ird-ubi-image.inc
```bitbake
MACHINE_FEATURES += "smallflash"

inherit image_types_sh4ubi

MKUBIFS_ARGS = "${@bb.utils.contains("MACHINE_FEATURES", "4thgsh4", "-m 2048 -e 129024 -c 1456 -x zlib -U", "-m 2048 -e 129024 -c 768 -x zlib -U", d)}"
UBINIZE_ARGS = "-m 2048 -p 128KiB -s 512 -x 1"

UBINIZE_DATAVOLSIZE = "${@bb.utils.contains("MACHINE_FEATURES", "4thgsh4", "179601408", "94961664", d)}"

EXTRA_IMAGECMD_COMPAT = " --eraseblock=0x20000 -n -l "

MACHINE_ESSENTIAL_EXTRA_RDEPENDS += "\
	forever-logo-cfe \
	mtd-utils-ubifs \
	"
```

## meta-sh4/conf/machine/include/kathrein.inc
```bitbake
require conf/machine/include/oem-sh4.inc
require conf/machine/include/normal-sh4-image.inc
require conf/machine/include/sh4-jffs2.inc

BOX_BRAND = "kathrein"

ROOTFS_FILE = "root.img"
KERNEL_FILE = "uImage"

IMAGE_FSTYPES = "tar.gz"

MACHINE_ESSENTIAL_EXTRA_RDEPENDS += "\
	fp-control \
	kernel-module-zram \
	"

MACHINE_FEATURES += "RCA YUV SCAR"
```

## meta-sh4/conf/machine/include/libeplayer-sh4.inc
```bitbake
# enable/disable your preferred mediaservice
# servicemp3epl = mixed solution gst/exteplayer3
# servicesh4 = pure libeplayer3 (ffmpeg without gst)
PREFERRED_PROVIDER_virtual/enigma2-mediaservice = "enigma2-plugin-systemplugins-servicesh4"

# add libeplayer MACHINE_FEATURES if mediaservice is servicesh4
# delete libeplayer MACHINE_FEATURES if mediaservice is servicemp3epl
MACHINE_FEATURES += "libeplayer"

# add this MACHINE_EXTRA_PRECOMMENDS if mediaservice is servicesh4
# delete this MACHINE_EXTRA_PRECOMMENDS if mediaservice is servicemp3epl
MACHINE_EXTRA_RRECOMMENDS += "\
	enigma2-plugin-systemplugins-servicesh4 \
	"
```

## meta-sh4/conf/machine/include/nbox.inc
```bitbake
require conf/machine/include/oem-sh4.inc
require conf/machine/include/normal-sh4-image.inc
require conf/machine/include/sh4-jffs2.inc

BOX_BRAND = "nbox"

ROOTFS_FILE = "root.img"
KERNEL_FILE = "uImage"

IMAGE_FSTYPES += "tar.gz"

MACHINE_FEATURES += "hdmicec ci smallflash YUV"

MACHINE_ESSENTIAL_EXTRA_RDEPENDS += "\
	enigma2-plugin-extensions-adbvfd \
	firmware-sh4 \
	kernel-module-zram \
	stlirc \
	"

CAN_USE_ENIGMA2_IN_FLASH = "1"

RCTYPE = "15"
RCNAME = "adb_xmp"
```

## meta-sh4/conf/machine/include/normal-sh4-image.inc
```bitbake
IMAGE_CMD_jffs2_append = " \
	; \
	while [ ! -s ${IMGDEPLOYDIR}/${IMAGE_NAME}${IMAGE_NAME_SUFFIX}.jffs2 ]; do sleep 1; done ; \
	cp -f ${IMGDEPLOYDIR}/${IMAGE_NAME}${IMAGE_NAME_SUFFIX}.jffs2 ${DEPLOY_DIR_IMAGE}/${IMAGE_NAME}${IMAGE_NAME_SUFFIX}.jffs2; \
	mkdir -p ${DEPLOY_DIR_IMAGE}/${IMAGEDIR}; \
	while [ ! -s ${DEPLOY_DIR_IMAGE}/${IMAGE_NAME}${IMAGE_NAME_SUFFIX}.jffs2 ]; do sleep 1; done ; \
	mv -f ${DEPLOY_DIR_IMAGE}/${IMAGE_NAME}${IMAGE_NAME_SUFFIX}.jffs2 ${DEPLOY_DIR_IMAGE}/${IMAGEDIR}/${ROOTFS_FILE}; \
	cp -f ${DEPLOY_DIR_IMAGE}/uImage ${DEPLOY_DIR_IMAGE}/${IMAGEDIR}/${KERNEL_FILE}; \
	echo ${IMAGE_NAME} > ${DEPLOY_DIR_IMAGE}/${IMAGEDIR}/imageversion; \
	echo "https://forum.openvision.tech/app.php/donate" > ${DEPLOY_DIR_IMAGE}/${IMAGEDIR}/donate.txt; \
	rm -f ${DEPLOY_DIR_IMAGE}/*.zip; \
	cd ${DEPLOY_DIR_IMAGE}; \
	zip ${IMAGE_NAME}_usb.zip ${IMAGEDIR}/*; \
	rm -f ${DEPLOY_DIR_IMAGE}/*.jffs2; \
	rm -rf ${IMAGEDIR}; \
	"

IMAGE_CMD_ubi_append = " \
	while [ ! -s ${IMGDEPLOYDIR}/${IMAGE_NAME}${IMAGE_NAME_SUFFIX}.ubi ]; do sleep 1; done ; \
	cp -f ${IMGDEPLOYDIR}/${IMAGE_NAME}${IMAGE_NAME_SUFFIX}.ubi ${DEPLOY_DIR_IMAGE}/${IMAGE_NAME}${IMAGE_NAME_SUFFIX}.ubi; \
	mkdir -p ${DEPLOY_DIR_IMAGE}/${IMAGEDIR}; \
	while [ ! -s ${DEPLOY_DIR_IMAGE}/${IMAGE_NAME}${IMAGE_NAME_SUFFIX}.ubi ]; do sleep 1; done ; \
	mv -f ${DEPLOY_DIR_IMAGE}/${IMAGE_NAME}${IMAGE_NAME_SUFFIX}.ubi ${DEPLOY_DIR_IMAGE}/${IMAGEDIR}/${ROOTFS_FILE}; \
	cp -f ${DEPLOY_DIR_IMAGE}/uImage ${DEPLOY_DIR_IMAGE}/${IMAGEDIR}/${KERNEL_FILE}; \
	echo ${IMAGE_NAME} > ${DEPLOY_DIR_IMAGE}/${IMAGEDIR}/imageversion; \
	echo "https://forum.openvision.tech/app.php/donate" > ${DEPLOY_DIR_IMAGE}/${IMAGEDIR}/donate.txt; \
	rm -f ${DEPLOY_DIR_IMAGE}/*.zip; \
	cd ${DEPLOY_DIR_IMAGE}; \
	zip ${IMAGE_NAME}_usb.zip ${IMAGEDIR}/*; \
	rm -f ${DEPLOY_DIR_IMAGE}/*.ubi; \
	rm -f ${DEPLOY_DIR_IMAGE}/*.ubifs; \
	rm -rf ${IMAGEDIR}; \
	"
```

## meta-sh4/conf/machine/include/oem-sh4.inc
```bitbake
# We know about rtc
MACHINE_FEATURES_BACKFILL_CONSIDERED += "rtc"

require conf/machine/include/libeplayer-sh4-condition.inc

KERNELVERSION = "2.6.32"

IMAGEDIR = "enigma2"

KERNEL_MODULE_PACKAGE_SUFFIX = ""

TARGET_ARCH = "sh4"
DEFAULTTUNE = "sh4"

GCCVERSION_sh4 = "4.9.4"
GLIBCVERSION_sh4 = "2.25"

HOSTTOOLS_NONFATAL += "whoami"

OLDEST_KERNEL = "${KERNELVERSION}"
PREFERRED_VERSION_kernel-module-extrawlan-rt8812au = "4.3.14"
PREFERRED_VERSION_directfb = "1.7.7"
PREFERRED_PROVIDER_virtual/egl = "libstgles"
PREFERRED_PROVIDER_virtual/libgles1 = "libstgles"
PREFERRED_PROVIDER_virtual/enigma2-mediaservice = "enigma2-plugin-systemplugins-servicemp3epl"

SERIAL_CONSOLE = "115200 ttyAS0"

DVBPROVIDER = "kernel"

MACHINE_FEATURES += "alsa ext2 usbhost serial dvb-c switchoff textlcd usbconsole sh4stb ${MACHINE} HDMI"

DISTRO_FEATURES_append = " libsigc2"

KERNEL_IMAGETYPE = "uImage"

DVBMEDIASINK_CONFIG = "--with-wma --with-wmv --with-pcm --with-dtsdownmix --with-eac3"

# Add uImage in tar image boot directory
IMAGE_CMD_tar_prepend = "\
    cp -f ${DEPLOY_DIR_IMAGE}/uImage ${IMAGE_ROOTFS}/boot/${KERNEL_FILE}; \
    "
	
MACHINE_ESSENTIAL_EXTRA_RDEPENDS += "\
	devinit \
	evremote2 \
	sh4-dvb-modules \
	stfbcontrol \
	stslave-fw \
	ustslave \
	wait4button \
	libpcre \
	"

EXTRA_IMAGEDEPENDS += "\
	libpcre \
	"

require conf/machine/include/tune-sh4.inc
require conf/machine/include/soc-family.inc

EXTRA_OECONF_append_pn-enigma2 = " --with-sh4stb"
```

## meta-sh4/conf/machine/include/sh4-jffs2.inc
```bitbake
IMAGE_FSTYPES = "jffs2"

JFFS2_ERASEBLOCK = "0x20000"
JFFS2_ENDIANNESS = "${@oe.utils.conditional('SITEINFO_ENDIANNESS', 'le', '--little-endian', '--big-endian', d)}"
EXTRA_IMAGECMD_jffs2 = "--pad ${JFFS2_ENDIANNESS} --eraseblock=${JFFS2_ERASEBLOCK} --no-cleanmarkers"

MACHINE_ESSENTIAL_EXTRA_RDEPENDS += "\
	mtd-utils-jffs2 \
	"

IMAGE_CMD_jffs2_prepend = "\
	rm -rf ${IMAGE_ROOTFS}/tmp/*; \
	"
```

## meta-sh4/conf/machine/include/sh4-ubi.inc
```bitbake
IMAGE_FSTYPES = "ubi"

MKUBIFS_ARGS = "-m 2048 -e 129024 -c 768 -x zlib -U"
UBINIZE_ARGS = "-m 2048 -p 128KiB -s 512 -x 1"

EXTRA_IMAGECMD_COMPAT = " --eraseblock=0x20000 -n -l "

MACHINE_ESSENTIAL_EXTRA_RDEPENDS += "\
	mtd-utils-ubifs \
	"

IMAGE_CMD_ubifs_prepend = " \
	rm -rf ${IMAGE_ROOTFS}/tmp/*; \
	"
```

## meta-sh4/conf/machine/include/spark.inc
```bitbake
require conf/machine/include/oem-sh4.inc
require conf/machine/include/normal-sh4-image.inc
require conf/machine/include/sh4-jffs2.inc

BOX_BRAND = "fulan"

MTD_KERNEL = "mtd5"
MTD_ROOTFS = "mtd6"

PREFERRED_PROVIDER_virtual/kernel = "linux-sh4-${MACHINE}"

ROOTFS_FILE = "e2jffs2.img"
KERNEL_FILE = "uImage"

IMAGE_FSTYPES += "tar.gz"

MACHINE_ESSENTIAL_EXTRA_RDEPENDS += "\
	enigma2-plugin-extensions-${MACHINE}vfd \
	flash-tools \
	fp-control \
	kernel-module-zram \
	mount-sh4 \
	stlirc \
	"

MACHINE_FEATURES += "hdmicec ci directfb sh4booster SCART RCA"

DISTRO_FEATURES_append = " gtk-directfb"

CAN_USE_ENIGMA2_IN_FLASH = "1"

RCTYPE = "10"

IMAGE_CLASSES += "usb_image-sh4"

INITRAMFS_FSTYPES =  "ext2.gz sh4updt"
```

## meta-sh4/conf/machine/octagon1008.conf
```bitbake
require conf/machine/include/oem-sh4.inc
require conf/machine/include/normal-sh4-image.inc
require conf/machine/include/sh4-jffs2.inc

BOX_BRAND = "octagon"

PREFERRED_PROVIDER_virtual/kernel = "linux-sh4-edisionargus"

ROOTFS_FILE = "root.img"
KERNEL_FILE = "uImage"

IMAGE_FSTYPES = "tar.gz"

MACHINE_FEATURES += "ci smallflash RCA YUV resellerid"

AUDIOELF = "audio_7100.elf"
VIDEOELF = "video_7109.elf"

SOC_FAMILY = "sti7109"

DVB1FIRMWARE = "dvb-fe-avl2108.fw"
DVB2FIRMWARE = "dvb-fe-stv6306.fw"

MACHINE_ESSENTIAL_EXTRA_RDEPENDS += "\
	enigma2-plugin-extensions-hs9510vfd \
	firmware-sh4 \
	fp-control \
	kernel-module-zram \
	stlinux24-sh4-stx7109-fdma-firmware \
	"

CAN_USE_ENIGMA2_IN_FLASH = "0"

RESELLERID = "20220302"

RCNAME = "hs9510"
```
