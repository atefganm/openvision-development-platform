## meta-sh4/conf/machine/pace7241.conf
```bitbake
require conf/machine/include/oem-sh4.inc
require conf/machine/include/normal-sh4-image.inc
require conf/machine/include/sh4-jffs2.inc

BOX_BRAND = "pace"

PREFERRED_PROVIDER_virtual/kernel = "linux-sh4-${BOX_BRAND}"

ROOTFS_FILE = "root.img"
KERNEL_FILE = "uImage"

IMAGE_FSTYPES += "tar.gz"

MACHINE_FEATURES += "hdmicec fan ci smallflash SCART nofhdskin"

AUDIOELF = "audio_7105.elf"
VIDEOELF = "video_7105.elf"

SOC_FAMILY = "sti7105"

MACHINE_ESSENTIAL_EXTRA_RDEPENDS += "\
	enigma2-plugin-extensions-${MACHINE}vfd \
	firmware-sh4 \
	kernel-module-zram \
	stlinux24-sh4-stmfb-firmware-stx7105 \
	stlinux24-sh4-stx7105-fdma-firmware \
	stlirc \
	"

CAN_USE_ENIGMA2_IN_FLASH = "1"

RCTYPE = "16"
RCNAME = "pace7241"
```

## meta-sh4/conf/machine/qboxhd.conf
```bitbake
require conf/machine/include/duolabs.inc

MACHINE_FEATURES += "YUV"

RCNAME = "qbox"
RCIDNUM = "0"
```
