## meta-tripledot/conf/machine/tyrant.conf
```bitbake
#
# This is config file for Tripledot Tyrant
#

MTD_ROOTFS = "mtd8"

MACHINE_ESSENTIAL_EXTRA_RDEPENDS += "\
	tripledot-dvb-modules-vg1000 \
	"

PREFERRED_PROVIDER_virtual/kernel = "linux-tripledot-vg1000"
PREFERRED_VERSION_linux-tripledot-vg1000 = "${KERNELVERSION}"

SOC_FAMILY = "bcm7356"

MKUBIFS_ARGS = "-m 2048 -e 126976 -c 4096"
UBINIZE_ARGS = "-m 2048 -p 128KiB -s 2048"

MACHINE_FEATURES += "dvb-c ci textlcd AV_JACK"

require conf/machine/include/tripledot-oem.inc

RCNAME = "tyrant"
```

## meta-tripledot/conf/machine/x1plus.conf
```bitbake
#
# This is config file for Evo EnfinityX 1Plus
#

require conf/machine/include/vg5000.inc

RCNAME = "evo3"
```

## meta-tripledot/conf/machine/xcombo.conf
```bitbake
#
# This is config file for Evo EnfinityX Combo Plus
#

MTD_ROOTFS = "mtd8"

MACHINE_ESSENTIAL_EXTRA_RDEPENDS += "\
	tripledot-dvb-modules-vg2000 \
	"

PREFERRED_PROVIDER_virtual/kernel = "linux-tripledot-vg2000"
PREFERRED_VERSION_linux-tripledot-vg2000 = "${KERNELVERSION}"

SOC_FAMILY = "bcm7362"

MKUBIFS_ARGS = "-m 2048 -e 126976 -c 4096"
UBINIZE_ARGS = "-m 2048 -p 128KiB -s 2048"

MACHINE_FEATURES += "ci 7segment textlcd AV_JACK"

require conf/machine/include/tripledot-oem.inc

RCNAME = "evo3"
```

## meta-uclan/conf/machine/ustym4kpro.conf
```bitbake
#@TYPE: Machine
#@NAME: Uclan Ustym 4K PRO
#@DESCRIPTION: Machine configuration for Uclan Ustym 4K PRO

require conf/machine/include/uclan-hisi.inc
```

## meta-xcore/conf/machine/include/xcore-arm.inc
```bitbake
require conf/machine/include/xcore-oem.inc

TARGET_ARCH = "arm"
DEFAULTTUNE = "cortexa15hf-neon-vfpv4"
require conf/machine/include/tune-cortexa15.inc

MTD_BOOTFS = "mmcblk1p1"
MTD_BLACK  = "mmcblk1"

SOC_FAMILY = "bcm7439"

require conf/machine/include/soc-family.inc

DVBMEDIASINK_CONFIG = "--with-wma --with-wmv --with-pcm --with-dts --with-eac3 --with-h265 --with-vb6 --with-vb8 --with-vb9 --with-spark"

IMAGE_FSTYPES ?= "${@bb.utils.contains('MACHINE_FEATURES', 'emmc', 'xcoreemmc', 'ubi', d)}"

MACHINE_FEATURES += "videoenhancement bluetooth textlcd dvb-c blindscan-tbs ci mountboot"

KERNEL_IMAGETYPE = "zImage"
KERNEL_CONSOLE = "ttyS0,115200n8"

GLIBC_EXTRA_OECONF = "--with-tls --with-__thread"

MACHINE_ESSENTIAL_EXTRA_RDEPENDS += "\
	firmware-rtl8723b \
	"

IMAGE_CLASSES += "image_types_xcore"
IMAGE_ROOTFS_SIZE ?= "294912"

IMAGE_CMD_xcoreemmc_append = " \
	mkdir -p ${DEPLOY_DIR_IMAGE}/${IMAGEDIR}; \
	mv -f ${DEPLOY_DIR_IMAGE}/${IMAGE_NAME}${IMAGE_NAME_SUFFIX}.emmc ${DEPLOY_DIR_IMAGE}/${IMAGEDIR}/emmc.img; \
	cd ${IMAGE_ROOTFS}; \
	tar -cvf ${DEPLOY_DIR_IMAGE}/rootfs.tar -C ${IMAGE_ROOTFS} .; \
	mv -f ${DEPLOY_DIR_IMAGE}/rootfs.tar ${DEPLOY_DIR_IMAGE}/${IMAGEDIR}/rootfs.tar; \
	bzip2 ${DEPLOY_DIR_IMAGE}/${IMAGEDIR}/rootfs.tar; \
	cp -f ${DEPLOY_DIR_IMAGE}/zImage ${DEPLOY_DIR_IMAGE}/${IMAGEDIR}/${KERNEL_FILE}; \
	echo ${IMAGE_NAME} > ${DEPLOY_DIR_IMAGE}/${IMAGEDIR}/imageversion; \
	echo "https://forum.openvision.tech/app.php/donate" > ${DEPLOY_DIR_IMAGE}/${IMAGEDIR}/donate.txt; \
	echo "rename this file to 'force' to force an update without confirmation" > ${DEPLOY_DIR_IMAGE}/${IMAGEDIR}/noforce; \
	rm -f ${DEPLOY_DIR_IMAGE}/*.zip; \
	cd ${DEPLOY_DIR_IMAGE}; \
	zip ${IMAGE_NAME}_usb.zip ${IMAGEDIR}/*; \
	rm -f ${DEPLOY_DIR_IMAGE}/*.ext4; \
	rm -Rf ${IMAGEDIR}; \
	"

IMAGE_CMD_prepend = "\
	rm -Rf ${IMAGE_ROOTFS}/tmp/*; \
	"

# new 2 GB Flash Model
MKUBIFS_ARGS = "-m 4096 -e 1040384 -c 2048 -F"
UBINIZE_ARGS = "-m 4096 -p 1024KiB"

IMAGE_CMD_ubifs_prepend = "\
	rm -rf ${IMAGE_ROOTFS}/boot/*; \
	rm -rf ${IMAGE_ROOTFS}/tmp/*; \
	"

IMAGE_CMD_ubi_append = " \
	mkdir -p ${DEPLOY_DIR_IMAGE}/${IMAGEDIR}; \
	mv -f ${IMGDEPLOYDIR}/${IMAGE_NAME}${IMAGE_NAME_SUFFIX}.ubi ${DEPLOY_DIR_IMAGE}/${IMAGEDIR}/${ROOTFS_FILE}; \
	cp -f ${DEPLOY_DIR_IMAGE}/${KERNEL_IMAGETYPE}-${MACHINE}.bin ${DEPLOY_DIR_IMAGE}/${IMAGEDIR}/${KERNEL_FILE}; \
	echo ${IMAGE_NAME} > ${DEPLOY_DIR_IMAGE}/${IMAGEDIR}/imageversion; \
	echo "https://forum.openvision.tech/app.php/donate" > ${DEPLOY_DIR_IMAGE}/${IMAGEDIR}/donate.txt; \
	echo "rename this file to 'force' to force an update without confirmation" > ${DEPLOY_DIR_IMAGE}/${IMAGEDIR}/noforce; \
	rm -f ${DEPLOY_DIR_IMAGE}/*.zip; \
	cd ${DEPLOY_DIR_IMAGE}; \
	zip ${IMAGE_NAME}_usb.zip ${IMAGEDIR}/*; \
	rm -f ${DEPLOY_DIR_IMAGE}/*.ubi; \
	rm -f ${DEPLOY_DIR_IMAGE}/*.ubifs; \
	rm -Rf ${IMAGEDIR}; \
	"

STB_PLATFORM = "4kspycat"
```

## meta-xcore/conf/machine/include/xcore-mipsel.inc
```bitbake
require conf/machine/include/xcore-oem.inc

TARGET_ARCH = "mipsel"
DEFAULTTUNE = "mips32el"
require conf/machine/include/tune-mips32.inc

SOC_FAMILY = "bcm7362"

PREFERRED_VERSION_linux-xcore = "4.11"

MKUBIFS_ARGS = "-m 2048 -e 126976 -c 4096 -F"
UBINIZE_ARGS = "-m 2048 -p 128KiB"

MTD_KERNEL = "mtd0"
MTD_ROOTFS = "mtd2"

KERNEL_IMAGETYPE = "vmlinux.gz"
KERNEL_CONSOLE = "ttyS0,115200n8"

ROOTFS_FILE = "rootfs.bin"

DVBMEDIASINK_CONFIG = "--with-wma --with-wmv --with-pcm --with-dts --with-eac3"

require conf/machine/include/soc-family.inc

MACHINE_FEATURES += "videoenhancement osdposition bluetooth blindscan-dvbc dvb-c blindscan-tbs"

IMAGE_FSTYPES ?= "ubi"

IMAGE_CMD_ubifs_prepend = "\
	rm -rf ${IMAGE_ROOTFS}/boot/*; \
	rm -rf ${IMAGE_ROOTFS}/tmp/*; \
	"

IMAGE_CMD_ubi_append = " \
	mkdir -p ${DEPLOY_DIR_IMAGE}/${IMAGEDIR}; \
	mv -f ${IMGDEPLOYDIR}/${IMAGE_NAME}${IMAGE_NAME_SUFFIX}.ubi ${DEPLOY_DIR_IMAGE}/${IMAGEDIR}/${ROOTFS_FILE}; \
	cp -f ${DEPLOY_DIR_IMAGE}/${KERNEL_IMAGETYPE}-${MACHINE}.bin ${DEPLOY_DIR_IMAGE}/${IMAGEDIR}/${KERNEL_FILE}; \
	echo ${IMAGE_NAME} > ${DEPLOY_DIR_IMAGE}/${IMAGEDIR}/imageversion; \
	echo "https://forum.openvision.tech/app.php/donate" > ${DEPLOY_DIR_IMAGE}/${IMAGEDIR}/donate.txt; \
	echo "rename this file to 'force' to force an update without confirmation" > ${DEPLOY_DIR_IMAGE}/${IMAGEDIR}/noforce; \
	cd ${DEPLOY_DIR_IMAGE}; \
	zip ${IMAGE_NAME}_usb.zip ${IMAGEDIR}/*; \
	rm -f ${DEPLOY_DIR_IMAGE}/*.ubi; \
	rm -f ${DEPLOY_DIR_IMAGE}/*.ubifs; \
	rm -Rf ${IMAGEDIR}; \
	"

STB_PLATFORM = "mipsspycat"
```

## meta-xcore/conf/machine/include/xcore-oem.inc
```bitbake
# We know about rtc
MACHINE_FEATURES_BACKFILL_CONSIDERED += "rtc"

KERNELVERSION = "4.11"

BOX_BRAND = "xcore"

KERNEL_FILE = "kernel.bin"

DVBPROVIDER = "kernel"
DVBSKYPROVIDER = "kernel"

MACHINE_ESSENTIAL_EXTRA_RDEPENDS += "\
	xcore-dvb-modules-${MACHINE} \
	kernel-module-extrawlan-rt8723bs \
	firmware-rtl8723bs \
	kernel-module-hci-uart \
	gstreamer1.0-plugin-dvbmediasink \
	gstreamer1.0-libav \
	"

PREFERRED_PROVIDER_virtual/blindscan-dvbs = "xcore-blindscan-utils"
PREFERRED_PROVIDER_virtual/blindscan-dvbc = "xcore-blindscan-utils"

PREFERRED_PROVIDER_virtual/kernel = "linux-xcore"
PREFERRED_VERSION_linux-xcore = ${KERNELVERSION}"

MACHINE_FEATURES += "alsa switchoff hdmicec HDMI"

BOOTLOGO_FILENAME = "splash.bin"

KERNEL_MODULE_AUTOLOAD += "\
	r8723bs \
	hci_uart \
	"

RCNAME = "xcore1"
```

## meta-xcore/conf/machine/spycat.conf
```bitbake
#@TYPE: Machine
#@NAME: spycat
#@DESCRIPTION: Machine configuration for SpyCat

require conf/machine/include/xcore-mipsel.inc

MACHINE_FEATURES += "ci textlcd vfdsymbol"
```

## meta-xcore/conf/machine/spycat4k.conf
```bitbake
#
# This is config file for SpyCat 4K
#

require conf/machine/include/xcore-arm.inc

MACHINE_FEATURES += "mmc emmc swap mountboot"

KERNEL_MODULE_AUTOLOAD += "wlan"

MTD_KERNEL = "mmcblk1p2"
MTD_ROOTFS = "mmcblk1p3"

ROOTFS_FILE = "rootfs.tar.bz2"

MACHINE_ESSENTIAL_EXTRA_RDEPENDS += "\
    kernel-module-extrawlan-qca6174 \
    firmware-qca9377 \
    "
```

## meta-xcore/conf/machine/spycat4kcombo.conf
```bitbake
#
# This is config file for SpyCat 4K Combo
#

require conf/machine/include/xcore-arm.inc

MACHINE_FEATURES += "mmc emmc swap mountboot"

KERNEL_MODULE_AUTOLOAD += "wlan"

MTD_KERNEL = "mmcblk1p2"
MTD_ROOTFS = "mmcblk1p3"

ROOTFS_FILE = "rootfs.tar.bz2"

IMAGEDIR = "spycat4k"

MACHINE_ESSENTIAL_EXTRA_RDEPENDS += "\
    kernel-module-extrawlan-qca6174 \
    firmware-qca9377 \
    "
```

## meta-xcore/conf/machine/spycat4kmini.conf
```bitbake
#
# This is config file for SpyCat 4K mini
#

require conf/machine/include/xcore-arm.inc

MACHINE_FEATURES += "mountboot vfdsymbol"

MTD_KERNEL = "mtd0"
MTD_ROOTFS = "mtd2"

ROOTFS_FILE = "rootfs.bin"
```

## meta-xcore/conf/machine/spycatmini.conf
```bitbake
#@TYPE: Machine
#@NAME: spycatmini
#@DESCRIPTION: Machine configuration for SpyCat Mini

require conf/machine/include/xcore-mipsel.inc

MACHINE_FEATURES += "7segment"
```

## meta-xcore/conf/machine/spycatminiplus.conf
```bitbake
#@TYPE: Machine
#@NAME: spycatminiplus
#@DESCRIPTION: Machine configuration for SpyCat Mini Plus

require conf/machine/include/xcore-mipsel.inc

MACHINE_FEATURES += "7segment"

DVBMEDIASINK_CONFIG += "--with-h265"
```

## meta-xtrend/conf/machine/beyonwizu4.conf
```bitbake
#@TYPE: Machine
#@NAME: Beyonwiz U4
#@DESCRIPTION: Machine configuration for Beyonwiz U4

KERNELVERSION = "4.9.51"

IMAGEDIR = "beyonwiz/u4"

MACHINE_ESSENTIAL_EXTRA_RDEPENDS += "\
	et-dvb-modules-${MACHINE} \
	et-initrd-et13000 \
	"

require conf/machine/include/etxx00-oem.inc

PREFERRED_VERSION_linux-etxx00 = "${KERNELVERSION}"

MACHINE_FEATURES += "dvb-c textlcd multitranscoding fanctrl HDMI-IN-FHD"

SOC_FAMILY = "bcm7252s"

RCTYPE = "507"
RCNAME = "beyonwiz1"
```

## meta-xtrend/conf/machine/et10000.conf
```bitbake
#@TYPE: Machine
#@NAME: Xtrend et10000
#@DESCRIPTION: Machine configuration for the Xtrend et10000

SOC_FAMILY = "bcm7425"

require conf/machine/include/etxx00-2g.inc

RCTYPE = "9"
RCNAME = "et8000"

MACHINE_FEATURES += "dvb-c ci fanctrl bwlcd128 blindscan-dvbc multitranscoding blindscan-tbs wol HDMI-IN-HD YUV"
```

## meta-xtrend/conf/machine/et13000.conf
```bitbake
#@TYPE: Machine
#@NAME: Xtrend et13000
#@DESCRIPTION: Machine configuration for Xtrend et13000

KERNELVERSION = "4.9.51"

MACHINE_ESSENTIAL_EXTRA_RDEPENDS += "\
	et-dvb-modules-beyonwizu4 \
	et-initrd-${MACHINE} \
	"

require conf/machine/include/etxx00-oem.inc

PREFERRED_VERSION_linux-etxx00 = "${KERNELVERSION}"

MACHINE_FEATURES += "textlcd multitranscoding fanctrl SCART RCA HDMI-IN-FHD"

SOC_FAMILY = "bcm7252s"

RCTYPE = "9"
```

## meta-xtrend/conf/machine/et1x000.conf
```bitbake
#@TYPE: Machine
#@NAME: Xtrend et1x000
#@DESCRIPTION: Machine configuration for Xtrend et1x000

KERNELVERSION = "4.1.37"

MACHINE_ESSENTIAL_EXTRA_RDEPENDS += "\
	et-dvb-modules-${MACHINE} \
	et-initrd-${MACHINE} \
	"

require conf/machine/include/etxx00-oem.inc

PREFERRED_VERSION_linux-etxx00 = "${KERNELVERSION}"

MACHINE_FEATURES += "ci 7segment"

SOC_FAMILY = "bcm7251s"

RCTYPE = "504"
RCNAME = "et7x00mini"
```

## meta-xtrend/conf/machine/et4x00.conf
```bitbake
#@TYPE: Machine
#@NAME: Xtrend et4x00
#@DESCRIPTION: Machine configuration for the Xtrend et4x00

DEFAULTTUNE = "mips32el-nf"

SOC_FAMILY = "bcm7358"

require conf/machine/include/etxx00-2g.inc

# Broken bootloader can only flash around 100 MB
FLASHSIZE = "96"

RCTYPE = "13"
RCNAME = "et4x00"

MACHINE_FEATURES += "nofhdskin blindscan-dvbs RCA"
```

## meta-xtrend/conf/machine/et5x00.conf
```bitbake
#@TYPE: Machine
#@NAME: Xtrend et5x00
#@DESCRIPTION: Machine configuration for the Xtrend et5x00

SOC_FAMILY = "bcm7413"

require conf/machine/include/etxx00.inc

RCTYPE = "7"
RCNAME = "et6x00"

MACHINE_FEATURES += "nofhdskin"
```

## meta-xtrend/conf/machine/et6x00.conf
```bitbake
#@TYPE: Machine
#@NAME: Xtrend et6x00
#@DESCRIPTION: Machine configuration for the Xtrend et6x00

SOC_FAMILY = "bcm7413"

require conf/machine/include/etxx00.inc

RCTYPE = "7"
RCNAME = "et6x00"

MACHINE_FEATURES += "textlcd SCART"
```

## meta-xtrend/conf/machine/et7x00.conf
```bitbake
#@TYPE: Machine
#@NAME: Xtrend et7x00
#@DESCRIPTION: Machine configuration for the Xtrend et7x00

SOC_FAMILY = "bcm7362"

require conf/machine/include/et7k.inc

MACHINE_FEATURES += "textlcd blindscan-dvbs SCART YUV vfdsymbol"

RCTYPE = "16"
RCNAME = "et7x00"
```

## meta-xtrend/conf/machine/et8000.conf
```bitbake
#@TYPE: Machine
#@NAME: Xtrend et8000
#@DESCRIPTION: Machine configuration for the Xtrend et8000

SOC_FAMILY = "bcm7241"

require conf/machine/include/etxx00-2g.inc

# Broken bootloader can only flash around 100 MB
FLASHSIZE = "96"

RCTYPE = "9"
RCNAME = "et8000"

MACHINE_FEATURES += "dvb-c ci fanctrl textlcd blindscan-dvbc blindscan-tbs RCA"
```

## meta-xtrend/conf/machine/et8500.conf
```bitbake
#@TYPE: Machine
#@NAME: Xtrend et8500
#@DESCRIPTION: Machine configuration for the Xtrend et8500

SOC_FAMILY = "bcm7241"

require conf/machine/include/et7k.inc

MACHINE_FEATURES += "colorlcd720 dvb-c ci fanctrl videoenhancement blindscan-dvbc RCA"

RCTYPE = "16"
RCNAME = "et8000"
```

## meta-xtrend/conf/machine/et9x00.conf
```bitbake
#@TYPE: Machine
#@NAME: Xtrend et9x00
#@DESCRIPTION: Machine configuration for the Xtrend et9x00

SOC_FAMILY = "bcm7413"

require conf/machine/include/etxx00.inc

RCTYPE = "5"
RCNAME = "et9x00"

MACHINE_FEATURES += "ci fanctrl textlcd SCART"
```

## meta-xtrend/conf/machine/include/et.inc
```bitbake
# We know about rtc
MACHINE_FEATURES_BACKFILL_CONSIDERED += "rtc"

MACHINE_ESSENTIAL_EXTRA_RDEPENDS += "\
	et-dvb-modules-${MACHINE} \
	gstreamer1.0-plugin-dvbmediasink \
	"

MTD_KERNEL = "mtd1"
MTD_ROOTFS = "mtd2"
KERNEL_FILE = "kernel.bin"
ROOTFS_FILE = "rootfs.bin"

DVBMEDIASINK_CONFIG = "--with-wma --with-wmv --with-pcm --with-dts --with-eac3"

TARGET_ARCH = "mipsel"
DEFAULTTUNE = "mips32el"

KERNEL_IMAGETYPE = "vmlinux"
KERNEL_OUTPUT = "${KERNEL_IMAGETYPE}"
KERNEL_OUTPUT_DIR = "."
KERNEL_CONSOLE = "null"

IMAGE_FSTYPES ?= "ubi"

IMAGE_CMD_ubi_append = " \
	mkdir -p ${IMGDEPLOYDIR}/${IMAGEDIR}; \
	cp -f ${IMGDEPLOYDIR}/${IMAGE_NAME}${IMAGE_NAME_SUFFIX}.ubi ${IMGDEPLOYDIR}/${IMAGEDIR}/${ROOTFS_FILE}; \
	gzip -9c ${DEPLOY_DIR_IMAGE}/vmlinux-${MACHINE}.bin > ${IMGDEPLOYDIR}/${IMAGEDIR}/${KERNEL_FILE}; \
	echo "${IMAGE_NAME}" > ${IMGDEPLOYDIR}/${IMAGEDIR}/imageversion; \
	echo "https://forum.openvision.tech/app.php/donate" > ${IMGDEPLOYDIR}/${IMAGEDIR}/donate.txt; \
	echo "rename this file to 'force' to force an update without confirmation" > ${IMGDEPLOYDIR}/${IMAGEDIR}/noforce; \
	rm -f ${IMGDEPLOYDIR}/*.zip; \
	cd ${IMGDEPLOYDIR}; \
	zip ${IMAGE_NAME}_usb.zip ${IMAGEDIR}/*; \
	rm -f ${DEPLOY_DIR_IMAGE}/*.ubi; \
	rm -f ${DEPLOY_DIR_IMAGE}/*.ubifs; \
	rm -rf ${IMAGEDIR}; \
	"

IMAGE_CMD_ubifs_prepend = " \
	rm -Rf ${IMAGE_ROOTFS}/boot/*; \
	rm -Rf ${IMAGE_ROOTFS}/tmp/*; \
	"

MACHINE_FEATURES += "alsa usbhost switchoff osdposition hdmicec HDMI"

require conf/machine/include/tune-mips32.inc

BOX_BRAND = "xtrend"

PREFERRED_PROVIDER_virtual/kernel = "linux-etxx00"

BLINDSCAN_BINARY = "avl_xtrend_blindscan"
```
