## meta-ini/conf/machine/bwidowx2.conf
```bitbake
#
# This is config file for SPACE Black Widow-X2
#

require conf/machine/include/inihde2.inc

MACHINE_FEATURES += "dvb-c blindscan-dvbc blindscan-dvbs ci"

MACHINE_ESSENTIAL_EXTRA_RDEPENDS += "\
	ini-dvb-modules-yhgd2580-7362 \
	"

RCNAME = "ini6"
RCIDNUM = "1"
```

## meta-ini/conf/machine/evoslim.conf
```bitbake
#
# This is config file for EVO Slim
#

require conf/machine/include/inihde2.inc

IMAGEDIR = "xpeedlxpro"

MACHINE_FEATURES += "dvb-c"

MACHINE_ESSENTIAL_EXTRA_RDEPENDS += "\
	ini-dvb-modules-yhgd5034 \
	"

RCNAME = "evo8"
RCIDNUM = "1"
```

## meta-ini/conf/machine/include/ini-oem.inc
```bitbake
# We know about rtc
MACHINE_FEATURES_BACKFILL_CONSIDERED += "rtc"

BOX_BRAND = "ini"

KERNEL_FILE = "kernel.bin"
ROOTFS_FILE = "rootfs.bin"

DVBPROVIDER = "kernel"

MACHINE_ESSENTIAL_EXTRA_RDEPENDS += "\
	gstreamer1.0-plugin-dvbmediasink \
	kernel-module-rtl8192cu \
	firmware-rtl8192cu \
	firmware-rtl8192cufw \
	"

TARGET_ARCH = "mipsel"
DEFAULTTUNE = "mips32el"

DVBMEDIASINK_CONFIG = "--with-wma --with-wmv --with-pcm --with-dts"

PREFERRED_PROVIDER_virtual/blindscan-dvbs = "ini-blindscan-utils"
PREFERRED_PROVIDER_virtual/blindscan-dvbc = "ini-blindscan-utils"

KERNEL_IMAGETYPE = "vmlinux"
KERNEL_OUTPUT = "${KERNEL_IMAGETYPE}"
KERNEL_CONSOLE = "ttyS0,115200n8"

IMAGE_FSTYPES ?= "ubi"

IMAGE_CMD_ubifs_prepend = "\
	rm -rf ${IMAGE_ROOTFS}/boot/*; \
	rm -rf ${IMAGE_ROOTFS}/tmp/*; \
	"

IMAGE_CMD_ubi_append = " \
	mkdir -p ${DEPLOY_DIR_IMAGE}/${IMAGEDIR}; \
	${@bb.utils.contains("MACHINE_FEATURES", "extrasplash", "cp -f ${DEPLOY_DIR_IMAGE}/cfe.bmp ${DEPLOY_DIR_IMAGE}/${IMAGEDIR}/;" , "", d)} \
	${@bb.utils.contains("MACHINE_FEATURES", "extrasplash", "cp -f ${DEPLOY_DIR_IMAGE}/splash.bmp ${DEPLOY_DIR_IMAGE}/${IMAGEDIR}/;" , "", d)} \
	${@bb.utils.contains("MACHINE_FEATURES", "extrasplash", "cp -f ${DEPLOY_DIR_IMAGE}/imageversion.bmp ${DEPLOY_DIR_IMAGE}/${IMAGEDIR}/;" , "", d)} \
	${@bb.utils.contains("MACHINE_FEATURES", "extrasplash", "cp -f ${DEPLOY_DIR_IMAGE}/kernel.bmp ${DEPLOY_DIR_IMAGE}/${IMAGEDIR}/;" , "", d)} \
	${@bb.utils.contains("MACHINE_FEATURES", "extrasplash", "cp -f ${DEPLOY_DIR_IMAGE}/rootfs.bmp ${DEPLOY_DIR_IMAGE}/${IMAGEDIR}/;" , "", d)} \
	${@bb.utils.contains("MACHINE_FEATURES", "extrasplash", "cp -f ${DEPLOY_DIR_IMAGE}/finished.bmp ${DEPLOY_DIR_IMAGE}/${IMAGEDIR}/;" , "", d)} \
	mv -f ${IMGDEPLOYDIR}/${IMAGE_NAME}${IMAGE_NAME_SUFFIX}.ubi ${DEPLOY_DIR_IMAGE}/${IMAGEDIR}/${ROOTFS_FILE}; \
	gzip -f -9c ${DEPLOY_DIR_IMAGE}/vmlinux-${MACHINE}.bin > ${DEPLOY_DIR_IMAGE}/${IMAGEDIR}/${KERNEL_FILE}; \
	echo ${IMAGE_NAME} > ${DEPLOY_DIR_IMAGE}/${IMAGEDIR}/imageversion; \
	echo "https://forum.openvision.tech/app.php/donate" > ${DEPLOY_DIR_IMAGE}/${IMAGEDIR}/donate.txt; \
	${@bb.utils.contains('MACHINE_FEATURES', 'forceflash', \
	'echo "dont change this file" > ${DEPLOY_DIR_IMAGE}/${IMAGEDIR}/force;' , \
	'echo "rename this file to force to force an update without confirmation" > ${DEPLOY_DIR_IMAGE}/${IMAGEDIR}/noforce;', d)} \
	rm -f ${DEPLOY_DIR_IMAGE}/*.zip; \
	cd ${DEPLOY_DIR_IMAGE}; \
	zip ${IMAGE_NAME}_usb.zip ${IMAGEDIR}/*; \
	rm -f ${DEPLOY_DIR_IMAGE}/*.ubi; \
	rm -f ${DEPLOY_DIR_IMAGE}/*.ubifs; \
	rm -rf ${IMAGEDIR}; \
	rm -rf atemio; \
	rm -rf miraclebox; \
	rm -rf beyonwiz; \
	rm -rf bwidowx; \
	rm -rf bwidowx2; \
	rm -rf opticum; \
	"

MACHINE_FEATURES += "alsa hdmicec switchoff usbhost osdposition micom HDMI RCA"

# Broken bootloader can only flash around 100 MB
FLASHSIZE = "96"

BOOTLOGO_FILENAME = "splash.bin"

BLINDSCAN_BINARY = "ini_blindscan"

require conf/machine/include/tune-mips32.inc
require conf/machine/include/soc-family.inc

RCNAME ?= "ini4"
```

## meta-ini/conf/machine/include/inihde.inc
```bitbake
require conf/machine/include/ini-oem.inc

KERNELVERSION = "3.12.1"

MTD_KERNEL = "mtd2"
MTD_ROOTFS = "mtd0"

PREFERRED_PROVIDER_virtual/kernel = "linux-ini-hde"
PREFERRED_VERSION_linux-ini-hde2 = "${KERNELVERSION}"

MACHINE_FEATURES += "videoenhancement extrasplash blindscan-tbs blindscan-dvbs blindscan-dvbc dvb-c ci"

SOC_FAMILY = "bcm7358"

MKUBIFS_ARGS = "-m 2048 -e 126976 -c 4096"
UBINIZE_ARGS = "-m 2048 -p 128KiB"

MACHINE_ESSENTIAL_EXTRA_RDEPENDS += "\
	ini-cfe \
	"

STB_PLATFORM = "inihde"
```

## meta-ini/conf/machine/include/inihde2.inc
```bitbake
require conf/machine/include/ini-oem.inc

KERNELVERSION = "3.14.2"

MTD_KERNEL = "mtd2"
MTD_ROOTFS = "mtd0"

PREFERRED_PROVIDER_virtual/kernel = "linux-ini-hde2"
PREFERRED_VERSION_linux-ini-hde2 = "${KERNELVERSION}"

MACHINE_FEATURES += "videoenhancement extrasplash blindscan-tbs YUV"

SOC_FAMILY = "bcm7362"

MKUBIFS_ARGS = "-m 2048 -e 126976 -c 4096"
UBINIZE_ARGS = "-m 2048 -p 128KiB"

MACHINE_ESSENTIAL_EXTRA_RDEPENDS += "\
	ini-cfe \
	"

STB_PLATFORM = "inihde2"
```

## meta-ini/conf/machine/include/inihdp.inc
```bitbake
require conf/machine/include/ini-oem.inc

KERNELVERSION = "3.14.2"

MTD_KERNEL = "mtd2"
MTD_ROOTFS = "mtd0"

PREFERRED_PROVIDER_virtual/kernel = "linux-ini-hdp"
PREFERRED_VERSION_linux-ini-hdp = "${KERNELVERSION}"

MACHINE_FEATURES += "videoenhancement extrasplash blindscan-tbs dvb-c blindscan-dvbc blindscan-dvbs multitranscoding transcoding bwlcd255 fanctrl fan wol ci YUV HDMI-IN-HD"

SOC_FAMILY = "bcm7425"

MKUBIFS_ARGS = "-m 4096 -e 1040384 -c 1984"
UBINIZE_ARGS = "-m 4096 -p 1024KiB"

MACHINE_ESSENTIAL_EXTRA_RDEPENDS += "\
	ini-coldboot \
	ini-ethwol \
	ini-cfe \
	"

STB_PLATFORM = "inihdp"
```

## meta-ini/conf/machine/include/inihdx.inc
```bitbake
require conf/machine/include/ini-oem.inc

KERNELVERSION = "3.6.0"

MTD_KERNEL = "mtd1"
MTD_ROOTFS = "mtd2"

PREFERRED_PROVIDER_virtual/kernel = "linux-ini-hdx"
PREFERRED_VERSION_linux-ini-hdx = "${KERNELVERSION}"

MACHINE_FEATURES += "textlcd fanctrl extrasplash blindscan-dvbc blindscan-dvbs ci dvb-c SCART YUV"

SOC_FAMILY = "bcm7413"

MKUBIFS_ARGS = "-m 2048 -e 126976 -c 4096"
UBINIZE_ARGS = "-m 2048 -p 128KiB"

MACHINE_ESSENTIAL_EXTRA_RDEPENDS += "\
	ini-dvb-modules-inihdx \
	ini-cfe \
	"

STB_PLATFORM = "inihdx"
```

## meta-ini/conf/machine/mbhybrid.conf
```bitbake
#
# This is config file for Miraclebox Premium Hybrid
#

require conf/machine/include/inihde2.inc

IMAGEDIR = "miraclebox/minihybrid"

MACHINE_FEATURES += "dvb-c"

MACHINE_ESSENTIAL_EXTRA_RDEPENDS += "\
	ini-dvb-modules-inihde2sv \
	"

RCNAME = "ini3"
```

## meta-ini/conf/machine/mbmini.conf
```bitbake
#
# This is config file for Miraclebox Premium Mini
#

require conf/machine/include/inihde.inc

MACHINE_FEATURES += "textlcd vfdsymbol"

IMAGEDIR = "miraclebox/mini"

MACHINE_ESSENTIAL_EXTRA_RDEPENDS += "\
	ini-dvb-modules-inihde \
	"

RCNAME = "ini3"
```

## meta-ini/conf/machine/mbminiplus.conf
```bitbake
#
# This is config file for Miraclebox Premium Mini Plus
#

require conf/machine/include/inihde2.inc

IMAGEDIR = "miraclebox/miniplus"

MACHINE_FEATURES += "dvb-c blindscan-dvbc blindscan-dvbs ci SCART"

MACHINE_ESSENTIAL_EXTRA_RDEPENDS += "\
	ini-dvb-modules-inihde2sv \
	"
```

## meta-ini/conf/machine/mbtwin.conf
```bitbake
#
# This is config file for Miraclebox Premium Twin
#

require conf/machine/include/inihdx.inc

IMAGEDIR = "miraclebox/twin"

MACHINE_FEATURES += "vfdsymbol"

RCNAME = "ini3"
```

## meta-ini/conf/machine/mbultra.conf
```bitbake
#
# This is config file for Miraclebox Premium Ultra
#

require conf/machine/include/inihdp.inc

IMAGEDIR = "miraclebox/ultra"

MACHINE_ESSENTIAL_EXTRA_RDEPENDS += "\
	ini-dvb-modules-ini-800 \
	kernel-module-extrawlan-rt8723bt \
	kernel-module-rtk-btusb \
	kernel-module-extrawlan-rt8723a \
	kernel-module-8723au \
	kernel-module-tuner-it913x \
	enigma2-plugin-drivers-dvb-usb-it913x \
	"

MACHINE_FEATURES += "bluetooth"

RCNAME = "ini3"
```

## meta-ini/conf/machine/opticumtt.conf
```bitbake
#
# This is config file for Opticum Twin
#

require conf/machine/include/inihde2.inc

IMAGEDIR = "opticum/tt"

MACHINE_FEATURES += "dvb-c blindscan-dvbc blindscan-dvbs ci textlcd"

MACHINE_ESSENTIAL_EXTRA_RDEPENDS += "\
	ini-dvb-modules-ini-435oc \
	"

RCNAME = "ini8"
RCIDNUM = "1"
```

## meta-ini/conf/machine/sezam1000hd.conf
```bitbake
#
# This is config file for Sezam 1000HD
#

require conf/machine/include/inihde.inc

MACHINE_FEATURES += "textlcd vfdsymbol"

IMAGEDIR = "hde"

MACHINE_ESSENTIAL_EXTRA_RDEPENDS += "\
	ini-dvb-modules-inihde \
	"

RCNAME = "ini2"
```

## meta-ini/conf/machine/sezam5000hd.conf
```bitbake
#
# This is config file for Sezam 5000HD
#

require conf/machine/include/inihdx.inc

IMAGEDIR = "hdx"

MACHINE_FEATURES += "vfdsymbol"

RCNAME = "ini2"
```

## meta-ini/conf/machine/sezammarvel.conf
```bitbake
#
# This is config file for Sezam Marvel
#

require conf/machine/include/inihdp.inc

IMAGEDIR = "hdp"

MACHINE_ESSENTIAL_EXTRA_RDEPENDS += "\
	ini-dvb-modules-ini-900 \
	kernel-module-extrawlan-rt3070 \
	firmware-rt3070 \
	"
```

## meta-ini/conf/machine/ventonhdx.conf
```bitbake
#
# This is config file for Venton HDX
#

require conf/machine/include/inihdx.inc

IMAGEDIR = "venton-hdx"

RCNAME = "ini0"
```

## meta-ini/conf/machine/xpeedlx.conf
```bitbake
#
# This is config file for GI LX-x
#

require conf/machine/include/inihde.inc

MACHINE_FEATURES += "textlcd"

MACHINE_ESSENTIAL_EXTRA_RDEPENDS += "\
	ini-dvb-modules-inihde \
	"
```

## meta-ini/conf/machine/xpeedlx3.conf
```bitbake
#
# This is config file for GI LX-3
#

require conf/machine/include/inihdp.inc

MACHINE_ESSENTIAL_EXTRA_RDEPENDS += "\
	ini-dvb-modules-ini-900 \
	kernel-module-extrawlan-rt3070 \
	firmware-rt3070 \
	"
```

## meta-ixuss/conf/layer.conf
```bitbake
# We have a conf and classes directory, append to BBPATH
BBPATH .= ":${LAYERDIR}"

# We have a recipes directory, add to BBFILES
BBFILES += "${LAYERDIR}/recipes-*/*.bb ${LAYERDIR}/recipes-*/*.bbappend \
            ${LAYERDIR}/recipes-*/*/*.bb ${LAYERDIR}/recipes-*/*/*.bbappend \
            ${LAYERDIR}/recipes-*/*/*/*.bb ${LAYERDIR}/recipes-*/*/*/*.bbappend"

METAIXUSS_BASE := '${@os.path.normpath("${LAYERDIR}/../")}'
# Prevent current directory creeping into sstate objects. Otherwise, building
# in another TOPDIR will cause recipes using this variable to be rebuilt.
METAIXUSS_BASE[vardepvalue] = 'meta-ixuss'

# Additional license directories.
LICENSE_PATH += "${LAYERDIR}/conf/license"
```

## meta-ixuss/conf/machine/include/ixuss.inc
```bitbake
# We know about rtc
MACHINE_FEATURES_BACKFILL_CONSIDERED += "rtc"

KERNELVERSION = "3.3.0"

BOX_BRAND = "ixuss"

KERNEL_FILE = "kernel.bin"
ROOTFS_FILE = "rootfs.bin"

MACHINE_ESSENTIAL_EXTRA_RDEPENDS += "\
	ixuss-dvb-modules-${MACHINE} \
	ixuss-shutdown \
	gstreamer1.0-plugin-dvbmediasink \
	"

DVBPROVIDER = "kernel"

SOC_FAMILY = "bcm7413"

DVBMEDIASINK_CONFIG = "--with-wma --with-wmv --with-pcm --with-dtsdownmix"

TARGET_ARCH = "mipsel"
DEFAULTTUNE = "mips32el"

GLIBC_EXTRA_OECONF = "--with-tls --with-__thread"

PREFERRED_PROVIDER_virtual/kernel = "linux-ixuss"

PREFERRED_VERSION_linux-ixuss = "${KERNELVERSION}"

KERNEL_IMAGETYPE = "vmlinux"
KERNEL_OUTPUT = "${KERNEL_IMAGETYPE}"
KERNEL_CONSOLE = "ttyS0,115200n8"

IMAGE_FSTYPES ?= "ubi"

MKUBIFS_ARGS = "-m 2048 -e 126976 -c 4096 -F"
UBINIZE_ARGS = "-m 2048 -p 128KiB"

IMAGE_CMD_ubifs_prepend = "\
	rm -rf ${IMAGE_ROOTFS}/boot/*; \
	rm -rf ${IMAGE_ROOTFS}/tmp/*; \
	"

IMAGE_CMD_ubi_append = " \
	mkdir -p ${DEPLOY_DIR_IMAGE}/${IMAGEDIR}; \
	mv -f ${IMGDEPLOYDIR}/${IMAGE_NAME}${IMAGE_NAME_SUFFIX}.ubi ${DEPLOY_DIR_IMAGE}/${IMAGEDIR}/${ROOTFS_FILE}; \
	gzip -9c ${DEPLOY_DIR_IMAGE}/vmlinux-${MACHINE}.bin > ${DEPLOY_DIR_IMAGE}/${IMAGEDIR}/${KERNEL_FILE}; \
	echo ${IMAGE_NAME} > ${DEPLOY_DIR_IMAGE}/${IMAGEDIR}/imageversion; \
	echo "https://forum.openvision.tech/app.php/donate" > ${DEPLOY_DIR_IMAGE}/${IMAGEDIR}/donate.txt; \
	echo "rename this file to 'force' to force an update without confirmation" > ${DEPLOY_DIR_IMAGE}/${IMAGEDIR}/noforce; \
	rm -f ${DEPLOY_DIR_IMAGE}/*.zip; \
	cd ${DEPLOY_DIR_IMAGE}; \
	zip ${IMAGE_NAME}_usb.zip ${IMAGEDIR}/*; \
	rm -f ${DEPLOY_DIR_IMAGE}/*.ubi; \
	rm -f ${DEPLOY_DIR_IMAGE}/*.ubifs; \
	rm -rf ${IMAGEDIR}; \
	"

MACHINE_FEATURES += "alsa hdmicec switchoff textlcd ixuss HDMI RCA vfdsymbol"

# Broken bootloader can only flash around 100 MB
FLASHSIZE = "96"

BOOTLOGO_FILENAME = "cfe-bootlogo.bmp"

require conf/machine/include/tune-mips32.inc
require conf/machine/include/soc-family.inc

RCNAME = "ixuss"
```

## meta-ixuss/conf/machine/ixussone.conf
```bitbake
#@TYPE: Machine
#@NAME: Ixuss One
#@DESCRIPTION: Machine configuration for the Ixuss One

MTD_ROOTFS = "mtd2"
MTD_KERNEL = "mtd1"

IMAGEDIR = "medialink/ixussone"

require conf/machine/include/ixuss.inc

MACHINE_FEATURES += "YUV"
```

## meta-odin/conf/layer.conf
```bitbake
# We have a conf and classes directory, append to BBPATH
BBPATH .= ":${LAYERDIR}"

# We have a recipes directory, add to BBFILES
BBFILES += "${LAYERDIR}/recipes-*/*.bb ${LAYERDIR}/recipes-*/*.bbappend \
            ${LAYERDIR}/recipes-*/*/*.bb ${LAYERDIR}/recipes-*/*/*.bbappend \
            ${LAYERDIR}/recipes-*/*/*/*.bb ${LAYERDIR}/recipes-*/*/*/*.bbappend"

METAODIN_BASE := '${@os.path.normpath("${LAYERDIR}/../")}'
# Prevent current directory creeping into sstate objects. Otherwise, building
# in another TOPDIR will cause recipes using this variable to be rebuilt.
METAODIN_BASE[vardepvalue] = 'meta-odin'

# Additional license directories.
LICENSE_PATH += "${LAYERDIR}/conf/license"
```

## meta-odin/conf/machine/axase3.conf
```bitbake
#
# This is config file for Axas E3HD, Axas E3HD-C, Optibox Evo E3HD and Galaxy Innovations Genius E3HD
#

require conf/machine/include/e3hd.inc
```

## meta-odin/conf/machine/axodin.conf
```bitbake
#
# This is config file for Opticum AX ODIN, Opticum AX ODIN-C, Optibox EVO, Galaxy Innovations Genius, T-rex GalaxyM6, Starsat LX and Axas CLASS M
#

require conf/machine/include/odinm7.inc
```
